VERSION "icd_hash=988d22d6ca6c5c91cbbd255bbe1d794947c62240,flight_icd_hash=a87bbd2b659aa77ba19f4ee88d6b7bdd425ae081,git_commit_hash=c0af9743,merge_dbc_0=../../libs/flight_sw_icd/docs/icd/can/CanIcdInstanceGen/FcsCanC1.dbc,merge_dbc_1=../../libs/flight_sw_icd/docs/icd/can/CanIcdInstanceGen/FcsCanC2.dbc,merge_dbc_2=../../libs/flight_sw_icd/docs/icd/can/CanIcdInstanceGen/FcsCanL1.dbc,merge_dbc_3=../../libs/flight_sw_icd/docs/icd/can/CanIcdInstanceGen/FcsCanL2.dbc,merge_dbc_4=../../libs/flight_sw_icd/docs/icd/can/CanIcdInstanceGen/FcsCanR1.dbc,merge_dbc_5=../../libs/flight_sw_icd/docs/icd/can/CanIcdInstanceGen/FcsCanR2.dbc"

NS_ :

BS_:

BU_: L Maint EEC
VAL_TABLE_ COM_Maint_Cmd 238 "EEC_CMD_FUNCTION" 5 "REQUEST_SW_DOWNLOAD_B" 4 "REQUEST_SW_DOWNLOAD_A" 3 "REQUEST_SW_UPLOAD_B" 2 "REQUEST_SW_UPLOAD_A" 1 "REQUEST_QUIET_MODE" 0 "NO_MAINT_REQUEST" ;
VAL_TABLE_ EEC_Maint_Cmd_State_t 8 "EEC_STATE_MAINT_CMD_VOLTAGE_CTRL" 7 "EEC_STATE_MAINT_CMD_CURRENT_CTRL" 6 "EEC_STATE_MAINT_CMD_SPEED_CTRL" 5 "EEC_STATE_MAINT_CMD_ACTIVE_DISCHARGE" 4 "EEC_STATE_MAINT_CMD_RESIST_WINDMILL" 3 "EEC_STATE_MAINT_CMD_MIN_STOW" 2 "EEC_STATE_MAINT_CMD_MAX_STOW" 1 "EEC_STATE_MAINT_CMD_TORQUE_CTRL" 0 "EEC_STATE_MAINT_CMD_STANDBY" ;

BO_ 2047 COM_MaintCmd_EEC: 32 Maint
 SG_ COM_TargetLru_ID : 0|8@1+ (1,0) [0|255] "(none)"  EEC
 SG_ COM_MaintCmd : 8|8@1+ (1,0) [0|255] "enum"  EEC
 SG_ COM_MaintParam1 : 16|8@1+ (1,0) [0|255] "(none)"  EEC
 SG_ COM_MaintParam2 : 24|8@1+ (1,0) [0|255] "(none)"  EEC
 SG_ current_ctrl_i_dq_cmd_d : 32|32@1+ (1,0) [-3.4e+38|3.4e+38] "Amps"  EEC
 SG_ current_ctrl_i_dq_cmd_q : 64|32@1+ (1,0) [-3.4e+38|3.4e+38] "Amps"  EEC
 SG_ voltage_ctrl_v_dq_cmd_d : 96|32@1+ (1,0) [-3.4e+38|3.4e+38] "Volts"  EEC
 SG_ voltage_ctrl_v_dq_cmd_q : 128|32@1+ (1,0) [-3.4e+38|3.4e+38] "Volts"  EEC
 SG_ commanded_engine_torque : 160|32@1+ (1,0) [-3.4e+38|3.4e+38] "Nm"  EEC
 SG_ commanded_engine_speed : 192|32@1+ (1,0) [-3.4e+38|3.4e+38] "RPM"  EEC
 SG_ eec_maint_command : 224|8@1+ (1,0) [0|8] "enum"  EEC

BO_ 1186 BMU_2C_Control_Status_MSG18: 48 BMU_2C
 SG_ BMU_CellStackVoltage : 7|10@0+ (1,0) [0|1023] "Volts" Vector__XXX
 SG_ BMU_CellStackVoltage_Validity : 9|2@0+ (1,0) [0|3] "Enum" Vector__XXX
 SG_ BMU_PropBusVoltage : 23|10@0+ (1,0) [0|1023] "Volts" Vector__XXX
 SG_ BMU_PropBusVoltage_Validity : 25|2@0+ (1,0) [0|3] "Enum" Vector__XXX
 SG_ BMU_XlinkCurrent : 39|10@0- (1,0) [-512|511] "Amps" Vector__XXX
 SG_ BMU_XlinkCurrent_Validity : 41|2@0+ (1,0) [0|3] "Enum" Vector__XXX
 SG_ BMU_EE1Current : 55|10@0- (1,0) [-512|511] "Amps" Vector__XXX
 SG_ BMU_EE1Current_Validity : 57|2@0+ (1,0) [0|3] "Enum" Vector__XXX
 SG_ BMU_EE2Current : 71|10@0- (1,0) [-512|511] "Amps" Vector__XXX
 SG_ BMU_EE2Current_Validity : 73|2@0+ (1,0) [0|3] "Enum" Vector__XXX
 SG_ BMU_DchgPwr2sLoFi : 87|10@0+ (0.5,-511.5) [-511.5|0] "kW" Vector__XXX
 SG_ BMU_DchgPwr2sLoFi_Validity : 89|2@0+ (1,0) [0|3] "Enum" Vector__XXX
 SG_ BMU_DchgPwr10sLoFi : 103|10@0+ (0.5,-511.5) [-511.5|0] "kW" Vector__XXX
 SG_ BMU_DchgPwr10sLoFi_Validity : 105|2@0+ (1,0) [0|3] "Enum" Vector__XXX
 SG_ BMU_Mate_DchgPwr2sHiFi : 119|10@0+ (0.5,-511.5) [-511.5|0] "kWh" Vector__XXX
 SG_ BMU_Mate_DchgPwr2sHiFi_Validity : 121|2@0+ (1,0) [0|3] "Enum" Vector__XXX
 SG_ BMU_Mate_DchgPwr10sHiFi : 135|10@0+ (0.5,-511.5) [-511.5|0] "kWh" Vector__XXX
 SG_ BMU_Mate_DchgPwr10sHiFi_Validity : 137|2@0+ (1,0) [0|3] "Enum" Vector__XXX
 SG_ BMU_ChgPwr2sLoFi : 151|8@0+ (0.5,0) [0|127.5] "kW" Vector__XXX
 SG_ BMU_ChgPwr10sLoFi : 159|8@0+ (0.5,0) [0|127.5] "kW" Vector__XXX
 SG_ BMU_Mate_ChgPwr2sHiFi : 167|8@0+ (0.5,0) [0|127.5] "kWh" Vector__XXX
 SG_ BMU_Mate_ChgPwr10sHiFi : 175|8@0+ (0.5,0) [0|127.5] "kWh" Vector__XXX
 SG_ BMU_AuxCurrent : 183|8@0+ (0.1,0) [0|25.5] "Amps" Vector__XXX
 SG_ BMU_CLEnergyLoFi : 191|8@0+ (0.1,0) [0|25.5] "kWh" Vector__XXX
 SG_ BMU_VLEnergyLoFi : 199|8@0+ (0.1,0) [0|25.5] "kWh" Vector__XXX
 SG_ BMU_MaxAvailEnergyLoFi : 207|8@0+ (0.1,0) [0|25.5] "kWh" Vector__XXX
 SG_ BMU_RemainingEnergyLoFi : 215|8@0+ (0.1,0) [0|25.5] "kWh" Vector__XXX
 SG_ BMU_ChargerVoltage : 223|10@0+ (1,0) [0|1023] "Volts" Vector__XXX
 SG_ BMU_ChargerVoltage_Validity : 225|2@0+ (1,0) [0|3] "Enum" Vector__XXX
 SG_ BMU_ChargeCurrent : 239|9@0+ (1,0) [0|511] "Amps" Vector__XXX
 SG_ BMU_ChargeCurrent_Validity : 241|2@0+ (1,0) [0|3] "Enum" Vector__XXX
 SG_ BMU_ChargeTimeRemaining : 255|10@0+ (1,0) [0|1023] "Minutes" Vector__XXX
 SG_ BMU_ChargeTimeRemaining_Validity : 257|2@0+ (1,0) [0|3] "Enum" Vector__XXX
 SG_ BMU_RemainingEnergyLoFi_Validity : 271|2@0+ (1,0) [0|3] "Enum" Vector__XXX
 SG_ BMU_MaxAvailEnergyLoFi_Validity : 269|2@0+ (1,0) [0|3] "Enum" Vector__XXX
 SG_ BMU_VLEnergyLoFi_Validity : 267|2@0+ (1,0) [0|3] "Enum" Vector__XXX
 SG_ BMU_CLEnergyLoFi_Validity : 265|2@0+ (1,0) [0|3] "Enum" Vector__XXX
 SG_ BMU_ChgPwr10sLoFi_Validity : 279|2@0+ (1,0) [0|3] "Enum" Vector__XXX
 SG_ BMU_ChgPwr2sLoFi_Validity : 277|2@0+ (1,0) [0|3] "Enum" Vector__XXX
 SG_ BMU_Mate_ChgPwr10sHiFi_Validity : 275|2@0+ (1,0) [0|3] "Enum" Vector__XXX
 SG_ BMU_Mate_ChgPwr2sHiFi_Validity : 273|2@0+ (1,0) [0|3] "Enum" Vector__XXX
 SG_ BMU_MainBusConnectionState : 287|3@0+ (1,0) [0|7] "Enum" Vector__XXX
 SG_ BMU_PropBusConnectionState : 284|3@0+ (1,0) [0|7] "Enum" Vector__XXX
 SG_ BMU_AuxCurrent_Validity : 281|2@0+ (1,0) [0|3] "Enum" Vector__XXX
 SG_ BMU_EE1PyroStatus : 335|2@0+ (1,0) [0|3] "Enum" Vector__XXX
 SG_ BMU_EE2PyroStatus : 333|2@0+ (1,0) [0|3] "Enum" Vector__XXX
 SG_ BMU_XlinkHSPyroStatus : 331|2@0+ (1,0) [0|3] "Enum" Vector__XXX
 SG_ BMU_XlinkLSPyroStatus : 329|2@0+ (1,0) [0|3] "Enum" Vector__XXX
 SG_ BMU_CCUModeSwitchPosition : 343|2@0+ (1,0) [0|3] "Enum" Vector__XXX
 SG_ BMU_ChargeStatus : 341|2@0+ (1,0) [0|3] "Enum" Vector__XXX
 SG_ BMU_ChargePlugStatus : 339|2@0+ (1,0) [0|3] "Enum" Vector__XXX
 SG_ BMU_ThermalPlugStatus : 337|2@0+ (1,0) [0|3] "Enum" Vector__XXX
 SG_ BMU_ECSMinBusVoltageFault : 351|1@0+ (1,0) [0|1] "Enum" Vector__XXX
 SG_ BMU_PropMinBusVoltageFault : 350|1@0+ (1,0) [0|1] "Enum" Vector__XXX
 SG_ BMU_HVPSImbalanceAlert : 349|1@0+ (1,0) [0|1] "Enum" Vector__XXX
 SG_ BMU_HVPSFaultAlert : 348|1@0+ (1,0) [0|1] "Enum" Vector__XXX
 SG_ BMU_CtrlHVPSDegradedAlert : 347|1@0+ (1,0) [0|1] "Enum" Vector__XXX
 SG_ BMU_PackHVExposedAlert : 346|1@0+ (1,0) [0|1] "Enum" Vector__XXX
 SG_ BMU_PackPyroStatus : 345|2@0+ (1,0) [0|3] "Enum" Vector__XXX
 SG_ BMU_Mate_HVPSImbalanceAlert : 359|1@0+ (1,0) [0|1] "Enum" Vector__XXX
 SG_ BMU_Mate_HVPSFaultAlert : 358|1@0+ (1,0) [0|1] "Enum" Vector__XXX
 SG_ BMU_Mate_PackHVExposedAlert : 357|1@0+ (1,0) [0|1] "Enum" Vector__XXX
 SG_ BMU_Mate_CtrlHVPSDegradedAlert : 356|1@0+ (1,0) [0|1] "Enum" Vector__XXX
 SG_ BMU_Mate_EstHVPSDegradedAlert : 355|1@0+ (1,0) [0|1] "Enum" Vector__XXX
 SG_ BMU_Mate_PackOverheatAlert : 354|1@0+ (1,0) [0|1] "Enum" Vector__XXX
 SG_ BMU_Mate_PackHiTempAlert : 353|1@0+ (1,0) [0|1] "Enum" Vector__XXX
 SG_ BMU_Mate_PackTempAlert : 352|1@0+ (1,0) [0|1] "Enum" Vector__XXX
 SG_ COM_RollingCounter : 367|8@0+ (1,0) [0|255] "NA" Vector__XXX
 SG_ COM_E2E_CRC16 : 375|16@0+ (1,0) [0|65535] "NA" Vector__XXX

BO_ 720 EEC_2_Status_Slow_MSG11: 32 EEC_2
 SG_ EEC_HVCurrent : 7|10@0+ (1,-500) [-500|523] "Amps" Vector__XXX
 SG_ EEC_HVInputVoltage : 23|10@0+ (1,0) [0|1023] "Volts" Vector__XXX
 SG_ EEC_ControllerTemp : 39|8@0+ (1,-50) [-50|205] "Celsius" Vector__XXX
 SG_ EEC_OilTemp : 47|8@0+ (1,-50) [-50|205] "Celsius" Vector__XXX
 SG_ EEC_StatorWindingTemp : 55|8@0+ (1,-50) [-50|205] "Celsius" Vector__XXX
 SG_ EEC_ConsolidatedTemp : 63|8@0+ (0.39215686275,0) [0|100.00000000125] "Percentage" Vector__XXX
 SG_ EEC_TakeoffTimeLimit : 71|10@0+ (1,-10) [-10|1013] "Seconds" Vector__XXX
 SG_ EEC_MaxPowerTimeLimit : 87|8@0+ (1,-10) [-10|245] "Seconds" Vector__XXX
 SG_ EEC_HVCurrent_Validity : 95|2@0+ (1,0) [0|3] "Enum" Vector__XXX
 SG_ EEC_HVInputVoltage_Validity : 93|2@0+ (1,0) [0|3] "Enum" Vector__XXX
 SG_ EEC_ControllerTemp_Validity : 91|2@0+ (1,0) [0|3] "Enum" Vector__XXX
 SG_ EEC_OilTemp_Validity : 89|2@0+ (1,0) [0|3] "Enum" Vector__XXX
 SG_ EEC_StatorWindingTemp_Validity : 103|2@0+ (1,0) [0|3] "Enum" Vector__XXX
 SG_ EEC_ConsolidatedTemp_Validity : 101|2@0+ (1,0) [0|3] "Enum" Vector__XXX
 SG_ EEC_TakeoffTimeLimit_Validity : 99|2@0+ (1,0) [0|3] "Enum" Vector__XXX
 SG_ EEC_MaxPowerTimeLimit_Validity : 97|2@0+ (1,0) [0|3] "Enum" Vector__XXX
 SG_ EEC_EngineFault_Alert : 111|1@0+ (1,0) [0|1] "Bool" Vector__XXX
 SG_ EEC_EngineDegraded_Alert : 110|1@0+ (1,0) [0|1] "Bool" Vector__XXX
 SG_ EEC_HighTemp_Alert : 109|1@0+ (1,0) [0|1] "Bool" Vector__XXX
 SG_ EEC_StowingAvailable : 108|1@0+ (1,0) [0|1] "Enum" Vector__XXX
 SG_ EEC_LACmdValidity : 119|2@0+ (1,0) [0|3] "Enum" Vector__XXX
 SG_ EEC_LBCmdValidity : 117|2@0+ (1,0) [0|3] "Enum" Vector__XXX
 SG_ EEC_RACmdValidity : 115|2@0+ (1,0) [0|3] "Enum" Vector__XXX
 SG_ EEC_RBCmdValidity : 113|2@0+ (1,0) [0|3] "Enum" Vector__XXX
 SG_ EEC_ContinuousRatedTorque : 135|10@0+ (1,0) [0|1023] "Nm" Vector__XXX
 SG_ EEC_EmergencyRatedTorque : 151|10@0+ (1,0) [0|1023] "Nm" Vector__XXX
 SG_ EEC_TakeoffRatedTorque : 167|10@0+ (1,0) [0|1023] "Nm" Vector__XXX
 SG_ EEC_HiTempTorqueLimit : 183|10@0+ (1,0) [0|1023] "Nm" Vector__XXX
 SG_ COM_RollingCounter : 239|8@0+ (1,0) [0|255] "NA" Vector__XXX
 SG_ COM_E2E_CRC16 : 247|16@0+ (1,0) [0|65535] "NA" Vector__XXX

BO_ 722 EEC_4_Status_Slow_MSG11: 32 EEC_4
 SG_ EEC_HVCurrent : 7|10@0+ (1,-500) [-500|523] "Amps" Vector__XXX
 SG_ EEC_HVInputVoltage : 23|10@0+ (1,0) [0|1023] "Volts" Vector__XXX
 SG_ EEC_ControllerTemp : 39|8@0+ (1,-50) [-50|205] "Celsius" Vector__XXX
 SG_ EEC_OilTemp : 47|8@0+ (1,-50) [-50|205] "Celsius" Vector__XXX
 SG_ EEC_StatorWindingTemp : 55|8@0+ (1,-50) [-50|205] "Celsius" Vector__XXX
 SG_ EEC_ConsolidatedTemp : 63|8@0+ (0.39215686275,0) [0|100.00000000125] "Percentage" Vector__XXX
 SG_ EEC_TakeoffTimeLimit : 71|10@0+ (1,-10) [-10|1013] "Seconds" Vector__XXX
 SG_ EEC_MaxPowerTimeLimit : 87|8@0+ (1,-10) [-10|245] "Seconds" Vector__XXX
 SG_ EEC_HVCurrent_Validity : 95|2@0+ (1,0) [0|3] "Enum" Vector__XXX
 SG_ EEC_HVInputVoltage_Validity : 93|2@0+ (1,0) [0|3] "Enum" Vector__XXX
 SG_ EEC_ControllerTemp_Validity : 91|2@0+ (1,0) [0|3] "Enum" Vector__XXX
 SG_ EEC_OilTemp_Validity : 89|2@0+ (1,0) [0|3] "Enum" Vector__XXX
 SG_ EEC_StatorWindingTemp_Validity : 103|2@0+ (1,0) [0|3] "Enum" Vector__XXX
 SG_ EEC_ConsolidatedTemp_Validity : 101|2@0+ (1,0) [0|3] "Enum" Vector__XXX
 SG_ EEC_TakeoffTimeLimit_Validity : 99|2@0+ (1,0) [0|3] "Enum" Vector__XXX
 SG_ EEC_MaxPowerTimeLimit_Validity : 97|2@0+ (1,0) [0|3] "Enum" Vector__XXX
 SG_ EEC_EngineFault_Alert : 111|1@0+ (1,0) [0|1] "Bool" Vector__XXX
 SG_ EEC_EngineDegraded_Alert : 110|1@0+ (1,0) [0|1] "Bool" Vector__XXX
 SG_ EEC_HighTemp_Alert : 109|1@0+ (1,0) [0|1] "Bool" Vector__XXX
 SG_ EEC_StowingAvailable : 108|1@0+ (1,0) [0|1] "Enum" Vector__XXX
 SG_ EEC_LACmdValidity : 119|2@0+ (1,0) [0|3] "Enum" Vector__XXX
 SG_ EEC_LBCmdValidity : 117|2@0+ (1,0) [0|3] "Enum" Vector__XXX
 SG_ EEC_RACmdValidity : 115|2@0+ (1,0) [0|3] "Enum" Vector__XXX
 SG_ EEC_RBCmdValidity : 113|2@0+ (1,0) [0|3] "Enum" Vector__XXX
 SG_ EEC_ContinuousRatedTorque : 135|10@0+ (1,0) [0|1023] "Nm" Vector__XXX
 SG_ EEC_EmergencyRatedTorque : 151|10@0+ (1,0) [0|1023] "Nm" Vector__XXX
 SG_ EEC_TakeoffRatedTorque : 167|10@0+ (1,0) [0|1023] "Nm" Vector__XXX
 SG_ EEC_HiTempTorqueLimit : 183|10@0+ (1,0) [0|1023] "Nm" Vector__XXX
 SG_ COM_RollingCounter : 239|8@0+ (1,0) [0|255] "NA" Vector__XXX
 SG_ COM_E2E_CRC16 : 247|16@0+ (1,0) [0|65535] "NA" Vector__XXX

BO_ 727 EEC_9_Status_Slow_MSG11: 32 EEC_9
 SG_ EEC_HVCurrent : 7|10@0+ (1,-500) [-500|523] "Amps" Vector__XXX
 SG_ EEC_HVInputVoltage : 23|10@0+ (1,0) [0|1023] "Volts" Vector__XXX
 SG_ EEC_ControllerTemp : 39|8@0+ (1,-50) [-50|205] "Celsius" Vector__XXX
 SG_ EEC_OilTemp : 47|8@0+ (1,-50) [-50|205] "Celsius" Vector__XXX
 SG_ EEC_StatorWindingTemp : 55|8@0+ (1,-50) [-50|205] "Celsius" Vector__XXX
 SG_ EEC_ConsolidatedTemp : 63|8@0+ (0.39215686275,0) [0|100.00000000125] "Percentage" Vector__XXX
 SG_ EEC_TakeoffTimeLimit : 71|10@0+ (1,-10) [-10|1013] "Seconds" Vector__XXX
 SG_ EEC_MaxPowerTimeLimit : 87|8@0+ (1,-10) [-10|245] "Seconds" Vector__XXX
 SG_ EEC_HVCurrent_Validity : 95|2@0+ (1,0) [0|3] "Enum" Vector__XXX
 SG_ EEC_HVInputVoltage_Validity : 93|2@0+ (1,0) [0|3] "Enum" Vector__XXX
 SG_ EEC_ControllerTemp_Validity : 91|2@0+ (1,0) [0|3] "Enum" Vector__XXX
 SG_ EEC_OilTemp_Validity : 89|2@0+ (1,0) [0|3] "Enum" Vector__XXX
 SG_ EEC_StatorWindingTemp_Validity : 103|2@0+ (1,0) [0|3] "Enum" Vector__XXX
 SG_ EEC_ConsolidatedTemp_Validity : 101|2@0+ (1,0) [0|3] "Enum" Vector__XXX
 SG_ EEC_TakeoffTimeLimit_Validity : 99|2@0+ (1,0) [0|3] "Enum" Vector__XXX
 SG_ EEC_MaxPowerTimeLimit_Validity : 97|2@0+ (1,0) [0|3] "Enum" Vector__XXX
 SG_ EEC_EngineFault_Alert : 111|1@0+ (1,0) [0|1] "Bool" Vector__XXX
 SG_ EEC_EngineDegraded_Alert : 110|1@0+ (1,0) [0|1] "Bool" Vector__XXX
 SG_ EEC_HighTemp_Alert : 109|1@0+ (1,0) [0|1] "Bool" Vector__XXX
 SG_ EEC_StowingAvailable : 108|1@0+ (1,0) [0|1] "Enum" Vector__XXX
 SG_ EEC_LACmdValidity : 119|2@0+ (1,0) [0|3] "Enum" Vector__XXX
 SG_ EEC_LBCmdValidity : 117|2@0+ (1,0) [0|3] "Enum" Vector__XXX
 SG_ EEC_RACmdValidity : 115|2@0+ (1,0) [0|3] "Enum" Vector__XXX
 SG_ EEC_RBCmdValidity : 113|2@0+ (1,0) [0|3] "Enum" Vector__XXX
 SG_ EEC_ContinuousRatedTorque : 135|10@0+ (1,0) [0|1023] "Nm" Vector__XXX
 SG_ EEC_EmergencyRatedTorque : 151|10@0+ (1,0) [0|1023] "Nm" Vector__XXX
 SG_ EEC_TakeoffRatedTorque : 167|10@0+ (1,0) [0|1023] "Nm" Vector__XXX
 SG_ EEC_HiTempTorqueLimit : 183|10@0+ (1,0) [0|1023] "Nm" Vector__XXX
 SG_ COM_RollingCounter : 239|8@0+ (1,0) [0|255] "NA" Vector__XXX
 SG_ COM_E2E_CRC16 : 247|16@0+ (1,0) [0|65535] "NA" Vector__XXX

BO_ 729 EEC_11_Status_Slow_MSG11: 32 EEC_11
 SG_ EEC_HVCurrent : 7|10@0+ (1,-500) [-500|523] "Amps" Vector__XXX
 SG_ EEC_HVInputVoltage : 23|10@0+ (1,0) [0|1023] "Volts" Vector__XXX
 SG_ EEC_ControllerTemp : 39|8@0+ (1,-50) [-50|205] "Celsius" Vector__XXX
 SG_ EEC_OilTemp : 47|8@0+ (1,-50) [-50|205] "Celsius" Vector__XXX
 SG_ EEC_StatorWindingTemp : 55|8@0+ (1,-50) [-50|205] "Celsius" Vector__XXX
 SG_ EEC_ConsolidatedTemp : 63|8@0+ (0.39215686275,0) [0|100.00000000125] "Percentage" Vector__XXX
 SG_ EEC_TakeoffTimeLimit : 71|10@0+ (1,-10) [-10|1013] "Seconds" Vector__XXX
 SG_ EEC_MaxPowerTimeLimit : 87|8@0+ (1,-10) [-10|245] "Seconds" Vector__XXX
 SG_ EEC_HVCurrent_Validity : 95|2@0+ (1,0) [0|3] "Enum" Vector__XXX
 SG_ EEC_HVInputVoltage_Validity : 93|2@0+ (1,0) [0|3] "Enum" Vector__XXX
 SG_ EEC_ControllerTemp_Validity : 91|2@0+ (1,0) [0|3] "Enum" Vector__XXX
 SG_ EEC_OilTemp_Validity : 89|2@0+ (1,0) [0|3] "Enum" Vector__XXX
 SG_ EEC_StatorWindingTemp_Validity : 103|2@0+ (1,0) [0|3] "Enum" Vector__XXX
 SG_ EEC_ConsolidatedTemp_Validity : 101|2@0+ (1,0) [0|3] "Enum" Vector__XXX
 SG_ EEC_TakeoffTimeLimit_Validity : 99|2@0+ (1,0) [0|3] "Enum" Vector__XXX
 SG_ EEC_MaxPowerTimeLimit_Validity : 97|2@0+ (1,0) [0|3] "Enum" Vector__XXX
 SG_ EEC_EngineFault_Alert : 111|1@0+ (1,0) [0|1] "Bool" Vector__XXX
 SG_ EEC_EngineDegraded_Alert : 110|1@0+ (1,0) [0|1] "Bool" Vector__XXX
 SG_ EEC_HighTemp_Alert : 109|1@0+ (1,0) [0|1] "Bool" Vector__XXX
 SG_ EEC_StowingAvailable : 108|1@0+ (1,0) [0|1] "Enum" Vector__XXX
 SG_ EEC_LACmdValidity : 119|2@0+ (1,0) [0|3] "Enum" Vector__XXX
 SG_ EEC_LBCmdValidity : 117|2@0+ (1,0) [0|3] "Enum" Vector__XXX
 SG_ EEC_RACmdValidity : 115|2@0+ (1,0) [0|3] "Enum" Vector__XXX
 SG_ EEC_RBCmdValidity : 113|2@0+ (1,0) [0|3] "Enum" Vector__XXX
 SG_ EEC_ContinuousRatedTorque : 135|10@0+ (1,0) [0|1023] "Nm" Vector__XXX
 SG_ EEC_EmergencyRatedTorque : 151|10@0+ (1,0) [0|1023] "Nm" Vector__XXX
 SG_ EEC_TakeoffRatedTorque : 167|10@0+ (1,0) [0|1023] "Nm" Vector__XXX
 SG_ EEC_HiTempTorqueLimit : 183|10@0+ (1,0) [0|1023] "Nm" Vector__XXX
 SG_ COM_RollingCounter : 239|8@0+ (1,0) [0|255] "NA" Vector__XXX
 SG_ COM_E2E_CRC16 : 247|16@0+ (1,0) [0|65535] "NA" Vector__XXX

BO_ 656 EEC_2_Status_Fast_MSG10: 12 EEC_2
 SG_ EEC_PropellerRPM : 7|12@0+ (1,-500) [-500|3595] "RPM" Vector__XXX
 SG_ EEC_PropellerRPM_Validity : 9|2@0+ (1,0) [0|3] "Enum" Vector__XXX
 SG_ EEC_OutputShaftTorque : 23|12@0- (0.5,0) [-1024|1023.5] "Nm" Vector__XXX
 SG_ EEC_OutputShaftTorque_Validity : 25|2@0+ (1,0) [0|3] "Enum" Vector__XXX
 SG_ EEC_StateFeedback : 39|8@0+ (1,0) [0|255] "Enum" Vector__XXX
 SG_ EEC_TPAC_HingeAngle : 47|7@0+ (1,-4) [-4|123] "Degrees" Vector__XXX
 SG_ EEC_TPAC_HingeAngle_Valid : 40|1@0+ (1,0) [0|1] "Bool" Vector__XXX
 SG_ EEC_SelectedFCC : 55|2@0+ (1,0) [0|3] "Enum" Vector__XXX
 SG_ EEC_PrimaryMCU : 53|1@0+ (1,0) [0|1] "Enum" Vector__XXX
 SG_ EEC_ProtectionActive : 52|1@0+ (1,0) [0|1] "Bool" Vector__XXX
 SG_ EEC_IBIT_Status : 51|2@0+ (1,0) [0|1] "Enum" Vector__XXX
 SG_ EEC_FCSOverrideLimitsFeedback : 49|2@0+ (1,0) [0|3] "Enum" Vector__XXX
 SG_ EEC_EngineLoss : 63|1@0+ (1,0) [0|1] "Bool" Vector__XXX
 SG_ EEC_HalfEngineLoss : 62|1@0+ (1,0) [0|1] "Bool" Vector__XXX
 SG_ EEC_TPHS_Fault : 61|1@0+ (1,0) [0|1] "Bool" Vector__XXX
 SG_ EEC_MCU_Mismatch_Fault : 60|1@0+ (1,0) [0|1] "Bool" Vector__XXX
 SG_ EEC_PhaseShort_Fault : 59|1@0+ (1,0) [0|1] "Enum" Vector__XXX
 SG_ EEC_TorqueControl_Fault : 58|1@0+ (1,0) [0|1] "Bool" Vector__XXX
 SG_ COM_RollingCounter : 79|8@0+ (1,0) [0|255] "NA" Vector__XXX
 SG_ COM_E2E_CRC16 : 87|16@0+ (1,0) [0|65535] "NA" Vector__XXX

BO_ 658 EEC_4_Status_Fast_MSG10: 12 EEC_4
 SG_ EEC_PropellerRPM : 7|12@0+ (1,-500) [-500|3595] "RPM" Vector__XXX
 SG_ EEC_PropellerRPM_Validity : 9|2@0+ (1,0) [0|3] "Enum" Vector__XXX
 SG_ EEC_OutputShaftTorque : 23|12@0- (0.5,0) [-1024|1023.5] "Nm" Vector__XXX
 SG_ EEC_OutputShaftTorque_Validity : 25|2@0+ (1,0) [0|3] "Enum" Vector__XXX
 SG_ EEC_StateFeedback : 39|8@0+ (1,0) [0|255] "Enum" Vector__XXX
 SG_ EEC_TPAC_HingeAngle : 47|7@0+ (1,-4) [-4|123] "Degrees" Vector__XXX
 SG_ EEC_TPAC_HingeAngle_Valid : 40|1@0+ (1,0) [0|1] "Bool" Vector__XXX
 SG_ EEC_SelectedFCC : 55|2@0+ (1,0) [0|3] "Enum" Vector__XXX
 SG_ EEC_PrimaryMCU : 53|1@0+ (1,0) [0|1] "Enum" Vector__XXX
 SG_ EEC_ProtectionActive : 52|1@0+ (1,0) [0|1] "Bool" Vector__XXX
 SG_ EEC_IBIT_Status : 51|2@0+ (1,0) [0|1] "Enum" Vector__XXX
 SG_ EEC_FCSOverrideLimitsFeedback : 49|2@0+ (1,0) [0|3] "Enum" Vector__XXX
 SG_ EEC_EngineLoss : 63|1@0+ (1,0) [0|1] "Bool" Vector__XXX
 SG_ EEC_HalfEngineLoss : 62|1@0+ (1,0) [0|1] "Bool" Vector__XXX
 SG_ EEC_TPHS_Fault : 61|1@0+ (1,0) [0|1] "Bool" Vector__XXX
 SG_ EEC_MCU_Mismatch_Fault : 60|1@0+ (1,0) [0|1] "Bool" Vector__XXX
 SG_ EEC_PhaseShort_Fault : 59|1@0+ (1,0) [0|1] "Enum" Vector__XXX
 SG_ EEC_TorqueControl_Fault : 58|1@0+ (1,0) [0|1] "Bool" Vector__XXX
 SG_ COM_RollingCounter : 79|8@0+ (1,0) [0|255] "NA" Vector__XXX
 SG_ COM_E2E_CRC16 : 87|16@0+ (1,0) [0|65535] "NA" Vector__XXX

BO_ 663 EEC_9_Status_Fast_MSG10: 12 EEC_9
 SG_ EEC_PropellerRPM : 7|12@0+ (1,-500) [-500|3595] "RPM" Vector__XXX
 SG_ EEC_PropellerRPM_Validity : 9|2@0+ (1,0) [0|3] "Enum" Vector__XXX
 SG_ EEC_OutputShaftTorque : 23|12@0- (0.5,0) [-1024|1023.5] "Nm" Vector__XXX
 SG_ EEC_OutputShaftTorque_Validity : 25|2@0+ (1,0) [0|3] "Enum" Vector__XXX
 SG_ EEC_StateFeedback : 39|8@0+ (1,0) [0|255] "Enum" Vector__XXX
 SG_ EEC_TPAC_HingeAngle : 47|7@0+ (1,-4) [-4|123] "Degrees" Vector__XXX
 SG_ EEC_TPAC_HingeAngle_Valid : 40|1@0+ (1,0) [0|1] "Bool" Vector__XXX
 SG_ EEC_SelectedFCC : 55|2@0+ (1,0) [0|3] "Enum" Vector__XXX
 SG_ EEC_PrimaryMCU : 53|1@0+ (1,0) [0|1] "Enum" Vector__XXX
 SG_ EEC_ProtectionActive : 52|1@0+ (1,0) [0|1] "Bool" Vector__XXX
 SG_ EEC_IBIT_Status : 51|2@0+ (1,0) [0|1] "Enum" Vector__XXX
 SG_ EEC_FCSOverrideLimitsFeedback : 49|2@0+ (1,0) [0|3] "Enum" Vector__XXX
 SG_ EEC_EngineLoss : 63|1@0+ (1,0) [0|1] "Bool" Vector__XXX
 SG_ EEC_HalfEngineLoss : 62|1@0+ (1,0) [0|1] "Bool" Vector__XXX
 SG_ EEC_TPHS_Fault : 61|1@0+ (1,0) [0|1] "Bool" Vector__XXX
 SG_ EEC_MCU_Mismatch_Fault : 60|1@0+ (1,0) [0|1] "Bool" Vector__XXX
 SG_ EEC_PhaseShort_Fault : 59|1@0+ (1,0) [0|1] "Enum" Vector__XXX
 SG_ EEC_TorqueControl_Fault : 58|1@0+ (1,0) [0|1] "Bool" Vector__XXX
 SG_ COM_RollingCounter : 79|8@0+ (1,0) [0|255] "NA" Vector__XXX
 SG_ COM_E2E_CRC16 : 87|16@0+ (1,0) [0|65535] "NA" Vector__XXX

BO_ 665 EEC_11_Status_Fast_MSG10: 12 EEC_11
 SG_ EEC_PropellerRPM : 7|12@0+ (1,-500) [-500|3595] "RPM" Vector__XXX
 SG_ EEC_PropellerRPM_Validity : 9|2@0+ (1,0) [0|3] "Enum" Vector__XXX
 SG_ EEC_OutputShaftTorque : 23|12@0- (0.5,0) [-1024|1023.5] "Nm" Vector__XXX
 SG_ EEC_OutputShaftTorque_Validity : 25|2@0+ (1,0) [0|3] "Enum" Vector__XXX
 SG_ EEC_StateFeedback : 39|8@0+ (1,0) [0|255] "Enum" Vector__XXX
 SG_ EEC_TPAC_HingeAngle : 47|7@0+ (1,-4) [-4|123] "Degrees" Vector__XXX
 SG_ EEC_TPAC_HingeAngle_Valid : 40|1@0+ (1,0) [0|1] "Bool" Vector__XXX
 SG_ EEC_SelectedFCC : 55|2@0+ (1,0) [0|3] "Enum" Vector__XXX
 SG_ EEC_PrimaryMCU : 53|1@0+ (1,0) [0|1] "Enum" Vector__XXX
 SG_ EEC_ProtectionActive : 52|1@0+ (1,0) [0|1] "Bool" Vector__XXX
 SG_ EEC_IBIT_Status : 51|2@0+ (1,0) [0|1] "Enum" Vector__XXX
 SG_ EEC_FCSOverrideLimitsFeedback : 49|2@0+ (1,0) [0|3] "Enum" Vector__XXX
 SG_ EEC_EngineLoss : 63|1@0+ (1,0) [0|1] "Bool" Vector__XXX
 SG_ EEC_HalfEngineLoss : 62|1@0+ (1,0) [0|1] "Bool" Vector__XXX
 SG_ EEC_TPHS_Fault : 61|1@0+ (1,0) [0|1] "Bool" Vector__XXX
 SG_ EEC_MCU_Mismatch_Fault : 60|1@0+ (1,0) [0|1] "Bool" Vector__XXX
 SG_ EEC_PhaseShort_Fault : 59|1@0+ (1,0) [0|1] "Enum" Vector__XXX
 SG_ EEC_TorqueControl_Fault : 58|1@0+ (1,0) [0|1] "Bool" Vector__XXX
 SG_ COM_RollingCounter : 79|8@0+ (1,0) [0|255] "NA" Vector__XXX
 SG_ COM_E2E_CRC16 : 87|16@0+ (1,0) [0|65535] "NA" Vector__XXX

BO_ 65 FCC_LA_EEC_Cmd_MSG01: 48 FCC_LA
 SG_ EEC01_TorqueCmd : 7|12@0- (0.5,0) [-1024|1023.5] "Nm" Vector__XXX
 SG_ EEC01_FCSOverrideLimitsCmd : 10|2@0+ (1,0) [0|3] "Enum" Vector__XXX
 SG_ EEC01_HVAvailabilityStatus : 8|1@0+ (1,0) [0|1] "Enum" Vector__XXX
 SG_ EEC02_TorqueCmd : 23|12@0- (0.5,0) [-1024|1023.5] "Nm" Vector__XXX
 SG_ EEC02_FCSOverrideLimitsCmd : 26|2@0+ (1,0) [0|3] "Enum" Vector__XXX
 SG_ EEC02_HVAvailabilityStatus : 24|1@0+ (1,0) [0|1] "Enum" Vector__XXX
 SG_ EEC03_TorqueCmd : 39|12@0- (0.5,0) [-1024|1023.5] "Nm" Vector__XXX
 SG_ EEC03_FCSOverrideLimitsCmd : 42|2@0+ (1,0) [0|3] "Enum" Vector__XXX
 SG_ EEC03_HVAvailabilityStatus : 40|1@0+ (1,0) [0|1] "Enum" Vector__XXX
 SG_ EEC04_TorqueCmd : 55|12@0- (0.5,0) [-1024|1023.5] "Nm" Vector__XXX
 SG_ EEC04_FCSOverrideLimitsCmd : 58|2@0+ (1,0) [0|3] "Enum" Vector__XXX
 SG_ EEC04_HVAvailabilityStatus : 56|1@0+ (1,0) [0|1] "Enum" Vector__XXX
 SG_ EEC05_TorqueCmd : 71|12@0- (0.5,0) [-1024|1023.5] "Nm" Vector__XXX
 SG_ EEC05_FCSOverrideLimitsCmd : 74|2@0+ (1,0) [0|3] "Enum" Vector__XXX
 SG_ EEC05_HVAvailabilityStatus : 72|1@0+ (1,0) [0|1] "Enum" Vector__XXX
 SG_ EEC06_TorqueCmd : 87|12@0- (0.5,0) [-1024|1023.5] "Nm" Vector__XXX
 SG_ EEC06_FCSOverrideLimitsCmd : 90|2@0+ (1,0) [0|3] "Enum" Vector__XXX
 SG_ EEC06_HVAvailabilityStatus : 88|1@0+ (1,0) [0|1] "Enum" Vector__XXX
 SG_ EEC07_TorqueCmd : 103|12@0- (0.5,0) [-1024|1023.5] "Nm" Vector__XXX
 SG_ EEC07_FCSOverrideLimitsCmd : 106|2@0+ (1,0) [0|3] "Enum" Vector__XXX
 SG_ EEC07_HVAvailabilityStatus : 104|1@0+ (1,0) [0|1] "Enum" Vector__XXX
 SG_ EEC08_TorqueCmd : 119|12@0- (0.5,0) [-1024|1023.5] "Nm" Vector__XXX
 SG_ EEC08_FCSOverrideLimitsCmd : 122|2@0+ (1,0) [0|3] "Enum" Vector__XXX
 SG_ EEC08_HVAvailabilityStatus : 120|1@0+ (1,0) [0|1] "Enum" Vector__XXX
 SG_ EEC09_TorqueCmd : 135|12@0- (0.5,0) [-1024|1023.5] "Nm" Vector__XXX
 SG_ EEC09_FCSOverrideLimitsCmd : 138|2@0+ (1,0) [0|3] "Enum" Vector__XXX
 SG_ EEC09_HVAvailabilityStatus : 136|1@0+ (1,0) [0|1] "Enum" Vector__XXX
 SG_ EEC10_TorqueCmd : 151|12@0- (0.5,0) [-1024|1023.5] "Nm" Vector__XXX
 SG_ EEC10_FCSOverrideLimitsCmd : 154|2@0+ (1,0) [0|3] "Enum" Vector__XXX
 SG_ EEC10_HVAvailabilityStatus : 152|1@0+ (1,0) [0|1] "Enum" Vector__XXX
 SG_ EEC11_TorqueCmd : 167|12@0- (0.5,0) [-1024|1023.5] "Nm" Vector__XXX
 SG_ EEC11_FCSOverrideLimitsCmd : 170|2@0+ (1,0) [0|3] "Enum" Vector__XXX
 SG_ EEC11_HVAvailabilityStatus : 168|1@0+ (1,0) [0|1] "Enum" Vector__XXX
 SG_ EEC12_TorqueCmd : 183|12@0- (0.5,0) [-1024|1023.5] "Nm" Vector__XXX
 SG_ EEC12_FCSOverrideLimitsCmd : 186|2@0+ (1,0) [0|3] "Enum" Vector__XXX
 SG_ EEC12_HVAvailabilityStatus : 184|1@0+ (1,0) [0|1] "Enum" Vector__XXX
 SG_ EEC01_StateCmd : 199|8@0+ (1,0) [0|255] "Enum" Vector__XXX
 SG_ EEC02_StateCmd : 207|8@0+ (1,0) [0|255] "Enum" Vector__XXX
 SG_ EEC03_StateCmd : 215|8@0+ (1,0) [0|255] "Enum" Vector__XXX
 SG_ EEC04_StateCmd : 223|8@0+ (1,0) [0|255] "Enum" Vector__XXX
 SG_ EEC05_StateCmd : 231|8@0+ (1,0) [0|255] "Enum" Vector__XXX
 SG_ EEC06_StateCmd : 239|8@0+ (1,0) [0|255] "Enum" Vector__XXX
 SG_ EEC07_StateCmd : 247|8@0+ (1,0) [0|255] "Enum" Vector__XXX
 SG_ EEC08_StateCmd : 255|8@0+ (1,0) [0|255] "Enum" Vector__XXX
 SG_ EEC09_StateCmd : 263|8@0+ (1,0) [0|255] "Enum" Vector__XXX
 SG_ EEC10_StateCmd : 271|8@0+ (1,0) [0|255] "Enum" Vector__XXX
 SG_ EEC11_StateCmd : 279|8@0+ (1,0) [0|255] "Enum" Vector__XXX
 SG_ EEC12_StateCmd : 287|8@0+ (1,0) [0|15] "Enum" Vector__XXX
 SG_ EEC_NotFly : 295|1@0+ (1,0) [0|1] "Bool" Vector__XXX
 SG_ EEC_FCCHealthIndication : 294|2@0+ (1,0) [0|3] "NA" Vector__XXX
 SG_ EEC_PropSpinProfileId : 359|4@0+ (1,0) [0|15] "NA" Vector__XXX
 SG_ EEC_PropSpinLruId : 355|4@0+ (1,0) [0|15] "NA" Vector__XXX
 SG_ COM_RollingCounter : 367|8@0+ (1,0) [0|255] "NA" Vector__XXX
 SG_ COM_E2E_CRC16 : 375|16@0+ (1,0) [0|65535] "NA" Vector__XXX

BO_ 1948 TPAC_2_Config_MSG30: 64 TPAC_2
 SG_ COM_Order : 7|7@0+ (1,0) [0|127] "PN Index" Vector__XXX
 SG_ COM_ConfigErrorDetected : 0|1@0+ (1,0) [0|1] "Enum" Vector__XXX
 SG_ COM_DataChar00 : 15|8@0+ (1,0) [0|255] "" Vector__XXX
 SG_ COM_DataChar01 : 23|8@0+ (1,0) [0|255] "" Vector__XXX
 SG_ COM_DataChar02 : 31|8@0+ (1,0) [0|255] "" Vector__XXX
 SG_ COM_DataChar03 : 39|8@0+ (1,0) [0|255] "" Vector__XXX
 SG_ COM_DataChar04 : 47|8@0+ (1,0) [0|255] "" Vector__XXX
 SG_ COM_DataChar05 : 55|8@0+ (1,0) [0|255] "" Vector__XXX
 SG_ COM_DataChar06 : 63|8@0+ (1,0) [0|255] "" Vector__XXX
 SG_ COM_DataChar07 : 71|8@0+ (1,0) [0|255] "" Vector__XXX
 SG_ COM_DataChar08 : 79|8@0+ (1,0) [0|255] "" Vector__XXX
 SG_ COM_DataChar09 : 87|8@0+ (1,0) [0|255] "" Vector__XXX
 SG_ COM_DataChar10 : 95|8@0+ (1,0) [0|255] "" Vector__XXX
 SG_ COM_DataChar11 : 103|8@0+ (1,0) [0|255] "" Vector__XXX
 SG_ COM_DataChar12 : 111|8@0+ (1,0) [0|255] "" Vector__XXX
 SG_ COM_DataChar13 : 119|8@0+ (1,0) [0|255] "" Vector__XXX
 SG_ COM_DataChar14 : 127|8@0+ (1,0) [0|255] "" Vector__XXX
 SG_ COM_DataChar15 : 135|8@0+ (1,0) [0|255] "" Vector__XXX
 SG_ COM_DataChar16 : 143|8@0+ (1,0) [0|255] "" Vector__XXX
 SG_ COM_DataChar17 : 151|8@0+ (1,0) [0|255] "" Vector__XXX
 SG_ COM_DataChar18 : 159|8@0+ (1,0) [0|255] "" Vector__XXX
 SG_ COM_DataChar19 : 167|8@0+ (1,0) [0|255] "" Vector__XXX
 SG_ COM_DataChar20 : 175|8@0+ (1,0) [0|255] "" Vector__XXX
 SG_ COM_DataChar21 : 183|8@0+ (1,0) [0|255] "" Vector__XXX
 SG_ COM_DataChar22 : 191|8@0+ (1,0) [0|255] "" Vector__XXX
 SG_ COM_DataChar23 : 199|8@0+ (1,0) [0|255] "" Vector__XXX
 SG_ COM_DataChar24 : 207|8@0+ (1,0) [0|255] "" Vector__XXX
 SG_ COM_DataChar25 : 215|8@0+ (1,0) [0|255] "" Vector__XXX
 SG_ COM_DataChar26 : 223|8@0+ (1,0) [0|255] "" Vector__XXX
 SG_ COM_DataChar27 : 231|8@0+ (1,0) [0|255] "" Vector__XXX
 SG_ COM_DataChar28 : 239|8@0+ (1,0) [0|255] "" Vector__XXX
 SG_ COM_DataChar29 : 247|8@0+ (1,0) [0|255] "" Vector__XXX
 SG_ COM_DataChar30 : 255|8@0+ (1,0) [0|255] "" Vector__XXX
 SG_ COM_DataChar31 : 263|8@0+ (1,0) [0|255] "" Vector__XXX
 SG_ COM_DataChar32 : 271|8@0+ (1,0) [0|255] "" Vector__XXX
 SG_ COM_DataChar33 : 279|8@0+ (1,0) [0|255] "" Vector__XXX
 SG_ COM_DataChar34 : 287|8@0+ (1,0) [0|255] "" Vector__XXX
 SG_ COM_DataChar35 : 295|8@0+ (1,0) [0|255] "" Vector__XXX
 SG_ COM_DataChar36 : 303|8@0+ (1,0) [0|255] "" Vector__XXX
 SG_ COM_DataChar37 : 311|8@0+ (1,0) [0|255] "" Vector__XXX
 SG_ COM_DataChar38 : 319|8@0+ (1,0) [0|255] "" Vector__XXX
 SG_ COM_DataChar39 : 327|8@0+ (1,0) [0|255] "" Vector__XXX
 SG_ COM_DataChar40 : 335|8@0+ (1,0) [0|255] "" Vector__XXX
 SG_ COM_DataChar41 : 343|8@0+ (1,0) [0|255] "" Vector__XXX
 SG_ COM_DataChar42 : 351|8@0+ (1,0) [0|255] "" Vector__XXX
 SG_ COM_DataChar43 : 359|8@0+ (1,0) [0|255] "" Vector__XXX
 SG_ COM_DataChar44 : 367|8@0+ (1,0) [0|255] "" Vector__XXX
 SG_ COM_DataChar45 : 375|8@0+ (1,0) [0|255] "" Vector__XXX
 SG_ COM_DataChar46 : 383|8@0+ (1,0) [0|255] "" Vector__XXX
 SG_ COM_DataChar47 : 391|8@0+ (1,0) [0|255] "" Vector__XXX
 SG_ COM_DataChar48 : 399|8@0+ (1,0) [0|255] "" Vector__XXX
 SG_ COM_DataChar49 : 407|8@0+ (1,0) [0|255] "" Vector__XXX
 SG_ COM_DataChar50 : 415|8@0+ (1,0) [0|255] "" Vector__XXX
 SG_ COM_DataChar51 : 423|8@0+ (1,0) [0|255] "" Vector__XXX
 SG_ COM_DataChar52 : 431|8@0+ (1,0) [0|255] "" Vector__XXX
 SG_ COM_DataChar53 : 439|8@0+ (1,0) [0|255] "" Vector__XXX
 SG_ COM_DataChar54 : 447|8@0+ (1,0) [0|255] "" Vector__XXX
 SG_ COM_DataChar55 : 455|8@0+ (1,0) [0|255] "" Vector__XXX
 SG_ COM_DataChar56 : 463|8@0+ (1,0) [0|255] "" Vector__XXX
 SG_ COM_DataChar57 : 471|8@0+ (1,0) [0|255] "" Vector__XXX
 SG_ COM_DataChar58 : 479|8@0+ (1,0) [0|255] "" Vector__XXX
 SG_ COM_DataChar59 : 487|8@0+ (1,0) [0|255] "" Vector__XXX
 SG_ COM_DataChar60 : 495|8@0+ (1,0) [0|255] "" Vector__XXX
 SG_ COM_E2E_CRC16 : 503|16@0+ (1,0) [0|65535] "" Vector__XXX

BO_ 1950 TPAC_4_Config_MSG30: 64 TPAC_4
 SG_ COM_Order : 7|7@0+ (1,0) [0|127] "PN Index" Vector__XXX
 SG_ COM_ConfigErrorDetected : 0|1@0+ (1,0) [0|1] "Enum" Vector__XXX
 SG_ COM_DataChar00 : 15|8@0+ (1,0) [0|255] "" Vector__XXX
 SG_ COM_DataChar01 : 23|8@0+ (1,0) [0|255] "" Vector__XXX
 SG_ COM_DataChar02 : 31|8@0+ (1,0) [0|255] "" Vector__XXX
 SG_ COM_DataChar03 : 39|8@0+ (1,0) [0|255] "" Vector__XXX
 SG_ COM_DataChar04 : 47|8@0+ (1,0) [0|255] "" Vector__XXX
 SG_ COM_DataChar05 : 55|8@0+ (1,0) [0|255] "" Vector__XXX
 SG_ COM_DataChar06 : 63|8@0+ (1,0) [0|255] "" Vector__XXX
 SG_ COM_DataChar07 : 71|8@0+ (1,0) [0|255] "" Vector__XXX
 SG_ COM_DataChar08 : 79|8@0+ (1,0) [0|255] "" Vector__XXX
 SG_ COM_DataChar09 : 87|8@0+ (1,0) [0|255] "" Vector__XXX
 SG_ COM_DataChar10 : 95|8@0+ (1,0) [0|255] "" Vector__XXX
 SG_ COM_DataChar11 : 103|8@0+ (1,0) [0|255] "" Vector__XXX
 SG_ COM_DataChar12 : 111|8@0+ (1,0) [0|255] "" Vector__XXX
 SG_ COM_DataChar13 : 119|8@0+ (1,0) [0|255] "" Vector__XXX
 SG_ COM_DataChar14 : 127|8@0+ (1,0) [0|255] "" Vector__XXX
 SG_ COM_DataChar15 : 135|8@0+ (1,0) [0|255] "" Vector__XXX
 SG_ COM_DataChar16 : 143|8@0+ (1,0) [0|255] "" Vector__XXX
 SG_ COM_DataChar17 : 151|8@0+ (1,0) [0|255] "" Vector__XXX
 SG_ COM_DataChar18 : 159|8@0+ (1,0) [0|255] "" Vector__XXX
 SG_ COM_DataChar19 : 167|8@0+ (1,0) [0|255] "" Vector__XXX
 SG_ COM_DataChar20 : 175|8@0+ (1,0) [0|255] "" Vector__XXX
 SG_ COM_DataChar21 : 183|8@0+ (1,0) [0|255] "" Vector__XXX
 SG_ COM_DataChar22 : 191|8@0+ (1,0) [0|255] "" Vector__XXX
 SG_ COM_DataChar23 : 199|8@0+ (1,0) [0|255] "" Vector__XXX
 SG_ COM_DataChar24 : 207|8@0+ (1,0) [0|255] "" Vector__XXX
 SG_ COM_DataChar25 : 215|8@0+ (1,0) [0|255] "" Vector__XXX
 SG_ COM_DataChar26 : 223|8@0+ (1,0) [0|255] "" Vector__XXX
 SG_ COM_DataChar27 : 231|8@0+ (1,0) [0|255] "" Vector__XXX
 SG_ COM_DataChar28 : 239|8@0+ (1,0) [0|255] "" Vector__XXX
 SG_ COM_DataChar29 : 247|8@0+ (1,0) [0|255] "" Vector__XXX
 SG_ COM_DataChar30 : 255|8@0+ (1,0) [0|255] "" Vector__XXX
 SG_ COM_DataChar31 : 263|8@0+ (1,0) [0|255] "" Vector__XXX
 SG_ COM_DataChar32 : 271|8@0+ (1,0) [0|255] "" Vector__XXX
 SG_ COM_DataChar33 : 279|8@0+ (1,0) [0|255] "" Vector__XXX
 SG_ COM_DataChar34 : 287|8@0+ (1,0) [0|255] "" Vector__XXX
 SG_ COM_DataChar35 : 295|8@0+ (1,0) [0|255] "" Vector__XXX
 SG_ COM_DataChar36 : 303|8@0+ (1,0) [0|255] "" Vector__XXX
 SG_ COM_DataChar37 : 311|8@0+ (1,0) [0|255] "" Vector__XXX
 SG_ COM_DataChar38 : 319|8@0+ (1,0) [0|255] "" Vector__XXX
 SG_ COM_DataChar39 : 327|8@0+ (1,0) [0|255] "" Vector__XXX
 SG_ COM_DataChar40 : 335|8@0+ (1,0) [0|255] "" Vector__XXX
 SG_ COM_DataChar41 : 343|8@0+ (1,0) [0|255] "" Vector__XXX
 SG_ COM_DataChar42 : 351|8@0+ (1,0) [0|255] "" Vector__XXX
 SG_ COM_DataChar43 : 359|8@0+ (1,0) [0|255] "" Vector__XXX
 SG_ COM_DataChar44 : 367|8@0+ (1,0) [0|255] "" Vector__XXX
 SG_ COM_DataChar45 : 375|8@0+ (1,0) [0|255] "" Vector__XXX
 SG_ COM_DataChar46 : 383|8@0+ (1,0) [0|255] "" Vector__XXX
 SG_ COM_DataChar47 : 391|8@0+ (1,0) [0|255] "" Vector__XXX
 SG_ COM_DataChar48 : 399|8@0+ (1,0) [0|255] "" Vector__XXX
 SG_ COM_DataChar49 : 407|8@0+ (1,0) [0|255] "" Vector__XXX
 SG_ COM_DataChar50 : 415|8@0+ (1,0) [0|255] "" Vector__XXX
 SG_ COM_DataChar51 : 423|8@0+ (1,0) [0|255] "" Vector__XXX
 SG_ COM_DataChar52 : 431|8@0+ (1,0) [0|255] "" Vector__XXX
 SG_ COM_DataChar53 : 439|8@0+ (1,0) [0|255] "" Vector__XXX
 SG_ COM_DataChar54 : 447|8@0+ (1,0) [0|255] "" Vector__XXX
 SG_ COM_DataChar55 : 455|8@0+ (1,0) [0|255] "" Vector__XXX
 SG_ COM_DataChar56 : 463|8@0+ (1,0) [0|255] "" Vector__XXX
 SG_ COM_DataChar57 : 471|8@0+ (1,0) [0|255] "" Vector__XXX
 SG_ COM_DataChar58 : 479|8@0+ (1,0) [0|255] "" Vector__XXX
 SG_ COM_DataChar59 : 487|8@0+ (1,0) [0|255] "" Vector__XXX
 SG_ COM_DataChar60 : 495|8@0+ (1,0) [0|255] "" Vector__XXX
 SG_ COM_E2E_CRC16 : 503|16@0+ (1,0) [0|65535] "" Vector__XXX

BO_ 1954 BMU_2C_Config_MSG30: 64 BMU_2C
 SG_ COM_Order : 7|7@0+ (1,0) [0|127] "PN Index" Vector__XXX
 SG_ COM_ConfigErrorDetected : 0|1@0+ (1,0) [0|1] "Enum" Vector__XXX
 SG_ COM_DataChar00 : 15|8@0+ (1,0) [0|255] "" Vector__XXX
 SG_ COM_DataChar01 : 23|8@0+ (1,0) [0|255] "" Vector__XXX
 SG_ COM_DataChar02 : 31|8@0+ (1,0) [0|255] "" Vector__XXX
 SG_ COM_DataChar03 : 39|8@0+ (1,0) [0|255] "" Vector__XXX
 SG_ COM_DataChar04 : 47|8@0+ (1,0) [0|255] "" Vector__XXX
 SG_ COM_DataChar05 : 55|8@0+ (1,0) [0|255] "" Vector__XXX
 SG_ COM_DataChar06 : 63|8@0+ (1,0) [0|255] "" Vector__XXX
 SG_ COM_DataChar07 : 71|8@0+ (1,0) [0|255] "" Vector__XXX
 SG_ COM_DataChar08 : 79|8@0+ (1,0) [0|255] "" Vector__XXX
 SG_ COM_DataChar09 : 87|8@0+ (1,0) [0|255] "" Vector__XXX
 SG_ COM_DataChar10 : 95|8@0+ (1,0) [0|255] "" Vector__XXX
 SG_ COM_DataChar11 : 103|8@0+ (1,0) [0|255] "" Vector__XXX
 SG_ COM_DataChar12 : 111|8@0+ (1,0) [0|255] "" Vector__XXX
 SG_ COM_DataChar13 : 119|8@0+ (1,0) [0|255] "" Vector__XXX
 SG_ COM_DataChar14 : 127|8@0+ (1,0) [0|255] "" Vector__XXX
 SG_ COM_DataChar15 : 135|8@0+ (1,0) [0|255] "" Vector__XXX
 SG_ COM_DataChar16 : 143|8@0+ (1,0) [0|255] "" Vector__XXX
 SG_ COM_DataChar17 : 151|8@0+ (1,0) [0|255] "" Vector__XXX
 SG_ COM_DataChar18 : 159|8@0+ (1,0) [0|255] "" Vector__XXX
 SG_ COM_DataChar19 : 167|8@0+ (1,0) [0|255] "" Vector__XXX
 SG_ COM_DataChar20 : 175|8@0+ (1,0) [0|255] "" Vector__XXX
 SG_ COM_DataChar21 : 183|8@0+ (1,0) [0|255] "" Vector__XXX
 SG_ COM_DataChar22 : 191|8@0+ (1,0) [0|255] "" Vector__XXX
 SG_ COM_DataChar23 : 199|8@0+ (1,0) [0|255] "" Vector__XXX
 SG_ COM_DataChar24 : 207|8@0+ (1,0) [0|255] "" Vector__XXX
 SG_ COM_DataChar25 : 215|8@0+ (1,0) [0|255] "" Vector__XXX
 SG_ COM_DataChar26 : 223|8@0+ (1,0) [0|255] "" Vector__XXX
 SG_ COM_DataChar27 : 231|8@0+ (1,0) [0|255] "" Vector__XXX
 SG_ COM_DataChar28 : 239|8@0+ (1,0) [0|255] "" Vector__XXX
 SG_ COM_DataChar29 : 247|8@0+ (1,0) [0|255] "" Vector__XXX
 SG_ COM_DataChar30 : 255|8@0+ (1,0) [0|255] "" Vector__XXX
 SG_ COM_DataChar31 : 263|8@0+ (1,0) [0|255] "" Vector__XXX
 SG_ COM_DataChar32 : 271|8@0+ (1,0) [0|255] "" Vector__XXX
 SG_ COM_DataChar33 : 279|8@0+ (1,0) [0|255] "" Vector__XXX
 SG_ COM_DataChar34 : 287|8@0+ (1,0) [0|255] "" Vector__XXX
 SG_ COM_DataChar35 : 295|8@0+ (1,0) [0|255] "" Vector__XXX
 SG_ COM_DataChar36 : 303|8@0+ (1,0) [0|255] "" Vector__XXX
 SG_ COM_DataChar37 : 311|8@0+ (1,0) [0|255] "" Vector__XXX
 SG_ COM_DataChar38 : 319|8@0+ (1,0) [0|255] "" Vector__XXX
 SG_ COM_DataChar39 : 327|8@0+ (1,0) [0|255] "" Vector__XXX
 SG_ COM_DataChar40 : 335|8@0+ (1,0) [0|255] "" Vector__XXX
 SG_ COM_DataChar41 : 343|8@0+ (1,0) [0|255] "" Vector__XXX
 SG_ COM_DataChar42 : 351|8@0+ (1,0) [0|255] "" Vector__XXX
 SG_ COM_DataChar43 : 359|8@0+ (1,0) [0|255] "" Vector__XXX
 SG_ COM_DataChar44 : 367|8@0+ (1,0) [0|255] "" Vector__XXX
 SG_ COM_DataChar45 : 375|8@0+ (1,0) [0|255] "" Vector__XXX
 SG_ COM_DataChar46 : 383|8@0+ (1,0) [0|255] "" Vector__XXX
 SG_ COM_DataChar47 : 391|8@0+ (1,0) [0|255] "" Vector__XXX
 SG_ COM_DataChar48 : 399|8@0+ (1,0) [0|255] "" Vector__XXX
 SG_ COM_DataChar49 : 407|8@0+ (1,0) [0|255] "" Vector__XXX
 SG_ COM_DataChar50 : 415|8@0+ (1,0) [0|255] "" Vector__XXX
 SG_ COM_DataChar51 : 423|8@0+ (1,0) [0|255] "" Vector__XXX
 SG_ COM_DataChar52 : 431|8@0+ (1,0) [0|255] "" Vector__XXX
 SG_ COM_DataChar53 : 439|8@0+ (1,0) [0|255] "" Vector__XXX
 SG_ COM_DataChar54 : 447|8@0+ (1,0) [0|255] "" Vector__XXX
 SG_ COM_DataChar55 : 455|8@0+ (1,0) [0|255] "" Vector__XXX
 SG_ COM_DataChar56 : 463|8@0+ (1,0) [0|255] "" Vector__XXX
 SG_ COM_DataChar57 : 471|8@0+ (1,0) [0|255] "" Vector__XXX
 SG_ COM_DataChar58 : 479|8@0+ (1,0) [0|255] "" Vector__XXX
 SG_ COM_DataChar59 : 487|8@0+ (1,0) [0|255] "" Vector__XXX
 SG_ COM_DataChar60 : 495|8@0+ (1,0) [0|255] "" Vector__XXX
 SG_ COM_E2E_CRC16 : 503|16@0+ (1,0) [0|65535] "" Vector__XXX

BO_ 1960 BMU_2E_Config_MSG30: 64 BMU_2E
 SG_ COM_Order : 7|7@0+ (1,0) [0|127] "PN Index" Vector__XXX
 SG_ COM_ConfigErrorDetected : 0|1@0+ (1,0) [0|1] "Enum" Vector__XXX
 SG_ COM_DataChar00 : 15|8@0+ (1,0) [0|255] "" Vector__XXX
 SG_ COM_DataChar01 : 23|8@0+ (1,0) [0|255] "" Vector__XXX
 SG_ COM_DataChar02 : 31|8@0+ (1,0) [0|255] "" Vector__XXX
 SG_ COM_DataChar03 : 39|8@0+ (1,0) [0|255] "" Vector__XXX
 SG_ COM_DataChar04 : 47|8@0+ (1,0) [0|255] "" Vector__XXX
 SG_ COM_DataChar05 : 55|8@0+ (1,0) [0|255] "" Vector__XXX
 SG_ COM_DataChar06 : 63|8@0+ (1,0) [0|255] "" Vector__XXX
 SG_ COM_DataChar07 : 71|8@0+ (1,0) [0|255] "" Vector__XXX
 SG_ COM_DataChar08 : 79|8@0+ (1,0) [0|255] "" Vector__XXX
 SG_ COM_DataChar09 : 87|8@0+ (1,0) [0|255] "" Vector__XXX
 SG_ COM_DataChar10 : 95|8@0+ (1,0) [0|255] "" Vector__XXX
 SG_ COM_DataChar11 : 103|8@0+ (1,0) [0|255] "" Vector__XXX
 SG_ COM_DataChar12 : 111|8@0+ (1,0) [0|255] "" Vector__XXX
 SG_ COM_DataChar13 : 119|8@0+ (1,0) [0|255] "" Vector__XXX
 SG_ COM_DataChar14 : 127|8@0+ (1,0) [0|255] "" Vector__XXX
 SG_ COM_DataChar15 : 135|8@0+ (1,0) [0|255] "" Vector__XXX
 SG_ COM_DataChar16 : 143|8@0+ (1,0) [0|255] "" Vector__XXX
 SG_ COM_DataChar17 : 151|8@0+ (1,0) [0|255] "" Vector__XXX
 SG_ COM_DataChar18 : 159|8@0+ (1,0) [0|255] "" Vector__XXX
 SG_ COM_DataChar19 : 167|8@0+ (1,0) [0|255] "" Vector__XXX
 SG_ COM_DataChar20 : 175|8@0+ (1,0) [0|255] "" Vector__XXX
 SG_ COM_DataChar21 : 183|8@0+ (1,0) [0|255] "" Vector__XXX
 SG_ COM_DataChar22 : 191|8@0+ (1,0) [0|255] "" Vector__XXX
 SG_ COM_DataChar23 : 199|8@0+ (1,0) [0|255] "" Vector__XXX
 SG_ COM_DataChar24 : 207|8@0+ (1,0) [0|255] "" Vector__XXX
 SG_ COM_DataChar25 : 215|8@0+ (1,0) [0|255] "" Vector__XXX
 SG_ COM_DataChar26 : 223|8@0+ (1,0) [0|255] "" Vector__XXX
 SG_ COM_DataChar27 : 231|8@0+ (1,0) [0|255] "" Vector__XXX
 SG_ COM_DataChar28 : 239|8@0+ (1,0) [0|255] "" Vector__XXX
 SG_ COM_DataChar29 : 247|8@0+ (1,0) [0|255] "" Vector__XXX
 SG_ COM_DataChar30 : 255|8@0+ (1,0) [0|255] "" Vector__XXX
 SG_ COM_DataChar31 : 263|8@0+ (1,0) [0|255] "" Vector__XXX
 SG_ COM_DataChar32 : 271|8@0+ (1,0) [0|255] "" Vector__XXX
 SG_ COM_DataChar33 : 279|8@0+ (1,0) [0|255] "" Vector__XXX
 SG_ COM_DataChar34 : 287|8@0+ (1,0) [0|255] "" Vector__XXX
 SG_ COM_DataChar35 : 295|8@0+ (1,0) [0|255] "" Vector__XXX
 SG_ COM_DataChar36 : 303|8@0+ (1,0) [0|255] "" Vector__XXX
 SG_ COM_DataChar37 : 311|8@0+ (1,0) [0|255] "" Vector__XXX
 SG_ COM_DataChar38 : 319|8@0+ (1,0) [0|255] "" Vector__XXX
 SG_ COM_DataChar39 : 327|8@0+ (1,0) [0|255] "" Vector__XXX
 SG_ COM_DataChar40 : 335|8@0+ (1,0) [0|255] "" Vector__XXX
 SG_ COM_DataChar41 : 343|8@0+ (1,0) [0|255] "" Vector__XXX
 SG_ COM_DataChar42 : 351|8@0+ (1,0) [0|255] "" Vector__XXX
 SG_ COM_DataChar43 : 359|8@0+ (1,0) [0|255] "" Vector__XXX
 SG_ COM_DataChar44 : 367|8@0+ (1,0) [0|255] "" Vector__XXX
 SG_ COM_DataChar45 : 375|8@0+ (1,0) [0|255] "" Vector__XXX
 SG_ COM_DataChar46 : 383|8@0+ (1,0) [0|255] "" Vector__XXX
 SG_ COM_DataChar47 : 391|8@0+ (1,0) [0|255] "" Vector__XXX
 SG_ COM_DataChar48 : 399|8@0+ (1,0) [0|255] "" Vector__XXX
 SG_ COM_DataChar49 : 407|8@0+ (1,0) [0|255] "" Vector__XXX
 SG_ COM_DataChar50 : 415|8@0+ (1,0) [0|255] "" Vector__XXX
 SG_ COM_DataChar51 : 423|8@0+ (1,0) [0|255] "" Vector__XXX
 SG_ COM_DataChar52 : 431|8@0+ (1,0) [0|255] "" Vector__XXX
 SG_ COM_DataChar53 : 439|8@0+ (1,0) [0|255] "" Vector__XXX
 SG_ COM_DataChar54 : 447|8@0+ (1,0) [0|255] "" Vector__XXX
 SG_ COM_DataChar55 : 455|8@0+ (1,0) [0|255] "" Vector__XXX
 SG_ COM_DataChar56 : 463|8@0+ (1,0) [0|255] "" Vector__XXX
 SG_ COM_DataChar57 : 471|8@0+ (1,0) [0|255] "" Vector__XXX
 SG_ COM_DataChar58 : 479|8@0+ (1,0) [0|255] "" Vector__XXX
 SG_ COM_DataChar59 : 487|8@0+ (1,0) [0|255] "" Vector__XXX
 SG_ COM_DataChar60 : 495|8@0+ (1,0) [0|255] "" Vector__XXX
 SG_ COM_E2E_CRC16 : 503|16@0+ (1,0) [0|65535] "" Vector__XXX

BO_ 1925 CSA_LOF_Config_MSG30: 64 CSA_LOF
 SG_ COM_Order : 7|7@0+ (1,0) [0|127] "PN Index" Vector__XXX
 SG_ COM_ConfigErrorDetected : 0|1@0+ (1,0) [0|1] "Enum" Vector__XXX
 SG_ COM_DataChar00 : 15|8@0+ (1,0) [0|255] "" Vector__XXX
 SG_ COM_DataChar01 : 23|8@0+ (1,0) [0|255] "" Vector__XXX
 SG_ COM_DataChar02 : 31|8@0+ (1,0) [0|255] "" Vector__XXX
 SG_ COM_DataChar03 : 39|8@0+ (1,0) [0|255] "" Vector__XXX
 SG_ COM_DataChar04 : 47|8@0+ (1,0) [0|255] "" Vector__XXX
 SG_ COM_DataChar05 : 55|8@0+ (1,0) [0|255] "" Vector__XXX
 SG_ COM_DataChar06 : 63|8@0+ (1,0) [0|255] "" Vector__XXX
 SG_ COM_DataChar07 : 71|8@0+ (1,0) [0|255] "" Vector__XXX
 SG_ COM_DataChar08 : 79|8@0+ (1,0) [0|255] "" Vector__XXX
 SG_ COM_DataChar09 : 87|8@0+ (1,0) [0|255] "" Vector__XXX
 SG_ COM_DataChar10 : 95|8@0+ (1,0) [0|255] "" Vector__XXX
 SG_ COM_DataChar11 : 103|8@0+ (1,0) [0|255] "" Vector__XXX
 SG_ COM_DataChar12 : 111|8@0+ (1,0) [0|255] "" Vector__XXX
 SG_ COM_DataChar13 : 119|8@0+ (1,0) [0|255] "" Vector__XXX
 SG_ COM_DataChar14 : 127|8@0+ (1,0) [0|255] "" Vector__XXX
 SG_ COM_DataChar15 : 135|8@0+ (1,0) [0|255] "" Vector__XXX
 SG_ COM_DataChar16 : 143|8@0+ (1,0) [0|255] "" Vector__XXX
 SG_ COM_DataChar17 : 151|8@0+ (1,0) [0|255] "" Vector__XXX
 SG_ COM_DataChar18 : 159|8@0+ (1,0) [0|255] "" Vector__XXX
 SG_ COM_DataChar19 : 167|8@0+ (1,0) [0|255] "" Vector__XXX
 SG_ COM_DataChar20 : 175|8@0+ (1,0) [0|255] "" Vector__XXX
 SG_ COM_DataChar21 : 183|8@0+ (1,0) [0|255] "" Vector__XXX
 SG_ COM_DataChar22 : 191|8@0+ (1,0) [0|255] "" Vector__XXX
 SG_ COM_DataChar23 : 199|8@0+ (1,0) [0|255] "" Vector__XXX
 SG_ COM_DataChar24 : 207|8@0+ (1,0) [0|255] "" Vector__XXX
 SG_ COM_DataChar25 : 215|8@0+ (1,0) [0|255] "" Vector__XXX
 SG_ COM_DataChar26 : 223|8@0+ (1,0) [0|255] "" Vector__XXX
 SG_ COM_DataChar27 : 231|8@0+ (1,0) [0|255] "" Vector__XXX
 SG_ COM_DataChar28 : 239|8@0+ (1,0) [0|255] "" Vector__XXX
 SG_ COM_DataChar29 : 247|8@0+ (1,0) [0|255] "" Vector__XXX
 SG_ COM_DataChar30 : 255|8@0+ (1,0) [0|255] "" Vector__XXX
 SG_ COM_DataChar31 : 263|8@0+ (1,0) [0|255] "" Vector__XXX
 SG_ COM_DataChar32 : 271|8@0+ (1,0) [0|255] "" Vector__XXX
 SG_ COM_DataChar33 : 279|8@0+ (1,0) [0|255] "" Vector__XXX
 SG_ COM_DataChar34 : 287|8@0+ (1,0) [0|255] "" Vector__XXX
 SG_ COM_DataChar35 : 295|8@0+ (1,0) [0|255] "" Vector__XXX
 SG_ COM_DataChar36 : 303|8@0+ (1,0) [0|255] "" Vector__XXX
 SG_ COM_DataChar37 : 311|8@0+ (1,0) [0|255] "" Vector__XXX
 SG_ COM_DataChar38 : 319|8@0+ (1,0) [0|255] "" Vector__XXX
 SG_ COM_DataChar39 : 327|8@0+ (1,0) [0|255] "" Vector__XXX
 SG_ COM_DataChar40 : 335|8@0+ (1,0) [0|255] "" Vector__XXX
 SG_ COM_DataChar41 : 343|8@0+ (1,0) [0|255] "" Vector__XXX
 SG_ COM_DataChar42 : 351|8@0+ (1,0) [0|255] "" Vector__XXX
 SG_ COM_DataChar43 : 359|8@0+ (1,0) [0|255] "" Vector__XXX
 SG_ COM_DataChar44 : 367|8@0+ (1,0) [0|255] "" Vector__XXX
 SG_ COM_DataChar45 : 375|8@0+ (1,0) [0|255] "" Vector__XXX
 SG_ COM_DataChar46 : 383|8@0+ (1,0) [0|255] "" Vector__XXX
 SG_ COM_DataChar47 : 391|8@0+ (1,0) [0|255] "" Vector__XXX
 SG_ COM_DataChar48 : 399|8@0+ (1,0) [0|255] "" Vector__XXX
 SG_ COM_DataChar49 : 407|8@0+ (1,0) [0|255] "" Vector__XXX
 SG_ COM_DataChar50 : 415|8@0+ (1,0) [0|255] "" Vector__XXX
 SG_ COM_DataChar51 : 423|8@0+ (1,0) [0|255] "" Vector__XXX
 SG_ COM_DataChar52 : 431|8@0+ (1,0) [0|255] "" Vector__XXX
 SG_ COM_DataChar53 : 439|8@0+ (1,0) [0|255] "" Vector__XXX
 SG_ COM_DataChar54 : 447|8@0+ (1,0) [0|255] "" Vector__XXX
 SG_ COM_DataChar55 : 455|8@0+ (1,0) [0|255] "" Vector__XXX
 SG_ COM_DataChar56 : 463|8@0+ (1,0) [0|255] "" Vector__XXX
 SG_ COM_DataChar57 : 471|8@0+ (1,0) [0|255] "" Vector__XXX
 SG_ COM_DataChar58 : 479|8@0+ (1,0) [0|255] "" Vector__XXX
 SG_ COM_DataChar59 : 487|8@0+ (1,0) [0|255] "" Vector__XXX
 SG_ COM_DataChar60 : 495|8@0+ (1,0) [0|255] "" Vector__XXX
 SG_ COM_E2E_CRC16 : 503|16@0+ (1,0) [0|65535] "" Vector__XXX

BO_ 1930 CSA_LMR_Config_MSG30: 64 CSA_LMR
 SG_ COM_Order : 7|7@0+ (1,0) [0|127] "PN Index" Vector__XXX
 SG_ COM_ConfigErrorDetected : 0|1@0+ (1,0) [0|1] "Enum" Vector__XXX
 SG_ COM_DataChar00 : 15|8@0+ (1,0) [0|255] "" Vector__XXX
 SG_ COM_DataChar01 : 23|8@0+ (1,0) [0|255] "" Vector__XXX
 SG_ COM_DataChar02 : 31|8@0+ (1,0) [0|255] "" Vector__XXX
 SG_ COM_DataChar03 : 39|8@0+ (1,0) [0|255] "" Vector__XXX
 SG_ COM_DataChar04 : 47|8@0+ (1,0) [0|255] "" Vector__XXX
 SG_ COM_DataChar05 : 55|8@0+ (1,0) [0|255] "" Vector__XXX
 SG_ COM_DataChar06 : 63|8@0+ (1,0) [0|255] "" Vector__XXX
 SG_ COM_DataChar07 : 71|8@0+ (1,0) [0|255] "" Vector__XXX
 SG_ COM_DataChar08 : 79|8@0+ (1,0) [0|255] "" Vector__XXX
 SG_ COM_DataChar09 : 87|8@0+ (1,0) [0|255] "" Vector__XXX
 SG_ COM_DataChar10 : 95|8@0+ (1,0) [0|255] "" Vector__XXX
 SG_ COM_DataChar11 : 103|8@0+ (1,0) [0|255] "" Vector__XXX
 SG_ COM_DataChar12 : 111|8@0+ (1,0) [0|255] "" Vector__XXX
 SG_ COM_DataChar13 : 119|8@0+ (1,0) [0|255] "" Vector__XXX
 SG_ COM_DataChar14 : 127|8@0+ (1,0) [0|255] "" Vector__XXX
 SG_ COM_DataChar15 : 135|8@0+ (1,0) [0|255] "" Vector__XXX
 SG_ COM_DataChar16 : 143|8@0+ (1,0) [0|255] "" Vector__XXX
 SG_ COM_DataChar17 : 151|8@0+ (1,0) [0|255] "" Vector__XXX
 SG_ COM_DataChar18 : 159|8@0+ (1,0) [0|255] "" Vector__XXX
 SG_ COM_DataChar19 : 167|8@0+ (1,0) [0|255] "" Vector__XXX
 SG_ COM_DataChar20 : 175|8@0+ (1,0) [0|255] "" Vector__XXX
 SG_ COM_DataChar21 : 183|8@0+ (1,0) [0|255] "" Vector__XXX
 SG_ COM_DataChar22 : 191|8@0+ (1,0) [0|255] "" Vector__XXX
 SG_ COM_DataChar23 : 199|8@0+ (1,0) [0|255] "" Vector__XXX
 SG_ COM_DataChar24 : 207|8@0+ (1,0) [0|255] "" Vector__XXX
 SG_ COM_DataChar25 : 215|8@0+ (1,0) [0|255] "" Vector__XXX
 SG_ COM_DataChar26 : 223|8@0+ (1,0) [0|255] "" Vector__XXX
 SG_ COM_DataChar27 : 231|8@0+ (1,0) [0|255] "" Vector__XXX
 SG_ COM_DataChar28 : 239|8@0+ (1,0) [0|255] "" Vector__XXX
 SG_ COM_DataChar29 : 247|8@0+ (1,0) [0|255] "" Vector__XXX
 SG_ COM_DataChar30 : 255|8@0+ (1,0) [0|255] "" Vector__XXX
 SG_ COM_DataChar31 : 263|8@0+ (1,0) [0|255] "" Vector__XXX
 SG_ COM_DataChar32 : 271|8@0+ (1,0) [0|255] "" Vector__XXX
 SG_ COM_DataChar33 : 279|8@0+ (1,0) [0|255] "" Vector__XXX
 SG_ COM_DataChar34 : 287|8@0+ (1,0) [0|255] "" Vector__XXX
 SG_ COM_DataChar35 : 295|8@0+ (1,0) [0|255] "" Vector__XXX
 SG_ COM_DataChar36 : 303|8@0+ (1,0) [0|255] "" Vector__XXX
 SG_ COM_DataChar37 : 311|8@0+ (1,0) [0|255] "" Vector__XXX
 SG_ COM_DataChar38 : 319|8@0+ (1,0) [0|255] "" Vector__XXX
 SG_ COM_DataChar39 : 327|8@0+ (1,0) [0|255] "" Vector__XXX
 SG_ COM_DataChar40 : 335|8@0+ (1,0) [0|255] "" Vector__XXX
 SG_ COM_DataChar41 : 343|8@0+ (1,0) [0|255] "" Vector__XXX
 SG_ COM_DataChar42 : 351|8@0+ (1,0) [0|255] "" Vector__XXX
 SG_ COM_DataChar43 : 359|8@0+ (1,0) [0|255] "" Vector__XXX
 SG_ COM_DataChar44 : 367|8@0+ (1,0) [0|255] "" Vector__XXX
 SG_ COM_DataChar45 : 375|8@0+ (1,0) [0|255] "" Vector__XXX
 SG_ COM_DataChar46 : 383|8@0+ (1,0) [0|255] "" Vector__XXX
 SG_ COM_DataChar47 : 391|8@0+ (1,0) [0|255] "" Vector__XXX
 SG_ COM_DataChar48 : 399|8@0+ (1,0) [0|255] "" Vector__XXX
 SG_ COM_DataChar49 : 407|8@0+ (1,0) [0|255] "" Vector__XXX
 SG_ COM_DataChar50 : 415|8@0+ (1,0) [0|255] "" Vector__XXX
 SG_ COM_DataChar51 : 423|8@0+ (1,0) [0|255] "" Vector__XXX
 SG_ COM_DataChar52 : 431|8@0+ (1,0) [0|255] "" Vector__XXX
 SG_ COM_DataChar53 : 439|8@0+ (1,0) [0|255] "" Vector__XXX
 SG_ COM_DataChar54 : 447|8@0+ (1,0) [0|255] "" Vector__XXX
 SG_ COM_DataChar55 : 455|8@0+ (1,0) [0|255] "" Vector__XXX
 SG_ COM_DataChar56 : 463|8@0+ (1,0) [0|255] "" Vector__XXX
 SG_ COM_DataChar57 : 471|8@0+ (1,0) [0|255] "" Vector__XXX
 SG_ COM_DataChar58 : 479|8@0+ (1,0) [0|255] "" Vector__XXX
 SG_ COM_DataChar59 : 487|8@0+ (1,0) [0|255] "" Vector__XXX
 SG_ COM_DataChar60 : 495|8@0+ (1,0) [0|255] "" Vector__XXX
 SG_ COM_E2E_CRC16 : 503|16@0+ (1,0) [0|65535] "" Vector__XXX

BO_ 1933 CSA_RMR_Config_MSG30: 64 CSA_RMR
 SG_ COM_Order : 7|7@0+ (1,0) [0|127] "PN Index" Vector__XXX
 SG_ COM_ConfigErrorDetected : 0|1@0+ (1,0) [0|1] "Enum" Vector__XXX
 SG_ COM_DataChar00 : 15|8@0+ (1,0) [0|255] "" Vector__XXX
 SG_ COM_DataChar01 : 23|8@0+ (1,0) [0|255] "" Vector__XXX
 SG_ COM_DataChar02 : 31|8@0+ (1,0) [0|255] "" Vector__XXX
 SG_ COM_DataChar03 : 39|8@0+ (1,0) [0|255] "" Vector__XXX
 SG_ COM_DataChar04 : 47|8@0+ (1,0) [0|255] "" Vector__XXX
 SG_ COM_DataChar05 : 55|8@0+ (1,0) [0|255] "" Vector__XXX
 SG_ COM_DataChar06 : 63|8@0+ (1,0) [0|255] "" Vector__XXX
 SG_ COM_DataChar07 : 71|8@0+ (1,0) [0|255] "" Vector__XXX
 SG_ COM_DataChar08 : 79|8@0+ (1,0) [0|255] "" Vector__XXX
 SG_ COM_DataChar09 : 87|8@0+ (1,0) [0|255] "" Vector__XXX
 SG_ COM_DataChar10 : 95|8@0+ (1,0) [0|255] "" Vector__XXX
 SG_ COM_DataChar11 : 103|8@0+ (1,0) [0|255] "" Vector__XXX
 SG_ COM_DataChar12 : 111|8@0+ (1,0) [0|255] "" Vector__XXX
 SG_ COM_DataChar13 : 119|8@0+ (1,0) [0|255] "" Vector__XXX
 SG_ COM_DataChar14 : 127|8@0+ (1,0) [0|255] "" Vector__XXX
 SG_ COM_DataChar15 : 135|8@0+ (1,0) [0|255] "" Vector__XXX
 SG_ COM_DataChar16 : 143|8@0+ (1,0) [0|255] "" Vector__XXX
 SG_ COM_DataChar17 : 151|8@0+ (1,0) [0|255] "" Vector__XXX
 SG_ COM_DataChar18 : 159|8@0+ (1,0) [0|255] "" Vector__XXX
 SG_ COM_DataChar19 : 167|8@0+ (1,0) [0|255] "" Vector__XXX
 SG_ COM_DataChar20 : 175|8@0+ (1,0) [0|255] "" Vector__XXX
 SG_ COM_DataChar21 : 183|8@0+ (1,0) [0|255] "" Vector__XXX
 SG_ COM_DataChar22 : 191|8@0+ (1,0) [0|255] "" Vector__XXX
 SG_ COM_DataChar23 : 199|8@0+ (1,0) [0|255] "" Vector__XXX
 SG_ COM_DataChar24 : 207|8@0+ (1,0) [0|255] "" Vector__XXX
 SG_ COM_DataChar25 : 215|8@0+ (1,0) [0|255] "" Vector__XXX
 SG_ COM_DataChar26 : 223|8@0+ (1,0) [0|255] "" Vector__XXX
 SG_ COM_DataChar27 : 231|8@0+ (1,0) [0|255] "" Vector__XXX
 SG_ COM_DataChar28 : 239|8@0+ (1,0) [0|255] "" Vector__XXX
 SG_ COM_DataChar29 : 247|8@0+ (1,0) [0|255] "" Vector__XXX
 SG_ COM_DataChar30 : 255|8@0+ (1,0) [0|255] "" Vector__XXX
 SG_ COM_DataChar31 : 263|8@0+ (1,0) [0|255] "" Vector__XXX
 SG_ COM_DataChar32 : 271|8@0+ (1,0) [0|255] "" Vector__XXX
 SG_ COM_DataChar33 : 279|8@0+ (1,0) [0|255] "" Vector__XXX
 SG_ COM_DataChar34 : 287|8@0+ (1,0) [0|255] "" Vector__XXX
 SG_ COM_DataChar35 : 295|8@0+ (1,0) [0|255] "" Vector__XXX
 SG_ COM_DataChar36 : 303|8@0+ (1,0) [0|255] "" Vector__XXX
 SG_ COM_DataChar37 : 311|8@0+ (1,0) [0|255] "" Vector__XXX
 SG_ COM_DataChar38 : 319|8@0+ (1,0) [0|255] "" Vector__XXX
 SG_ COM_DataChar39 : 327|8@0+ (1,0) [0|255] "" Vector__XXX
 SG_ COM_DataChar40 : 335|8@0+ (1,0) [0|255] "" Vector__XXX
 SG_ COM_DataChar41 : 343|8@0+ (1,0) [0|255] "" Vector__XXX
 SG_ COM_DataChar42 : 351|8@0+ (1,0) [0|255] "" Vector__XXX
 SG_ COM_DataChar43 : 359|8@0+ (1,0) [0|255] "" Vector__XXX
 SG_ COM_DataChar44 : 367|8@0+ (1,0) [0|255] "" Vector__XXX
 SG_ COM_DataChar45 : 375|8@0+ (1,0) [0|255] "" Vector__XXX
 SG_ COM_DataChar46 : 383|8@0+ (1,0) [0|255] "" Vector__XXX
 SG_ COM_DataChar47 : 391|8@0+ (1,0) [0|255] "" Vector__XXX
 SG_ COM_DataChar48 : 399|8@0+ (1,0) [0|255] "" Vector__XXX
 SG_ COM_DataChar49 : 407|8@0+ (1,0) [0|255] "" Vector__XXX
 SG_ COM_DataChar50 : 415|8@0+ (1,0) [0|255] "" Vector__XXX
 SG_ COM_DataChar51 : 423|8@0+ (1,0) [0|255] "" Vector__XXX
 SG_ COM_DataChar52 : 431|8@0+ (1,0) [0|255] "" Vector__XXX
 SG_ COM_DataChar53 : 439|8@0+ (1,0) [0|255] "" Vector__XXX
 SG_ COM_DataChar54 : 447|8@0+ (1,0) [0|255] "" Vector__XXX
 SG_ COM_DataChar55 : 455|8@0+ (1,0) [0|255] "" Vector__XXX
 SG_ COM_DataChar56 : 463|8@0+ (1,0) [0|255] "" Vector__XXX
 SG_ COM_DataChar57 : 471|8@0+ (1,0) [0|255] "" Vector__XXX
 SG_ COM_DataChar58 : 479|8@0+ (1,0) [0|255] "" Vector__XXX
 SG_ COM_DataChar59 : 487|8@0+ (1,0) [0|255] "" Vector__XXX
 SG_ COM_DataChar60 : 495|8@0+ (1,0) [0|255] "" Vector__XXX
 SG_ COM_E2E_CRC16 : 503|16@0+ (1,0) [0|65535] "" Vector__XXX

BO_ 1936 EEC_2_Config_MSG30: 64 EEC_2
 SG_ COM_Order : 7|7@0+ (1,0) [0|127] "PN Index" Vector__XXX
 SG_ COM_ConfigErrorDetected : 0|1@0+ (1,0) [0|1] "Enum" Vector__XXX
 SG_ COM_DataChar00 : 15|8@0+ (1,0) [0|255] "" Vector__XXX
 SG_ COM_DataChar01 : 23|8@0+ (1,0) [0|255] "" Vector__XXX
 SG_ COM_DataChar02 : 31|8@0+ (1,0) [0|255] "" Vector__XXX
 SG_ COM_DataChar03 : 39|8@0+ (1,0) [0|255] "" Vector__XXX
 SG_ COM_DataChar04 : 47|8@0+ (1,0) [0|255] "" Vector__XXX
 SG_ COM_DataChar05 : 55|8@0+ (1,0) [0|255] "" Vector__XXX
 SG_ COM_DataChar06 : 63|8@0+ (1,0) [0|255] "" Vector__XXX
 SG_ COM_DataChar07 : 71|8@0+ (1,0) [0|255] "" Vector__XXX
 SG_ COM_DataChar08 : 79|8@0+ (1,0) [0|255] "" Vector__XXX
 SG_ COM_DataChar09 : 87|8@0+ (1,0) [0|255] "" Vector__XXX
 SG_ COM_DataChar10 : 95|8@0+ (1,0) [0|255] "" Vector__XXX
 SG_ COM_DataChar11 : 103|8@0+ (1,0) [0|255] "" Vector__XXX
 SG_ COM_DataChar12 : 111|8@0+ (1,0) [0|255] "" Vector__XXX
 SG_ COM_DataChar13 : 119|8@0+ (1,0) [0|255] "" Vector__XXX
 SG_ COM_DataChar14 : 127|8@0+ (1,0) [0|255] "" Vector__XXX
 SG_ COM_DataChar15 : 135|8@0+ (1,0) [0|255] "" Vector__XXX
 SG_ COM_DataChar16 : 143|8@0+ (1,0) [0|255] "" Vector__XXX
 SG_ COM_DataChar17 : 151|8@0+ (1,0) [0|255] "" Vector__XXX
 SG_ COM_DataChar18 : 159|8@0+ (1,0) [0|255] "" Vector__XXX
 SG_ COM_DataChar19 : 167|8@0+ (1,0) [0|255] "" Vector__XXX
 SG_ COM_DataChar20 : 175|8@0+ (1,0) [0|255] "" Vector__XXX
 SG_ COM_DataChar21 : 183|8@0+ (1,0) [0|255] "" Vector__XXX
 SG_ COM_DataChar22 : 191|8@0+ (1,0) [0|255] "" Vector__XXX
 SG_ COM_DataChar23 : 199|8@0+ (1,0) [0|255] "" Vector__XXX
 SG_ COM_DataChar24 : 207|8@0+ (1,0) [0|255] "" Vector__XXX
 SG_ COM_DataChar25 : 215|8@0+ (1,0) [0|255] "" Vector__XXX
 SG_ COM_DataChar26 : 223|8@0+ (1,0) [0|255] "" Vector__XXX
 SG_ COM_DataChar27 : 231|8@0+ (1,0) [0|255] "" Vector__XXX
 SG_ COM_DataChar28 : 239|8@0+ (1,0) [0|255] "" Vector__XXX
 SG_ COM_DataChar29 : 247|8@0+ (1,0) [0|255] "" Vector__XXX
 SG_ COM_DataChar30 : 255|8@0+ (1,0) [0|255] "" Vector__XXX
 SG_ COM_DataChar31 : 263|8@0+ (1,0) [0|255] "" Vector__XXX
 SG_ COM_DataChar32 : 271|8@0+ (1,0) [0|255] "" Vector__XXX
 SG_ COM_DataChar33 : 279|8@0+ (1,0) [0|255] "" Vector__XXX
 SG_ COM_DataChar34 : 287|8@0+ (1,0) [0|255] "" Vector__XXX
 SG_ COM_DataChar35 : 295|8@0+ (1,0) [0|255] "" Vector__XXX
 SG_ COM_DataChar36 : 303|8@0+ (1,0) [0|255] "" Vector__XXX
 SG_ COM_DataChar37 : 311|8@0+ (1,0) [0|255] "" Vector__XXX
 SG_ COM_DataChar38 : 319|8@0+ (1,0) [0|255] "" Vector__XXX
 SG_ COM_DataChar39 : 327|8@0+ (1,0) [0|255] "" Vector__XXX
 SG_ COM_DataChar40 : 335|8@0+ (1,0) [0|255] "" Vector__XXX
 SG_ COM_DataChar41 : 343|8@0+ (1,0) [0|255] "" Vector__XXX
 SG_ COM_DataChar42 : 351|8@0+ (1,0) [0|255] "" Vector__XXX
 SG_ COM_DataChar43 : 359|8@0+ (1,0) [0|255] "" Vector__XXX
 SG_ COM_DataChar44 : 367|8@0+ (1,0) [0|255] "" Vector__XXX
 SG_ COM_DataChar45 : 375|8@0+ (1,0) [0|255] "" Vector__XXX
 SG_ COM_DataChar46 : 383|8@0+ (1,0) [0|255] "" Vector__XXX
 SG_ COM_DataChar47 : 391|8@0+ (1,0) [0|255] "" Vector__XXX
 SG_ COM_DataChar48 : 399|8@0+ (1,0) [0|255] "" Vector__XXX
 SG_ COM_DataChar49 : 407|8@0+ (1,0) [0|255] "" Vector__XXX
 SG_ COM_DataChar50 : 415|8@0+ (1,0) [0|255] "" Vector__XXX
 SG_ COM_DataChar51 : 423|8@0+ (1,0) [0|255] "" Vector__XXX
 SG_ COM_DataChar52 : 431|8@0+ (1,0) [0|255] "" Vector__XXX
 SG_ COM_DataChar53 : 439|8@0+ (1,0) [0|255] "" Vector__XXX
 SG_ COM_DataChar54 : 447|8@0+ (1,0) [0|255] "" Vector__XXX
 SG_ COM_DataChar55 : 455|8@0+ (1,0) [0|255] "" Vector__XXX
 SG_ COM_DataChar56 : 463|8@0+ (1,0) [0|255] "" Vector__XXX
 SG_ COM_DataChar57 : 471|8@0+ (1,0) [0|255] "" Vector__XXX
 SG_ COM_DataChar58 : 479|8@0+ (1,0) [0|255] "" Vector__XXX
 SG_ COM_DataChar59 : 487|8@0+ (1,0) [0|255] "" Vector__XXX
 SG_ COM_DataChar60 : 495|8@0+ (1,0) [0|255] "" Vector__XXX
 SG_ COM_E2E_CRC16 : 503|16@0+ (1,0) [0|65535] "" Vector__XXX

BO_ 1938 EEC_4_Config_MSG30: 64 EEC_4
 SG_ COM_Order : 7|7@0+ (1,0) [0|127] "PN Index" Vector__XXX
 SG_ COM_ConfigErrorDetected : 0|1@0+ (1,0) [0|1] "Enum" Vector__XXX
 SG_ COM_DataChar00 : 15|8@0+ (1,0) [0|255] "" Vector__XXX
 SG_ COM_DataChar01 : 23|8@0+ (1,0) [0|255] "" Vector__XXX
 SG_ COM_DataChar02 : 31|8@0+ (1,0) [0|255] "" Vector__XXX
 SG_ COM_DataChar03 : 39|8@0+ (1,0) [0|255] "" Vector__XXX
 SG_ COM_DataChar04 : 47|8@0+ (1,0) [0|255] "" Vector__XXX
 SG_ COM_DataChar05 : 55|8@0+ (1,0) [0|255] "" Vector__XXX
 SG_ COM_DataChar06 : 63|8@0+ (1,0) [0|255] "" Vector__XXX
 SG_ COM_DataChar07 : 71|8@0+ (1,0) [0|255] "" Vector__XXX
 SG_ COM_DataChar08 : 79|8@0+ (1,0) [0|255] "" Vector__XXX
 SG_ COM_DataChar09 : 87|8@0+ (1,0) [0|255] "" Vector__XXX
 SG_ COM_DataChar10 : 95|8@0+ (1,0) [0|255] "" Vector__XXX
 SG_ COM_DataChar11 : 103|8@0+ (1,0) [0|255] "" Vector__XXX
 SG_ COM_DataChar12 : 111|8@0+ (1,0) [0|255] "" Vector__XXX
 SG_ COM_DataChar13 : 119|8@0+ (1,0) [0|255] "" Vector__XXX
 SG_ COM_DataChar14 : 127|8@0+ (1,0) [0|255] "" Vector__XXX
 SG_ COM_DataChar15 : 135|8@0+ (1,0) [0|255] "" Vector__XXX
 SG_ COM_DataChar16 : 143|8@0+ (1,0) [0|255] "" Vector__XXX
 SG_ COM_DataChar17 : 151|8@0+ (1,0) [0|255] "" Vector__XXX
 SG_ COM_DataChar18 : 159|8@0+ (1,0) [0|255] "" Vector__XXX
 SG_ COM_DataChar19 : 167|8@0+ (1,0) [0|255] "" Vector__XXX
 SG_ COM_DataChar20 : 175|8@0+ (1,0) [0|255] "" Vector__XXX
 SG_ COM_DataChar21 : 183|8@0+ (1,0) [0|255] "" Vector__XXX
 SG_ COM_DataChar22 : 191|8@0+ (1,0) [0|255] "" Vector__XXX
 SG_ COM_DataChar23 : 199|8@0+ (1,0) [0|255] "" Vector__XXX
 SG_ COM_DataChar24 : 207|8@0+ (1,0) [0|255] "" Vector__XXX
 SG_ COM_DataChar25 : 215|8@0+ (1,0) [0|255] "" Vector__XXX
 SG_ COM_DataChar26 : 223|8@0+ (1,0) [0|255] "" Vector__XXX
 SG_ COM_DataChar27 : 231|8@0+ (1,0) [0|255] "" Vector__XXX
 SG_ COM_DataChar28 : 239|8@0+ (1,0) [0|255] "" Vector__XXX
 SG_ COM_DataChar29 : 247|8@0+ (1,0) [0|255] "" Vector__XXX
 SG_ COM_DataChar30 : 255|8@0+ (1,0) [0|255] "" Vector__XXX
 SG_ COM_DataChar31 : 263|8@0+ (1,0) [0|255] "" Vector__XXX
 SG_ COM_DataChar32 : 271|8@0+ (1,0) [0|255] "" Vector__XXX
 SG_ COM_DataChar33 : 279|8@0+ (1,0) [0|255] "" Vector__XXX
 SG_ COM_DataChar34 : 287|8@0+ (1,0) [0|255] "" Vector__XXX
 SG_ COM_DataChar35 : 295|8@0+ (1,0) [0|255] "" Vector__XXX
 SG_ COM_DataChar36 : 303|8@0+ (1,0) [0|255] "" Vector__XXX
 SG_ COM_DataChar37 : 311|8@0+ (1,0) [0|255] "" Vector__XXX
 SG_ COM_DataChar38 : 319|8@0+ (1,0) [0|255] "" Vector__XXX
 SG_ COM_DataChar39 : 327|8@0+ (1,0) [0|255] "" Vector__XXX
 SG_ COM_DataChar40 : 335|8@0+ (1,0) [0|255] "" Vector__XXX
 SG_ COM_DataChar41 : 343|8@0+ (1,0) [0|255] "" Vector__XXX
 SG_ COM_DataChar42 : 351|8@0+ (1,0) [0|255] "" Vector__XXX
 SG_ COM_DataChar43 : 359|8@0+ (1,0) [0|255] "" Vector__XXX
 SG_ COM_DataChar44 : 367|8@0+ (1,0) [0|255] "" Vector__XXX
 SG_ COM_DataChar45 : 375|8@0+ (1,0) [0|255] "" Vector__XXX
 SG_ COM_DataChar46 : 383|8@0+ (1,0) [0|255] "" Vector__XXX
 SG_ COM_DataChar47 : 391|8@0+ (1,0) [0|255] "" Vector__XXX
 SG_ COM_DataChar48 : 399|8@0+ (1,0) [0|255] "" Vector__XXX
 SG_ COM_DataChar49 : 407|8@0+ (1,0) [0|255] "" Vector__XXX
 SG_ COM_DataChar50 : 415|8@0+ (1,0) [0|255] "" Vector__XXX
 SG_ COM_DataChar51 : 423|8@0+ (1,0) [0|255] "" Vector__XXX
 SG_ COM_DataChar52 : 431|8@0+ (1,0) [0|255] "" Vector__XXX
 SG_ COM_DataChar53 : 439|8@0+ (1,0) [0|255] "" Vector__XXX
 SG_ COM_DataChar54 : 447|8@0+ (1,0) [0|255] "" Vector__XXX
 SG_ COM_DataChar55 : 455|8@0+ (1,0) [0|255] "" Vector__XXX
 SG_ COM_DataChar56 : 463|8@0+ (1,0) [0|255] "" Vector__XXX
 SG_ COM_DataChar57 : 471|8@0+ (1,0) [0|255] "" Vector__XXX
 SG_ COM_DataChar58 : 479|8@0+ (1,0) [0|255] "" Vector__XXX
 SG_ COM_DataChar59 : 487|8@0+ (1,0) [0|255] "" Vector__XXX
 SG_ COM_DataChar60 : 495|8@0+ (1,0) [0|255] "" Vector__XXX
 SG_ COM_E2E_CRC16 : 503|16@0+ (1,0) [0|65535] "" Vector__XXX

BO_ 1943 EEC_9_Config_MSG30: 64 EEC_9
 SG_ COM_Order : 7|7@0+ (1,0) [0|127] "PN Index" Vector__XXX
 SG_ COM_ConfigErrorDetected : 0|1@0+ (1,0) [0|1] "Enum" Vector__XXX
 SG_ COM_DataChar00 : 15|8@0+ (1,0) [0|255] "" Vector__XXX
 SG_ COM_DataChar01 : 23|8@0+ (1,0) [0|255] "" Vector__XXX
 SG_ COM_DataChar02 : 31|8@0+ (1,0) [0|255] "" Vector__XXX
 SG_ COM_DataChar03 : 39|8@0+ (1,0) [0|255] "" Vector__XXX
 SG_ COM_DataChar04 : 47|8@0+ (1,0) [0|255] "" Vector__XXX
 SG_ COM_DataChar05 : 55|8@0+ (1,0) [0|255] "" Vector__XXX
 SG_ COM_DataChar06 : 63|8@0+ (1,0) [0|255] "" Vector__XXX
 SG_ COM_DataChar07 : 71|8@0+ (1,0) [0|255] "" Vector__XXX
 SG_ COM_DataChar08 : 79|8@0+ (1,0) [0|255] "" Vector__XXX
 SG_ COM_DataChar09 : 87|8@0+ (1,0) [0|255] "" Vector__XXX
 SG_ COM_DataChar10 : 95|8@0+ (1,0) [0|255] "" Vector__XXX
 SG_ COM_DataChar11 : 103|8@0+ (1,0) [0|255] "" Vector__XXX
 SG_ COM_DataChar12 : 111|8@0+ (1,0) [0|255] "" Vector__XXX
 SG_ COM_DataChar13 : 119|8@0+ (1,0) [0|255] "" Vector__XXX
 SG_ COM_DataChar14 : 127|8@0+ (1,0) [0|255] "" Vector__XXX
 SG_ COM_DataChar15 : 135|8@0+ (1,0) [0|255] "" Vector__XXX
 SG_ COM_DataChar16 : 143|8@0+ (1,0) [0|255] "" Vector__XXX
 SG_ COM_DataChar17 : 151|8@0+ (1,0) [0|255] "" Vector__XXX
 SG_ COM_DataChar18 : 159|8@0+ (1,0) [0|255] "" Vector__XXX
 SG_ COM_DataChar19 : 167|8@0+ (1,0) [0|255] "" Vector__XXX
 SG_ COM_DataChar20 : 175|8@0+ (1,0) [0|255] "" Vector__XXX
 SG_ COM_DataChar21 : 183|8@0+ (1,0) [0|255] "" Vector__XXX
 SG_ COM_DataChar22 : 191|8@0+ (1,0) [0|255] "" Vector__XXX
 SG_ COM_DataChar23 : 199|8@0+ (1,0) [0|255] "" Vector__XXX
 SG_ COM_DataChar24 : 207|8@0+ (1,0) [0|255] "" Vector__XXX
 SG_ COM_DataChar25 : 215|8@0+ (1,0) [0|255] "" Vector__XXX
 SG_ COM_DataChar26 : 223|8@0+ (1,0) [0|255] "" Vector__XXX
 SG_ COM_DataChar27 : 231|8@0+ (1,0) [0|255] "" Vector__XXX
 SG_ COM_DataChar28 : 239|8@0+ (1,0) [0|255] "" Vector__XXX
 SG_ COM_DataChar29 : 247|8@0+ (1,0) [0|255] "" Vector__XXX
 SG_ COM_DataChar30 : 255|8@0+ (1,0) [0|255] "" Vector__XXX
 SG_ COM_DataChar31 : 263|8@0+ (1,0) [0|255] "" Vector__XXX
 SG_ COM_DataChar32 : 271|8@0+ (1,0) [0|255] "" Vector__XXX
 SG_ COM_DataChar33 : 279|8@0+ (1,0) [0|255] "" Vector__XXX
 SG_ COM_DataChar34 : 287|8@0+ (1,0) [0|255] "" Vector__XXX
 SG_ COM_DataChar35 : 295|8@0+ (1,0) [0|255] "" Vector__XXX
 SG_ COM_DataChar36 : 303|8@0+ (1,0) [0|255] "" Vector__XXX
 SG_ COM_DataChar37 : 311|8@0+ (1,0) [0|255] "" Vector__XXX
 SG_ COM_DataChar38 : 319|8@0+ (1,0) [0|255] "" Vector__XXX
 SG_ COM_DataChar39 : 327|8@0+ (1,0) [0|255] "" Vector__XXX
 SG_ COM_DataChar40 : 335|8@0+ (1,0) [0|255] "" Vector__XXX
 SG_ COM_DataChar41 : 343|8@0+ (1,0) [0|255] "" Vector__XXX
 SG_ COM_DataChar42 : 351|8@0+ (1,0) [0|255] "" Vector__XXX
 SG_ COM_DataChar43 : 359|8@0+ (1,0) [0|255] "" Vector__XXX
 SG_ COM_DataChar44 : 367|8@0+ (1,0) [0|255] "" Vector__XXX
 SG_ COM_DataChar45 : 375|8@0+ (1,0) [0|255] "" Vector__XXX
 SG_ COM_DataChar46 : 383|8@0+ (1,0) [0|255] "" Vector__XXX
 SG_ COM_DataChar47 : 391|8@0+ (1,0) [0|255] "" Vector__XXX
 SG_ COM_DataChar48 : 399|8@0+ (1,0) [0|255] "" Vector__XXX
 SG_ COM_DataChar49 : 407|8@0+ (1,0) [0|255] "" Vector__XXX
 SG_ COM_DataChar50 : 415|8@0+ (1,0) [0|255] "" Vector__XXX
 SG_ COM_DataChar51 : 423|8@0+ (1,0) [0|255] "" Vector__XXX
 SG_ COM_DataChar52 : 431|8@0+ (1,0) [0|255] "" Vector__XXX
 SG_ COM_DataChar53 : 439|8@0+ (1,0) [0|255] "" Vector__XXX
 SG_ COM_DataChar54 : 447|8@0+ (1,0) [0|255] "" Vector__XXX
 SG_ COM_DataChar55 : 455|8@0+ (1,0) [0|255] "" Vector__XXX
 SG_ COM_DataChar56 : 463|8@0+ (1,0) [0|255] "" Vector__XXX
 SG_ COM_DataChar57 : 471|8@0+ (1,0) [0|255] "" Vector__XXX
 SG_ COM_DataChar58 : 479|8@0+ (1,0) [0|255] "" Vector__XXX
 SG_ COM_DataChar59 : 487|8@0+ (1,0) [0|255] "" Vector__XXX
 SG_ COM_DataChar60 : 495|8@0+ (1,0) [0|255] "" Vector__XXX
 SG_ COM_E2E_CRC16 : 503|16@0+ (1,0) [0|65535] "" Vector__XXX

BO_ 1945 EEC_11_Config_MSG30: 64 EEC_11
 SG_ COM_Order : 7|7@0+ (1,0) [0|127] "PN Index" Vector__XXX
 SG_ COM_ConfigErrorDetected : 0|1@0+ (1,0) [0|1] "Enum" Vector__XXX
 SG_ COM_DataChar00 : 15|8@0+ (1,0) [0|255] "" Vector__XXX
 SG_ COM_DataChar01 : 23|8@0+ (1,0) [0|255] "" Vector__XXX
 SG_ COM_DataChar02 : 31|8@0+ (1,0) [0|255] "" Vector__XXX
 SG_ COM_DataChar03 : 39|8@0+ (1,0) [0|255] "" Vector__XXX
 SG_ COM_DataChar04 : 47|8@0+ (1,0) [0|255] "" Vector__XXX
 SG_ COM_DataChar05 : 55|8@0+ (1,0) [0|255] "" Vector__XXX
 SG_ COM_DataChar06 : 63|8@0+ (1,0) [0|255] "" Vector__XXX
 SG_ COM_DataChar07 : 71|8@0+ (1,0) [0|255] "" Vector__XXX
 SG_ COM_DataChar08 : 79|8@0+ (1,0) [0|255] "" Vector__XXX
 SG_ COM_DataChar09 : 87|8@0+ (1,0) [0|255] "" Vector__XXX
 SG_ COM_DataChar10 : 95|8@0+ (1,0) [0|255] "" Vector__XXX
 SG_ COM_DataChar11 : 103|8@0+ (1,0) [0|255] "" Vector__XXX
 SG_ COM_DataChar12 : 111|8@0+ (1,0) [0|255] "" Vector__XXX
 SG_ COM_DataChar13 : 119|8@0+ (1,0) [0|255] "" Vector__XXX
 SG_ COM_DataChar14 : 127|8@0+ (1,0) [0|255] "" Vector__XXX
 SG_ COM_DataChar15 : 135|8@0+ (1,0) [0|255] "" Vector__XXX
 SG_ COM_DataChar16 : 143|8@0+ (1,0) [0|255] "" Vector__XXX
 SG_ COM_DataChar17 : 151|8@0+ (1,0) [0|255] "" Vector__XXX
 SG_ COM_DataChar18 : 159|8@0+ (1,0) [0|255] "" Vector__XXX
 SG_ COM_DataChar19 : 167|8@0+ (1,0) [0|255] "" Vector__XXX
 SG_ COM_DataChar20 : 175|8@0+ (1,0) [0|255] "" Vector__XXX
 SG_ COM_DataChar21 : 183|8@0+ (1,0) [0|255] "" Vector__XXX
 SG_ COM_DataChar22 : 191|8@0+ (1,0) [0|255] "" Vector__XXX
 SG_ COM_DataChar23 : 199|8@0+ (1,0) [0|255] "" Vector__XXX
 SG_ COM_DataChar24 : 207|8@0+ (1,0) [0|255] "" Vector__XXX
 SG_ COM_DataChar25 : 215|8@0+ (1,0) [0|255] "" Vector__XXX
 SG_ COM_DataChar26 : 223|8@0+ (1,0) [0|255] "" Vector__XXX
 SG_ COM_DataChar27 : 231|8@0+ (1,0) [0|255] "" Vector__XXX
 SG_ COM_DataChar28 : 239|8@0+ (1,0) [0|255] "" Vector__XXX
 SG_ COM_DataChar29 : 247|8@0+ (1,0) [0|255] "" Vector__XXX
 SG_ COM_DataChar30 : 255|8@0+ (1,0) [0|255] "" Vector__XXX
 SG_ COM_DataChar31 : 263|8@0+ (1,0) [0|255] "" Vector__XXX
 SG_ COM_DataChar32 : 271|8@0+ (1,0) [0|255] "" Vector__XXX
 SG_ COM_DataChar33 : 279|8@0+ (1,0) [0|255] "" Vector__XXX
 SG_ COM_DataChar34 : 287|8@0+ (1,0) [0|255] "" Vector__XXX
 SG_ COM_DataChar35 : 295|8@0+ (1,0) [0|255] "" Vector__XXX
 SG_ COM_DataChar36 : 303|8@0+ (1,0) [0|255] "" Vector__XXX
 SG_ COM_DataChar37 : 311|8@0+ (1,0) [0|255] "" Vector__XXX
 SG_ COM_DataChar38 : 319|8@0+ (1,0) [0|255] "" Vector__XXX
 SG_ COM_DataChar39 : 327|8@0+ (1,0) [0|255] "" Vector__XXX
 SG_ COM_DataChar40 : 335|8@0+ (1,0) [0|255] "" Vector__XXX
 SG_ COM_DataChar41 : 343|8@0+ (1,0) [0|255] "" Vector__XXX
 SG_ COM_DataChar42 : 351|8@0+ (1,0) [0|255] "" Vector__XXX
 SG_ COM_DataChar43 : 359|8@0+ (1,0) [0|255] "" Vector__XXX
 SG_ COM_DataChar44 : 367|8@0+ (1,0) [0|255] "" Vector__XXX
 SG_ COM_DataChar45 : 375|8@0+ (1,0) [0|255] "" Vector__XXX
 SG_ COM_DataChar46 : 383|8@0+ (1,0) [0|255] "" Vector__XXX
 SG_ COM_DataChar47 : 391|8@0+ (1,0) [0|255] "" Vector__XXX
 SG_ COM_DataChar48 : 399|8@0+ (1,0) [0|255] "" Vector__XXX
 SG_ COM_DataChar49 : 407|8@0+ (1,0) [0|255] "" Vector__XXX
 SG_ COM_DataChar50 : 415|8@0+ (1,0) [0|255] "" Vector__XXX
 SG_ COM_DataChar51 : 423|8@0+ (1,0) [0|255] "" Vector__XXX
 SG_ COM_DataChar52 : 431|8@0+ (1,0) [0|255] "" Vector__XXX
 SG_ COM_DataChar53 : 439|8@0+ (1,0) [0|255] "" Vector__XXX
 SG_ COM_DataChar54 : 447|8@0+ (1,0) [0|255] "" Vector__XXX
 SG_ COM_DataChar55 : 455|8@0+ (1,0) [0|255] "" Vector__XXX
 SG_ COM_DataChar56 : 463|8@0+ (1,0) [0|255] "" Vector__XXX
 SG_ COM_DataChar57 : 471|8@0+ (1,0) [0|255] "" Vector__XXX
 SG_ COM_DataChar58 : 479|8@0+ (1,0) [0|255] "" Vector__XXX
 SG_ COM_DataChar59 : 487|8@0+ (1,0) [0|255] "" Vector__XXX
 SG_ COM_DataChar60 : 495|8@0+ (1,0) [0|255] "" Vector__XXX
 SG_ COM_E2E_CRC16 : 503|16@0+ (1,0) [0|65535] "" Vector__XXX

BO_ 965 CSA_LOF_Status_MSG15: 12 CSA_LOF
 SG_ CSA_LACmdValidity : 7|3@0+ (1,0) [0|7] "Enum" Vector__XXX
 SG_ CSA_LBCmdValidity : 4|3@0+ (1,0) [0|7] "Enum" Vector__XXX
 SG_ CSA_SelectedFCC : 1|2@0+ (1,0) [0|3] "Enum" Vector__XXX
 SG_ CSA_RACmdValidity : 15|3@0+ (1,0) [0|7] "Enum" Vector__XXX
 SG_ CSA_RBCmdValidity : 12|3@0+ (1,0) [0|7] "Enum" Vector__XXX
 SG_ CSA_OutputSplinePosition : 23|16@0- (0.002,0) [-65.536|65.534] "Degrees" Vector__XXX
 SG_ CSA_TorqueEstimate : 39|8@0- (5,0) [-640|635] "in-lbf" Vector__XXX
 SG_ CSA_ActiveMode : 47|3@0+ (1,0) [0|7] "Enum" Vector__XXX
 SG_ CSA_LVInputBelowNorm_Monitor : 43|1@0+ (1,0) [0|1] "Enum" Vector__XXX
 SG_ CSA_SBIT_Monitor : 55|1@0+ (1,0) [0|1] "Enum" Vector__XXX
 SG_ CSA_Damping_Monitor : 54|1@0+ (1,0) [0|1] "Enum" Vector__XXX
 SG_ CSA_PBIT_Monitor : 53|1@0+ (1,0) [0|1] "Enum" Vector__XXX
 SG_ CSA_LVInputBelow18V_Monitor : 52|1@0+ (1,0) [0|1] "Enum" Vector__XXX
 SG_ CSA_EMACInternalError_Monitor : 51|1@0+ (1,0) [0|1] "Enum" Vector__XXX
 SG_ CSA_EMAControlError_Monitor : 50|1@0+ (1,0) [0|1] "Enum" Vector__XXX
 SG_ CSA_CmdResponse_Monitor : 49|1@0+ (1,0) [0|1] "Enum" Vector__XXX
 SG_ CSA_OutputPosition_Monitor : 48|1@0+ (1,0) [0|1] "Enum" Vector__XXX
 SG_ CSA_TorqueOutputLimited : 63|1@0+ (1,0) [0|1] "Enum" Vector__XXX
 SG_ CSA_SBIT_Monitor_Exec : 56|1@0+ (1,0) [0|1] "Enum" Vector__XXX
 SG_ CSA_PositionBacklash : 71|8@0- (0.025,0) [-3.2|3.175] "deg" Vector__XXX
 SG_ COM_RollingCounter : 79|8@0+ (1,0) [0|255] "NA" Vector__XXX
 SG_ COM_E2E_CRC16 : 87|16@0+ (1,0) [0|65535] "NA" Vector__XXX

BO_ 970 CSA_LMR_Status_MSG15: 12 CSA_LMR
 SG_ CSA_LACmdValidity : 7|3@0+ (1,0) [0|7] "Enum" Vector__XXX
 SG_ CSA_LBCmdValidity : 4|3@0+ (1,0) [0|7] "Enum" Vector__XXX
 SG_ CSA_SelectedFCC : 1|2@0+ (1,0) [0|3] "Enum" Vector__XXX
 SG_ CSA_RACmdValidity : 15|3@0+ (1,0) [0|7] "Enum" Vector__XXX
 SG_ CSA_RBCmdValidity : 12|3@0+ (1,0) [0|7] "Enum" Vector__XXX
 SG_ CSA_OutputSplinePosition : 23|16@0- (0.002,0) [-65.536|65.534] "Degrees" Vector__XXX
 SG_ CSA_TorqueEstimate : 39|8@0- (5,0) [-640|635] "in-lbf" Vector__XXX
 SG_ CSA_ActiveMode : 47|3@0+ (1,0) [0|7] "Enum" Vector__XXX
 SG_ CSA_LVInputBelowNorm_Monitor : 43|1@0+ (1,0) [0|1] "Enum" Vector__XXX
 SG_ CSA_SBIT_Monitor : 55|1@0+ (1,0) [0|1] "Enum" Vector__XXX
 SG_ CSA_Damping_Monitor : 54|1@0+ (1,0) [0|1] "Enum" Vector__XXX
 SG_ CSA_PBIT_Monitor : 53|1@0+ (1,0) [0|1] "Enum" Vector__XXX
 SG_ CSA_LVInputBelow18V_Monitor : 52|1@0+ (1,0) [0|1] "Enum" Vector__XXX
 SG_ CSA_EMACInternalError_Monitor : 51|1@0+ (1,0) [0|1] "Enum" Vector__XXX
 SG_ CSA_EMAControlError_Monitor : 50|1@0+ (1,0) [0|1] "Enum" Vector__XXX
 SG_ CSA_CmdResponse_Monitor : 49|1@0+ (1,0) [0|1] "Enum" Vector__XXX
 SG_ CSA_OutputPosition_Monitor : 48|1@0+ (1,0) [0|1] "Enum" Vector__XXX
 SG_ CSA_TorqueOutputLimited : 63|1@0+ (1,0) [0|1] "Enum" Vector__XXX
 SG_ CSA_SBIT_Monitor_Exec : 56|1@0+ (1,0) [0|1] "Enum" Vector__XXX
 SG_ CSA_PositionBacklash : 71|8@0- (0.025,0) [-3.2|3.175] "deg" Vector__XXX
 SG_ COM_RollingCounter : 79|8@0+ (1,0) [0|255] "NA" Vector__XXX
 SG_ COM_E2E_CRC16 : 87|16@0+ (1,0) [0|65535] "NA" Vector__XXX

BO_ 973 CSA_RMR_Status_MSG15: 12 CSA_RMR
 SG_ CSA_LACmdValidity : 7|3@0+ (1,0) [0|7] "Enum" Vector__XXX
 SG_ CSA_LBCmdValidity : 4|3@0+ (1,0) [0|7] "Enum" Vector__XXX
 SG_ CSA_SelectedFCC : 1|2@0+ (1,0) [0|3] "Enum" Vector__XXX
 SG_ CSA_RACmdValidity : 15|3@0+ (1,0) [0|7] "Enum" Vector__XXX
 SG_ CSA_RBCmdValidity : 12|3@0+ (1,0) [0|7] "Enum" Vector__XXX
 SG_ CSA_OutputSplinePosition : 23|16@0- (0.002,0) [-65.536|65.534] "Degrees" Vector__XXX
 SG_ CSA_TorqueEstimate : 39|8@0- (5,0) [-640|635] "in-lbf" Vector__XXX
 SG_ CSA_ActiveMode : 47|3@0+ (1,0) [0|7] "Enum" Vector__XXX
 SG_ CSA_LVInputBelowNorm_Monitor : 43|1@0+ (1,0) [0|1] "Enum" Vector__XXX
 SG_ CSA_SBIT_Monitor : 55|1@0+ (1,0) [0|1] "Enum" Vector__XXX
 SG_ CSA_Damping_Monitor : 54|1@0+ (1,0) [0|1] "Enum" Vector__XXX
 SG_ CSA_PBIT_Monitor : 53|1@0+ (1,0) [0|1] "Enum" Vector__XXX
 SG_ CSA_LVInputBelow18V_Monitor : 52|1@0+ (1,0) [0|1] "Enum" Vector__XXX
 SG_ CSA_EMACInternalError_Monitor : 51|1@0+ (1,0) [0|1] "Enum" Vector__XXX
 SG_ CSA_EMAControlError_Monitor : 50|1@0+ (1,0) [0|1] "Enum" Vector__XXX
 SG_ CSA_CmdResponse_Monitor : 49|1@0+ (1,0) [0|1] "Enum" Vector__XXX
 SG_ CSA_OutputPosition_Monitor : 48|1@0+ (1,0) [0|1] "Enum" Vector__XXX
 SG_ CSA_TorqueOutputLimited : 63|1@0+ (1,0) [0|1] "Enum" Vector__XXX
 SG_ CSA_SBIT_Monitor_Exec : 56|1@0+ (1,0) [0|1] "Enum" Vector__XXX
 SG_ CSA_PositionBacklash : 71|8@0- (0.025,0) [-3.2|3.175] "deg" Vector__XXX
 SG_ COM_RollingCounter : 79|8@0+ (1,0) [0|255] "NA" Vector__XXX
 SG_ COM_E2E_CRC16 : 87|16@0+ (1,0) [0|65535] "NA" Vector__XXX

BO_ 129 FCC_LA_CSA_Cmd_MSG02: 48 FCC_LA
 SG_ CSALOF_PositionCmd : 7|16@0- (0.002,0) [-65.536|65.534] "Degrees" Vector__XXX
 SG_ CSALOF_EnableActiveControl : 23|1@0+ (1,0) [0|1] "Bool" Vector__XXX
 SG_ CSALOF_DisableActiveControlLaneA : 22|1@0+ (1,0) [0|1] "Bool" Vector__XXX
 SG_ CSALOF_DisableActiveControlLaneB : 21|1@0+ (1,0) [0|1] "Bool" Vector__XXX
 SG_ CSALOF_DisableActiveControlFPGA : 20|1@0+ (1,0) [0|1] "Bool" Vector__XXX
 SG_ CSALOF_TorqueLimit : 31|8@0+ (2.5,0) [0|637.5] "in-lbf" Vector__XXX
 SG_ CSALIF_PositionCmd : 39|16@0- (0.002,0) [-65.536|65.534] "Degrees" Vector__XXX
 SG_ CSALIF_EnableActiveControl : 55|1@0+ (1,0) [0|1] "Bool" Vector__XXX
 SG_ CSALIF_DisableActiveControlLaneA : 54|1@0+ (1,0) [0|1] "Bool" Vector__XXX
 SG_ CSALIF_DisableActiveControlLaneB : 53|1@0+ (1,0) [0|1] "Bool" Vector__XXX
 SG_ CSALIF_DisableActiveControlFPGA : 52|1@0+ (1,0) [0|1] "Bool" Vector__XXX
 SG_ CSALIF_TorqueLimit : 63|8@0+ (2.5,0) [0|637.5] "in-lbf" Vector__XXX
 SG_ CSARIF_PositionCmd : 71|16@0- (0.002,0) [-65.536|65.534] "Degrees" Vector__XXX
 SG_ CSARIF_EnableActiveControl : 87|1@0+ (1,0) [0|1] "Bool" Vector__XXX
 SG_ CSARIF_DisableActiveControlLaneA : 86|1@0+ (1,0) [0|1] "Bool" Vector__XXX
 SG_ CSARIF_DisableActiveControlLaneB : 85|1@0+ (1,0) [0|1] "Bool" Vector__XXX
 SG_ CSARIF_DisableActiveControlFPGA : 84|1@0+ (1,0) [0|1] "Bool" Vector__XXX
 SG_ CSARIF_TorqueLimit : 95|8@0+ (2.5,0) [0|637.5] "in-lbf" Vector__XXX
 SG_ CSAROF_PositionCmd : 103|16@0- (0.002,0) [-65.536|65.534] "Degrees" Vector__XXX
 SG_ CSAROF_EnableActiveControl : 119|1@0+ (1,0) [0|1] "Bool" Vector__XXX
 SG_ CSAROF_DisableActiveControlLaneA : 118|1@0+ (1,0) [0|1] "Bool" Vector__XXX
 SG_ CSAROF_DisableActiveControlLaneB : 117|1@0+ (1,0) [0|1] "Bool" Vector__XXX
 SG_ CSAROF_DisableActiveControlFPGA : 116|1@0+ (1,0) [0|1] "Bool" Vector__XXX
 SG_ CSAROF_TorqueLimit : 127|8@0+ (2.5,0) [0|637.5] "in-lbf" Vector__XXX
 SG_ CSALOR_PositionCmd : 135|16@0- (0.002,0) [-65.536|65.534] "Degrees" Vector__XXX
 SG_ CSALOR_EnableActiveControl : 151|1@0+ (1,0) [0|1] "Bool" Vector__XXX
 SG_ CSALOR_DisableActiveControlLaneA : 150|1@0+ (1,0) [0|1] "Bool" Vector__XXX
 SG_ CSALOR_DisableActiveControlLaneB : 149|1@0+ (1,0) [0|1] "Bool" Vector__XXX
 SG_ CSALOR_DisableActiveControlFPGA : 148|1@0+ (1,0) [0|1] "Bool" Vector__XXX
 SG_ CSALOR_TorqueLimit : 159|8@0+ (2.5,0) [0|637.5] "in-lbf" Vector__XXX
 SG_ CSALMR_PositionCmd : 167|16@0- (0.002,0) [-65.536|65.534] "Degrees" Vector__XXX
 SG_ CSALMR_EnableActiveControl : 183|1@0+ (1,0) [0|1] "Bool" Vector__XXX
 SG_ CSALMR_DisableActiveControlLaneA : 182|1@0+ (1,0) [0|1] "Bool" Vector__XXX
 SG_ CSALMR_DisableActiveControlLaneB : 181|1@0+ (1,0) [0|1] "Bool" Vector__XXX
 SG_ CSALMR_DisableActiveControlFPGA : 180|1@0+ (1,0) [0|1] "Bool" Vector__XXX
 SG_ CSALMR_TorqueLimit : 191|8@0+ (2.5,0) [0|637.5] "in-lbf" Vector__XXX
 SG_ CSALIR_PositionCmd : 199|16@0- (0.002,0) [-65.536|65.534] "Degrees" Vector__XXX
 SG_ CSALIR_EnableActiveControl : 215|1@0+ (1,0) [0|1] "Bool" Vector__XXX
 SG_ CSALIR_DisableActiveControlLaneA : 214|1@0+ (1,0) [0|1] "Bool" Vector__XXX
 SG_ CSALIR_DisableActiveControlLaneB : 213|1@0+ (1,0) [0|1] "Bool" Vector__XXX
 SG_ CSALIR_DisableActiveControlFPGA : 212|1@0+ (1,0) [0|1] "Bool" Vector__XXX
 SG_ CSALIR_TorqueLimit : 223|8@0+ (2.5,0) [0|637.5] "in-lbf" Vector__XXX
 SG_ CSARIR_PositionCmd : 231|16@0- (0.002,0) [-65.536|65.534] "Degrees" Vector__XXX
 SG_ CSARIR_EnableActiveControl : 247|1@0+ (1,0) [0|1] "Bool" Vector__XXX
 SG_ CSARIR_DisableActiveControlLaneA : 246|1@0+ (1,0) [0|1] "Bool" Vector__XXX
 SG_ CSARIR_DisableActiveControlLaneB : 245|1@0+ (1,0) [0|1] "Bool" Vector__XXX
 SG_ CSARIR_DisableActiveControlFPGA : 244|1@0+ (1,0) [0|1] "Bool" Vector__XXX
 SG_ CSARIR_TorqueLimit : 255|8@0+ (2.5,0) [0|637.5] "in-lbf" Vector__XXX
 SG_ CSARMR_PositionCmd : 263|16@0- (0.002,0) [-65.536|65.534] "Degrees" Vector__XXX
 SG_ CSARMR_EnableActiveControl : 279|1@0+ (1,0) [0|1] "Bool" Vector__XXX
 SG_ CSARMR_DisableActiveControlLaneA : 278|1@0+ (1,0) [0|1] "Bool" Vector__XXX
 SG_ CSARMR_DisableActiveControlLaneB : 277|1@0+ (1,0) [0|1] "Bool" Vector__XXX
 SG_ CSARMR_DisableActiveControlFPGA : 276|1@0+ (1,0) [0|1] "Bool" Vector__XXX
 SG_ CSARMR_TorqueLimit : 287|8@0+ (2.5,0) [0|637.5] "in-lbf" Vector__XXX
 SG_ CSAROR_PositionCmd : 295|16@0- (0.002,0) [-65.536|65.534] "Degrees" Vector__XXX
 SG_ CSAROR_EnableActiveControl : 311|1@0+ (1,0) [0|1] "Bool" Vector__XXX
 SG_ CSAROR_DisableActiveControlLaneA : 310|1@0+ (1,0) [0|1] "Bool" Vector__XXX
 SG_ CSAROR_DisableActiveControlLaneB : 309|1@0+ (1,0) [0|1] "Bool" Vector__XXX
 SG_ CSAROR_DisableActiveControlFPGA : 308|1@0+ (1,0) [0|1] "Bool" Vector__XXX
 SG_ CSAROR_TorqueLimit : 319|8@0+ (2.5,0) [0|637.5] "in-lbf" Vector__XXX
 SG_ CSA_NotFly : 327|1@0+ (1,0) [0|1] "Bool" Vector__XXX
 SG_ CSA_FCCHealthIndication : 326|2@0+ (1,0) [0|3] "NA" Vector__XXX
 SG_ COM_RollingCounter : 367|8@0+ (1,0) [0|255] "NA" Vector__XXX
 SG_ COM_E2E_CRC16 : 375|16@0+ (1,0) [0|65535] "NA" Vector__XXX

BO_ 193 FCC_LA_TPAC_Cmd_MSG03: 32 FCC_LA
 SG_ TPAC1_PositionCmd : 7|16@0+ (8e-05,0) [0|5.2428] "inches" Vector__XXX
 SG_ TPAC1_EnableActiveControl : 23|1@0+ (1,0) [0|1] "Bool" Vector__XXX
 SG_ TPAC1_DisableActiveControlLaneA : 22|1@0+ (1,0) [0|1] "Bool" Vector__XXX
 SG_ TPAC1_DisableActiveControlLaneB : 21|1@0+ (1,0) [0|1] "Bool" Vector__XXX
 SG_ TPAC1_DisableActiveControlFPGA : 20|1@0+ (1,0) [0|1] "Bool" Vector__XXX
 SG_ TPAC1_ApplyBrakeCmd : 19|1@0+ (1,0) [0|1] "Bool" Vector__XXX
 SG_ TPAC1_ForceLimit : 31|8@0+ (30,0) [0|7650] "lbf" Vector__XXX
 SG_ TPAC2_PositionCmd : 39|16@0+ (8e-05,0) [0|5.2428] "inches" Vector__XXX
 SG_ TPAC2_EnableActiveControl : 55|1@0+ (1,0) [0|1] "Bool" Vector__XXX
 SG_ TPAC2_DisableActiveControlLaneA : 54|1@0+ (1,0) [0|1] "Bool" Vector__XXX
 SG_ TPAC2_DisableActiveControlLaneB : 53|1@0+ (1,0) [0|1] "Bool" Vector__XXX
 SG_ TPAC2_DisableActiveControlFPGA : 52|1@0+ (1,0) [0|1] "Bool" Vector__XXX
 SG_ TPAC2_ApplyBrakeCmd : 51|1@0+ (1,0) [0|1] "Bool" Vector__XXX
 SG_ TPAC2_ForceLimit : 63|8@0+ (30,0) [0|7650] "lbf" Vector__XXX
 SG_ TPAC3_PositionCmd : 71|16@0+ (8e-05,0) [0|5.2428] "inches" Vector__XXX
 SG_ TPAC3_EnableActiveControl : 87|1@0+ (1,0) [0|1] "Bool" Vector__XXX
 SG_ TPAC3_DisableActiveControlLaneA : 86|1@0+ (1,0) [0|1] "Bool" Vector__XXX
 SG_ TPAC3_DisableActiveControlLaneB : 85|1@0+ (1,0) [0|1] "Bool" Vector__XXX
 SG_ TPAC3_DisableActiveControlFPGA : 84|1@0+ (1,0) [0|1] "Bool" Vector__XXX
 SG_ TPAC3_ApplyBrakeCmd : 83|1@0+ (1,0) [0|1] "Bool" Vector__XXX
 SG_ TPAC3_ForceLimit : 95|8@0+ (30,0) [0|7650] "lbf" Vector__XXX
 SG_ TPAC4_PositionCmd : 103|16@0+ (8e-05,0) [0|5.2428] "inches" Vector__XXX
 SG_ TPAC4_EnableActiveControl : 119|1@0+ (1,0) [0|1] "Bool" Vector__XXX
 SG_ TPAC4_DisableActiveControlLaneA : 118|1@0+ (1,0) [0|1] "Bool" Vector__XXX
 SG_ TPAC4_DisableActiveControlLaneB : 117|1@0+ (1,0) [0|1] "Bool" Vector__XXX
 SG_ TPAC4_DisableActiveControlFPGA : 116|1@0+ (1,0) [0|1] "Bool" Vector__XXX
 SG_ TPAC4_ApplyBrakeCmd : 115|1@0+ (1,0) [0|1] "Bool" Vector__XXX
 SG_ TPAC4_ForceLimit : 127|8@0+ (30,0) [0|7650] "lbf" Vector__XXX
 SG_ TPAC5_PositionCmd : 135|16@0+ (8e-05,0) [0|5.2428] "inches" Vector__XXX
 SG_ TPAC5_EnableActiveControl : 151|1@0+ (1,0) [0|1] "Bool" Vector__XXX
 SG_ TPAC5_DisableActiveControlLaneA : 150|1@0+ (1,0) [0|1] "Bool" Vector__XXX
 SG_ TPAC5_DisableActiveControlLaneB : 149|1@0+ (1,0) [0|1] "Bool" Vector__XXX
 SG_ TPAC5_DisableActiveControlFPGA : 148|1@0+ (1,0) [0|1] "Bool" Vector__XXX
 SG_ TPAC5_ApplyBrakeCmd : 147|1@0+ (1,0) [0|1] "Bool" Vector__XXX
 SG_ TPAC5_ForceLimit : 159|8@0+ (30,0) [0|7650] "lbf" Vector__XXX
 SG_ TPAC6_PositionCmd : 167|16@0+ (8e-05,0) [0|5.2428] "inches" Vector__XXX
 SG_ TPAC6_EnableActiveControl : 183|1@0+ (1,0) [0|1] "Bool" Vector__XXX
 SG_ TPAC6_DisableActiveControlLaneA : 182|1@0+ (1,0) [0|1] "Bool" Vector__XXX
 SG_ TPAC6_DisableActiveControlLaneB : 181|1@0+ (1,0) [0|1] "Bool" Vector__XXX
 SG_ TPAC6_DisableActiveControlFPGA : 180|1@0+ (1,0) [0|1] "Bool" Vector__XXX
 SG_ TPAC6_ApplyBrakeCmd : 179|1@0+ (1,0) [0|1] "Bool" Vector__XXX
 SG_ TPAC6_ForceLimit : 191|8@0+ (30,0) [0|7650] "lbf" Vector__XXX
 SG_ TPAC_NotFly : 199|1@0+ (1,0) [0|1] "Bool" Vector__XXX
 SG_ TPAC_FCCHealthIndication : 198|2@0+ (1,0) [0|3] "NA" Vector__XXX
 SG_ COM_RollingCounter : 239|8@0+ (1,0) [0|255] "NA" Vector__XXX
 SG_ COM_E2E_CRC16 : 247|16@0+ (1,0) [0|65535] "NA" Vector__XXX

BO_ 1052 TPAC_2_Status_MSG16: 12 TPAC_2
 SG_ TPAC_LACmdValidity : 7|3@0+ (1,0) [0|7] "Enum" Vector__XXX
 SG_ TPAC_LBCmdValidity : 4|3@0+ (1,0) [0|7] "Enum" Vector__XXX
 SG_ TPAC_SelectedFCC : 1|2@0+ (1,0) [0|3] "Enum" Vector__XXX
 SG_ TPAC_RACmdValidity : 15|3@0+ (1,0) [0|7] "Enum" Vector__XXX
 SG_ TPAC_RBCmdValidity : 12|3@0+ (1,0) [0|7] "Enum" Vector__XXX
 SG_ TPAC_ActuatorPosition : 23|16@0+ (8e-05,0) [0|5.2428] "inches" Vector__XXX
 SG_ TPAC_ForceEstimate : 39|8@0- (55,0) [-7040|6985] "lbf" Vector__XXX
 SG_ TPAC_ActiveMode : 47|3@0+ (1,0) [0|7] "Enum" Vector__XXX
 SG_ TPAC_BrakeApplied : 44|1@0+ (1,0) [0|1] "Bool" Vector__XXX
 SG_ TPAC_LVInputBelowNorm_Monitor : 43|1@0+ (1,0) [0|1] "Enum" Vector__XXX
 SG_ TPAC_HVInputBelow520V_Monitor : 42|1@0+ (1,0) [0|1] "Enum" Vector__XXX
 SG_ TPAC_HVConnectorsInstalled : 41|1@0+ (1,0) [0|1] "Enum" Vector__XXX
 SG_ TPAC_HVAppliedToTPAC : 40|1@0+ (1,0) [0|1] "Enum" Vector__XXX
 SG_ TPAC_SBIT_Monitor : 55|1@0+ (1,0) [0|1] "Enum" Vector__XXX
 SG_ TPAC_BrakeError_Monitor : 54|1@0+ (1,0) [0|1] "Enum" Vector__XXX
 SG_ TPAC_PBIT_Monitor : 53|1@0+ (1,0) [0|1] "Enum" Vector__XXX
 SG_ TPAC_LVInputBelow18V_Monitor : 52|1@0+ (1,0) [0|1] "Enum" Vector__XXX
 SG_ TPAC_EMACInternalError_Monitor : 51|1@0+ (1,0) [0|1] "Enum" Vector__XXX
 SG_ TPAC_EMAControlError_Monitor : 50|1@0+ (1,0) [0|1] "Enum" Vector__XXX
 SG_ TPAC_CmdResponse_Monitor : 49|1@0+ (1,0) [0|1] "Enum" Vector__XXX
 SG_ TPAC_OutputPosition_Monitor : 48|1@0+ (1,0) [0|1] "Enum" Vector__XXX
 SG_ TPAC_ForceOutputLimited : 63|1@0+ (1,0) [0|1] "Bool" Vector__XXX
 SG_ TPAC_SBIT_Monitor_Exec : 56|1@0+ (1,0) [0|1] "Enum" Vector__XXX
 SG_ TPAC_PositionBacklash : 71|8@0- (0.00035,0) [-0.0448|0.04445] "inches" Vector__XXX
 SG_ COM_RollingCounter : 79|8@0+ (1,0) [0|255] "NA" Vector__XXX
 SG_ COM_E2E_CRC16 : 87|16@0+ (1,0) [0|65535] "NA" Vector__XXX

BO_ 1054 TPAC_4_Status_MSG16: 12 TPAC_4
 SG_ TPAC_LACmdValidity : 7|3@0+ (1,0) [0|7] "Enum" Vector__XXX
 SG_ TPAC_LBCmdValidity : 4|3@0+ (1,0) [0|7] "Enum" Vector__XXX
 SG_ TPAC_SelectedFCC : 1|2@0+ (1,0) [0|3] "Enum" Vector__XXX
 SG_ TPAC_RACmdValidity : 15|3@0+ (1,0) [0|7] "Enum" Vector__XXX
 SG_ TPAC_RBCmdValidity : 12|3@0+ (1,0) [0|7] "Enum" Vector__XXX
 SG_ TPAC_ActuatorPosition : 23|16@0+ (8e-05,0) [0|5.2428] "inches" Vector__XXX
 SG_ TPAC_ForceEstimate : 39|8@0- (55,0) [-7040|6985] "lbf" Vector__XXX
 SG_ TPAC_ActiveMode : 47|3@0+ (1,0) [0|7] "Enum" Vector__XXX
 SG_ TPAC_BrakeApplied : 44|1@0+ (1,0) [0|1] "Bool" Vector__XXX
 SG_ TPAC_LVInputBelowNorm_Monitor : 43|1@0+ (1,0) [0|1] "Enum" Vector__XXX
 SG_ TPAC_HVInputBelow520V_Monitor : 42|1@0+ (1,0) [0|1] "Enum" Vector__XXX
 SG_ TPAC_HVConnectorsInstalled : 41|1@0+ (1,0) [0|1] "Enum" Vector__XXX
 SG_ TPAC_HVAppliedToTPAC : 40|1@0+ (1,0) [0|1] "Enum" Vector__XXX
 SG_ TPAC_SBIT_Monitor : 55|1@0+ (1,0) [0|1] "Enum" Vector__XXX
 SG_ TPAC_BrakeError_Monitor : 54|1@0+ (1,0) [0|1] "Enum" Vector__XXX
 SG_ TPAC_PBIT_Monitor : 53|1@0+ (1,0) [0|1] "Enum" Vector__XXX
 SG_ TPAC_LVInputBelow18V_Monitor : 52|1@0+ (1,0) [0|1] "Enum" Vector__XXX
 SG_ TPAC_EMACInternalError_Monitor : 51|1@0+ (1,0) [0|1] "Enum" Vector__XXX
 SG_ TPAC_EMAControlError_Monitor : 50|1@0+ (1,0) [0|1] "Enum" Vector__XXX
 SG_ TPAC_CmdResponse_Monitor : 49|1@0+ (1,0) [0|1] "Enum" Vector__XXX
 SG_ TPAC_OutputPosition_Monitor : 48|1@0+ (1,0) [0|1] "Enum" Vector__XXX
 SG_ TPAC_ForceOutputLimited : 63|1@0+ (1,0) [0|1] "Bool" Vector__XXX
 SG_ TPAC_SBIT_Monitor_Exec : 56|1@0+ (1,0) [0|1] "Enum" Vector__XXX
 SG_ TPAC_PositionBacklash : 71|8@0- (0.00035,0) [-0.0448|0.04445] "inches" Vector__XXX
 SG_ COM_RollingCounter : 79|8@0+ (1,0) [0|255] "NA" Vector__XXX
 SG_ COM_E2E_CRC16 : 87|16@0+ (1,0) [0|65535] "NA" Vector__XXX

BO_ 1345 FCC_LA_Aircraft_Status_MSG21: 12 FCC_LA
 SG_ FCC_AircraftID : 7|16@0+ (1,0) [0|65535] "NA" Vector__XXX
 SG_ FCC_UTCTime : 23|32@0+ (1,0) [0|4294967295] "Seconds since 00:00:00 1/6/1980" Vector__XXX
 SG_ FCC_OutsideAirTemp : 55|8@0+ (1,-40) [-40|215] "Celsius" Vector__XXX
 SG_ FCC_FlightPhase : 62|4@0+ (1,0) [0|15] "Enum" Vector__XXX
 SG_ FCC_AircraftMode : 58|2@0+ (1,0) [0|3] "Enum" Vector__XXX
 SG_ FCC_MaintenanceMode : 56|1@0+ (1,0) [0|1] "Enum" Vector__XXX
 SG_ COM_RollingCounter : 79|8@0+ (1,0) [0|255] "NA" Vector__XXX
 SG_ COM_E2E_CRC16 : 87|16@0+ (1,0) [0|65535] "NA" Vector__XXX

BO_ 257 FCC_LA_BMU_Cmd_MSG04: 12 FCC_LA
 SG_ BMU1_PropBusCmd : 7|2@0+ (1,0) [0|3] "Enum" Vector__XXX
 SG_ BMU1_XlinkPyroCmd : 5|1@0+ (1,0) [0|1] "Enum" Vector__XXX
 SG_ BMU1_LifterPyroCmd : 4|1@0+ (1,0) [0|1] "Enum" Vector__XXX
 SG_ BMU1_TilterPyroCmd : 3|1@0+ (1,0) [0|1] "Enum" Vector__XXX
 SG_ BMU1_MainBusDeEnergizeCmd : 2|1@0+ (1,0) [0|1] "Enum" Vector__XXX
 SG_ BMU2_PropBusCmd : 15|2@0+ (1,0) [0|3] "Enum" Vector__XXX
 SG_ BMU2_XlinkPyroCmd : 13|1@0+ (1,0) [0|1] "Enum" Vector__XXX
 SG_ BMU2_LifterPyroCmd : 12|1@0+ (1,0) [0|1] "Enum" Vector__XXX
 SG_ BMU2_TilterPyroCmd : 11|1@0+ (1,0) [0|1] "Enum" Vector__XXX
 SG_ BMU2_MainBusDeEnergizeCmd : 10|1@0+ (1,0) [0|1] "Enum" Vector__XXX
 SG_ BMU3_PropBusCmd : 23|2@0+ (1,0) [0|3] "Enum" Vector__XXX
 SG_ BMU3_XlinkPyroCmd : 21|1@0+ (1,0) [0|1] "Enum" Vector__XXX
 SG_ BMU3_LifterPyroCmd : 20|1@0+ (1,0) [0|1] "Enum" Vector__XXX
 SG_ BMU3_TilterPyroCmd : 19|1@0+ (1,0) [0|1] "Enum" Vector__XXX
 SG_ BMU3_MainBusDeEnergizeCmd : 18|1@0+ (1,0) [0|1] "Enum" Vector__XXX
 SG_ BMU4_PropBusCmd : 31|2@0+ (1,0) [0|3] "Enum" Vector__XXX
 SG_ BMU4_XlinkPyroCmd : 29|1@0+ (1,0) [0|1] "Enum" Vector__XXX
 SG_ BMU4_LifterPyroCmd : 28|1@0+ (1,0) [0|1] "Enum" Vector__XXX
 SG_ BMU4_TilterPyroCmd : 27|1@0+ (1,0) [0|1] "Enum" Vector__XXX
 SG_ BMU4_MainBusDeEnergizeCmd : 26|1@0+ (1,0) [0|1] "Enum" Vector__XXX
 SG_ BMU5_PropBusCmd : 39|2@0+ (1,0) [0|3] "Enum" Vector__XXX
 SG_ BMU5_XlinkPyroCmd : 37|1@0+ (1,0) [0|1] "Enum" Vector__XXX
 SG_ BMU5_LifterPyroCmd : 36|1@0+ (1,0) [0|1] "Enum" Vector__XXX
 SG_ BMU5_TilterPyroCmd : 35|1@0+ (1,0) [0|1] "Enum" Vector__XXX
 SG_ BMU5_MainBusDeEnergizeCmd : 34|1@0+ (1,0) [0|1] "Enum" Vector__XXX
 SG_ BMU6_PropBusCmd : 47|2@0+ (1,0) [0|3] "Enum" Vector__XXX
 SG_ BMU6_XlinkPyroCmd : 45|1@0+ (1,0) [0|1] "Enum" Vector__XXX
 SG_ BMU6_LifterPyroCmd : 44|1@0+ (1,0) [0|1] "Enum" Vector__XXX
 SG_ BMU6_TilterPyroCmd : 43|1@0+ (1,0) [0|1] "Enum" Vector__XXX
 SG_ BMU6_MainBusDeEnergizeCmd : 42|1@0+ (1,0) [0|1] "Enum" Vector__XXX
 SG_ BMU_NotFly : 71|1@0+ (1,0) [0|1] "Bool" Vector__XXX
 SG_ BMU_FCCHealthIndication : 70|2@0+ (1,0) [0|3] "NA" Vector__XXX
 SG_ COM_RollingCounter : 79|8@0+ (1,0) [0|255] "NA" Vector__XXX
 SG_ COM_E2E_CRC16 : 87|16@0+ (1,0) [0|65535] "NA" Vector__XXX

BO_ 1128 BMU_2E_Estimation_Status_MSG17: 32 BMU_2E
 SG_ BMU_ModuleMinVoltage : 7|8@0+ (0.02,0) [0|5.1] "Volts" Vector__XXX
 SG_ BMU_ModuleMaxVoltage : 15|8@0+ (0.02,0) [0|5.1] "Volts" Vector__XXX
 SG_ BMU_CellBlockMinTemp : 23|8@0+ (1,-50) [-50|205] "Celsius" Vector__XXX
 SG_ BMU_CellBlockMaxTemp : 31|8@0+ (1,-50) [-50|205] "Celsius" Vector__XXX
 SG_ BMU_PackSOC : 39|8@0+ (1,0) [0|127] "%" Vector__XXX
 SG_ BMU_VLEnergyHiFi : 47|8@0+ (0.1,0) [0|25.5] "kWh" Vector__XXX
 SG_ BMU_CLEnergyHiFi : 55|8@0+ (0.1,0) [0|25.5] "kWh" Vector__XXX
 SG_ BMU_MaxAvailEnergyHiFi : 63|8@0+ (0.1,0) [0|25.5] "kWh" Vector__XXX
 SG_ BMU_RemainingEnergyHiFi : 71|8@0+ (0.1,0) [0|25.5] "kWh" Vector__XXX
 SG_ BMU_ChgPwr2sHiFi : 79|8@0+ (0.5,0) [0|127.5] "kW" Vector__XXX
 SG_ BMU_ChgPwr10sHiFi : 87|8@0+ (0.5,0) [0|127.5] "kW" Vector__XXX
 SG_ BMU_DchgPwr2sHiFi : 95|10@0+ (0.5,-511.5) [-511.5|0] "kW" Vector__XXX
 SG_ BMU_DchgPwr2sHiFi_Validity : 97|2@0+ (1,0) [0|3] "Enum" Vector__XXX
 SG_ BMU_DchgPwr10sHiFi : 111|10@0+ (0.5,-511.5) [-511.5|0] "kW" Vector__XXX
 SG_ BMU_DchgPwr10sHiFi_Validity : 113|2@0+ (1,0) [0|3] "Enum" Vector__XXX
 SG_ BMU_PackSOH : 127|10@0+ (0.1,0) [0|102.3] "%" Vector__XXX
 SG_ BMU_PackSOH_Validity : 129|2@0+ (1,0) [0|3] "Enum" Vector__XXX
 SG_ BMU_CellStackCurrent : 143|11@0- (1,0) [-1024|1023] "Amps" Vector__XXX
 SG_ BMU_CellStackCurrent_Validity : 145|2@0+ (1,0) [0|3] "Enum" Vector__XXX
 SG_ BMU_ConsolidatedEISTemp : 159|7@0+ (1,0) [0|127] "%" Vector__XXX
 SG_ BMU_NominalPackCapacity : 167|8@0+ (0.1,0) [0|25.5] "kWh" Vector__XXX
 SG_ BMU_CellBlockMaxTemp_Validity : 175|2@0+ (1,0) [0|3] "Enum" Vector__XXX
 SG_ BMU_CellBlockMinTemp_Validity : 173|2@0+ (1,0) [0|3] "Enum" Vector__XXX
 SG_ BMU_ModuleMaxVoltage_Validity : 171|2@0+ (1,0) [0|3] "Enum" Vector__XXX
 SG_ BMU_ModuleMinVoltage_Validity : 169|2@0+ (1,0) [0|3] "Enum" Vector__XXX
 SG_ BMU_CLEnergyHiFi_Validity : 183|2@0+ (1,0) [0|3] "Enum" Vector__XXX
 SG_ BMU_VLEnergyHiFi_Validity : 181|2@0+ (1,0) [0|3] "Enum" Vector__XXX
 SG_ BMU_PackSOC_Validity : 179|2@0+ (1,0) [0|3] "Enum" Vector__XXX
 SG_ BMU_RemainingEnergyHiFi_Validity : 191|2@0+ (1,0) [0|3] "Enum" Vector__XXX
 SG_ BMU_MaxAvailEnergyHiFi_Validity : 189|2@0+ (1,0) [0|3] "Enum" Vector__XXX
 SG_ BMU_ChgPwr10sHiFi_Validity : 187|2@0+ (1,0) [0|3] "Enum" Vector__XXX
 SG_ BMU_ChgPwr2sHiFi_Validity : 185|2@0+ (1,0) [0|3] "Enum" Vector__XXX
 SG_ BMU_EstHVPSDegradedAlert : 197|1@0+ (1,0) [0|1] "Enum" Vector__XXX
 SG_ BMU_PackTempAlert : 196|1@0+ (1,0) [0|1] "Enum" Vector__XXX
 SG_ BMU_PackHiTempAlert : 195|1@0+ (1,0) [0|1] "Enum" Vector__XXX
 SG_ BMU_PackOverheatAlert : 194|1@0+ (1,0) [0|1] "Enum" Vector__XXX
 SG_ BMU_ConsolidatedEISTemp_Validity : 193|2@0+ (1,0) [0|3] "Enum" Vector__XXX
 SG_ COM_RollingCounter : 239|8@0+ (1,0) [0|255] "NA" Vector__XXX
 SG_ COM_E2E_CRC16 : 247|16@0+ (1,0) [0|65535] "NA" Vector__XXX

BO_ 1189 BMU_5C_Control_Status_MSG18: 48 BMU_5C
 SG_ BMU_CellStackVoltage : 7|10@0+ (1,0) [0|1023] "Volts" Vector__XXX
 SG_ BMU_CellStackVoltage_Validity : 9|2@0+ (1,0) [0|3] "Enum" Vector__XXX
 SG_ BMU_PropBusVoltage : 23|10@0+ (1,0) [0|1023] "Volts" Vector__XXX
 SG_ BMU_PropBusVoltage_Validity : 25|2@0+ (1,0) [0|3] "Enum" Vector__XXX
 SG_ BMU_XlinkCurrent : 39|10@0- (1,0) [-512|511] "Amps" Vector__XXX
 SG_ BMU_XlinkCurrent_Validity : 41|2@0+ (1,0) [0|3] "Enum" Vector__XXX
 SG_ BMU_EE1Current : 55|10@0- (1,0) [-512|511] "Amps" Vector__XXX
 SG_ BMU_EE1Current_Validity : 57|2@0+ (1,0) [0|3] "Enum" Vector__XXX
 SG_ BMU_EE2Current : 71|10@0- (1,0) [-512|511] "Amps" Vector__XXX
 SG_ BMU_EE2Current_Validity : 73|2@0+ (1,0) [0|3] "Enum" Vector__XXX
 SG_ BMU_DchgPwr2sLoFi : 87|10@0+ (0.5,-511.5) [-511.5|0] "kW" Vector__XXX
 SG_ BMU_DchgPwr2sLoFi_Validity : 89|2@0+ (1,0) [0|3] "Enum" Vector__XXX
 SG_ BMU_DchgPwr10sLoFi : 103|10@0+ (0.5,-511.5) [-511.5|0] "kW" Vector__XXX
 SG_ BMU_DchgPwr10sLoFi_Validity : 105|2@0+ (1,0) [0|3] "Enum" Vector__XXX
 SG_ BMU_Mate_DchgPwr2sHiFi : 119|10@0+ (0.5,-511.5) [-511.5|0] "kWh" Vector__XXX
 SG_ BMU_Mate_DchgPwr2sHiFi_Validity : 121|2@0+ (1,0) [0|3] "Enum" Vector__XXX
 SG_ BMU_Mate_DchgPwr10sHiFi : 135|10@0+ (0.5,-511.5) [-511.5|0] "kWh" Vector__XXX
 SG_ BMU_Mate_DchgPwr10sHiFi_Validity : 137|2@0+ (1,0) [0|3] "Enum" Vector__XXX
 SG_ BMU_ChgPwr2sLoFi : 151|8@0+ (0.5,0) [0|127.5] "kW" Vector__XXX
 SG_ BMU_ChgPwr10sLoFi : 159|8@0+ (0.5,0) [0|127.5] "kW" Vector__XXX
 SG_ BMU_Mate_ChgPwr2sHiFi : 167|8@0+ (0.5,0) [0|127.5] "kWh" Vector__XXX
 SG_ BMU_Mate_ChgPwr10sHiFi : 175|8@0+ (0.5,0) [0|127.5] "kWh" Vector__XXX
 SG_ BMU_AuxCurrent : 183|8@0+ (0.1,0) [0|25.5] "Amps" Vector__XXX
 SG_ BMU_CLEnergyLoFi : 191|8@0+ (0.1,0) [0|25.5] "kWh" Vector__XXX
 SG_ BMU_VLEnergyLoFi : 199|8@0+ (0.1,0) [0|25.5] "kWh" Vector__XXX
 SG_ BMU_MaxAvailEnergyLoFi : 207|8@0+ (0.1,0) [0|25.5] "kWh" Vector__XXX
 SG_ BMU_RemainingEnergyLoFi : 215|8@0+ (0.1,0) [0|25.5] "kWh" Vector__XXX
 SG_ BMU_ChargerVoltage : 223|10@0+ (1,0) [0|1023] "Volts" Vector__XXX
 SG_ BMU_ChargerVoltage_Validity : 225|2@0+ (1,0) [0|3] "Enum" Vector__XXX
 SG_ BMU_ChargeCurrent : 239|9@0+ (1,0) [0|511] "Amps" Vector__XXX
 SG_ BMU_ChargeCurrent_Validity : 241|2@0+ (1,0) [0|3] "Enum" Vector__XXX
 SG_ BMU_ChargeTimeRemaining : 255|10@0+ (1,0) [0|1023] "Minutes" Vector__XXX
 SG_ BMU_ChargeTimeRemaining_Validity : 257|2@0+ (1,0) [0|3] "Enum" Vector__XXX
 SG_ BMU_RemainingEnergyLoFi_Validity : 271|2@0+ (1,0) [0|3] "Enum" Vector__XXX
 SG_ BMU_MaxAvailEnergyLoFi_Validity : 269|2@0+ (1,0) [0|3] "Enum" Vector__XXX
 SG_ BMU_VLEnergyLoFi_Validity : 267|2@0+ (1,0) [0|3] "Enum" Vector__XXX
 SG_ BMU_CLEnergyLoFi_Validity : 265|2@0+ (1,0) [0|3] "Enum" Vector__XXX
 SG_ BMU_ChgPwr10sLoFi_Validity : 279|2@0+ (1,0) [0|3] "Enum" Vector__XXX
 SG_ BMU_ChgPwr2sLoFi_Validity : 277|2@0+ (1,0) [0|3] "Enum" Vector__XXX
 SG_ BMU_Mate_ChgPwr10sHiFi_Validity : 275|2@0+ (1,0) [0|3] "Enum" Vector__XXX
 SG_ BMU_Mate_ChgPwr2sHiFi_Validity : 273|2@0+ (1,0) [0|3] "Enum" Vector__XXX
 SG_ BMU_MainBusConnectionState : 287|3@0+ (1,0) [0|7] "Enum" Vector__XXX
 SG_ BMU_PropBusConnectionState : 284|3@0+ (1,0) [0|7] "Enum" Vector__XXX
 SG_ BMU_AuxCurrent_Validity : 281|2@0+ (1,0) [0|3] "Enum" Vector__XXX
 SG_ BMU_EE1PyroStatus : 335|2@0+ (1,0) [0|3] "Enum" Vector__XXX
 SG_ BMU_EE2PyroStatus : 333|2@0+ (1,0) [0|3] "Enum" Vector__XXX
 SG_ BMU_XlinkHSPyroStatus : 331|2@0+ (1,0) [0|3] "Enum" Vector__XXX
 SG_ BMU_XlinkLSPyroStatus : 329|2@0+ (1,0) [0|3] "Enum" Vector__XXX
 SG_ BMU_CCUModeSwitchPosition : 343|2@0+ (1,0) [0|3] "Enum" Vector__XXX
 SG_ BMU_ChargeStatus : 341|2@0+ (1,0) [0|3] "Enum" Vector__XXX
 SG_ BMU_ChargePlugStatus : 339|2@0+ (1,0) [0|3] "Enum" Vector__XXX
 SG_ BMU_ThermalPlugStatus : 337|2@0+ (1,0) [0|3] "Enum" Vector__XXX
 SG_ BMU_ECSMinBusVoltageFault : 351|1@0+ (1,0) [0|1] "Enum" Vector__XXX
 SG_ BMU_PropMinBusVoltageFault : 350|1@0+ (1,0) [0|1] "Enum" Vector__XXX
 SG_ BMU_HVPSImbalanceAlert : 349|1@0+ (1,0) [0|1] "Enum" Vector__XXX
 SG_ BMU_HVPSFaultAlert : 348|1@0+ (1,0) [0|1] "Enum" Vector__XXX
 SG_ BMU_CtrlHVPSDegradedAlert : 347|1@0+ (1,0) [0|1] "Enum" Vector__XXX
 SG_ BMU_PackHVExposedAlert : 346|1@0+ (1,0) [0|1] "Enum" Vector__XXX
 SG_ BMU_PackPyroStatus : 345|2@0+ (1,0) [0|3] "Enum" Vector__XXX
 SG_ BMU_Mate_HVPSImbalanceAlert : 359|1@0+ (1,0) [0|1] "Enum" Vector__XXX
 SG_ BMU_Mate_HVPSFaultAlert : 358|1@0+ (1,0) [0|1] "Enum" Vector__XXX
 SG_ BMU_Mate_PackHVExposedAlert : 357|1@0+ (1,0) [0|1] "Enum" Vector__XXX
 SG_ BMU_Mate_CtrlHVPSDegradedAlert : 356|1@0+ (1,0) [0|1] "Enum" Vector__XXX
 SG_ BMU_Mate_EstHVPSDegradedAlert : 355|1@0+ (1,0) [0|1] "Enum" Vector__XXX
 SG_ BMU_Mate_PackOverheatAlert : 354|1@0+ (1,0) [0|1] "Enum" Vector__XXX
 SG_ BMU_Mate_PackHiTempAlert : 353|1@0+ (1,0) [0|1] "Enum" Vector__XXX
 SG_ BMU_Mate_PackTempAlert : 352|1@0+ (1,0) [0|1] "Enum" Vector__XXX
 SG_ COM_RollingCounter : 367|8@0+ (1,0) [0|255] "NA" Vector__XXX
 SG_ COM_E2E_CRC16 : 375|16@0+ (1,0) [0|65535] "NA" Vector__XXX

BO_ 719 EEC_1_Status_Slow_MSG11: 32 EEC_1
 SG_ EEC_HVCurrent : 7|10@0+ (1,-500) [-500|523] "Amps" Vector__XXX
 SG_ EEC_HVInputVoltage : 23|10@0+ (1,0) [0|1023] "Volts" Vector__XXX
 SG_ EEC_ControllerTemp : 39|8@0+ (1,-50) [-50|205] "Celsius" Vector__XXX
 SG_ EEC_OilTemp : 47|8@0+ (1,-50) [-50|205] "Celsius" Vector__XXX
 SG_ EEC_StatorWindingTemp : 55|8@0+ (1,-50) [-50|205] "Celsius" Vector__XXX
 SG_ EEC_ConsolidatedTemp : 63|8@0+ (0.39215686275,0) [0|100.00000000125] "Percentage" Vector__XXX
 SG_ EEC_TakeoffTimeLimit : 71|10@0+ (1,-10) [-10|1013] "Seconds" Vector__XXX
 SG_ EEC_MaxPowerTimeLimit : 87|8@0+ (1,-10) [-10|245] "Seconds" Vector__XXX
 SG_ EEC_HVCurrent_Validity : 95|2@0+ (1,0) [0|3] "Enum" Vector__XXX
 SG_ EEC_HVInputVoltage_Validity : 93|2@0+ (1,0) [0|3] "Enum" Vector__XXX
 SG_ EEC_ControllerTemp_Validity : 91|2@0+ (1,0) [0|3] "Enum" Vector__XXX
 SG_ EEC_OilTemp_Validity : 89|2@0+ (1,0) [0|3] "Enum" Vector__XXX
 SG_ EEC_StatorWindingTemp_Validity : 103|2@0+ (1,0) [0|3] "Enum" Vector__XXX
 SG_ EEC_ConsolidatedTemp_Validity : 101|2@0+ (1,0) [0|3] "Enum" Vector__XXX
 SG_ EEC_TakeoffTimeLimit_Validity : 99|2@0+ (1,0) [0|3] "Enum" Vector__XXX
 SG_ EEC_MaxPowerTimeLimit_Validity : 97|2@0+ (1,0) [0|3] "Enum" Vector__XXX
 SG_ EEC_EngineFault_Alert : 111|1@0+ (1,0) [0|1] "Bool" Vector__XXX
 SG_ EEC_EngineDegraded_Alert : 110|1@0+ (1,0) [0|1] "Bool" Vector__XXX
 SG_ EEC_HighTemp_Alert : 109|1@0+ (1,0) [0|1] "Bool" Vector__XXX
 SG_ EEC_StowingAvailable : 108|1@0+ (1,0) [0|1] "Enum" Vector__XXX
 SG_ EEC_LACmdValidity : 119|2@0+ (1,0) [0|3] "Enum" Vector__XXX
 SG_ EEC_LBCmdValidity : 117|2@0+ (1,0) [0|3] "Enum" Vector__XXX
 SG_ EEC_RACmdValidity : 115|2@0+ (1,0) [0|3] "Enum" Vector__XXX
 SG_ EEC_RBCmdValidity : 113|2@0+ (1,0) [0|3] "Enum" Vector__XXX
 SG_ EEC_ContinuousRatedTorque : 135|10@0+ (1,0) [0|1023] "Nm" Vector__XXX
 SG_ EEC_EmergencyRatedTorque : 151|10@0+ (1,0) [0|1023] "Nm" Vector__XXX
 SG_ EEC_TakeoffRatedTorque : 167|10@0+ (1,0) [0|1023] "Nm" Vector__XXX
 SG_ EEC_HiTempTorqueLimit : 183|10@0+ (1,0) [0|1023] "Nm" Vector__XXX
 SG_ COM_RollingCounter : 239|8@0+ (1,0) [0|255] "NA" Vector__XXX
 SG_ COM_E2E_CRC16 : 247|16@0+ (1,0) [0|65535] "NA" Vector__XXX

BO_ 723 EEC_5_Status_Slow_MSG11: 32 EEC_5
 SG_ EEC_HVCurrent : 7|10@0+ (1,-500) [-500|523] "Amps" Vector__XXX
 SG_ EEC_HVInputVoltage : 23|10@0+ (1,0) [0|1023] "Volts" Vector__XXX
 SG_ EEC_ControllerTemp : 39|8@0+ (1,-50) [-50|205] "Celsius" Vector__XXX
 SG_ EEC_OilTemp : 47|8@0+ (1,-50) [-50|205] "Celsius" Vector__XXX
 SG_ EEC_StatorWindingTemp : 55|8@0+ (1,-50) [-50|205] "Celsius" Vector__XXX
 SG_ EEC_ConsolidatedTemp : 63|8@0+ (0.39215686275,0) [0|100.00000000125] "Percentage" Vector__XXX
 SG_ EEC_TakeoffTimeLimit : 71|10@0+ (1,-10) [-10|1013] "Seconds" Vector__XXX
 SG_ EEC_MaxPowerTimeLimit : 87|8@0+ (1,-10) [-10|245] "Seconds" Vector__XXX
 SG_ EEC_HVCurrent_Validity : 95|2@0+ (1,0) [0|3] "Enum" Vector__XXX
 SG_ EEC_HVInputVoltage_Validity : 93|2@0+ (1,0) [0|3] "Enum" Vector__XXX
 SG_ EEC_ControllerTemp_Validity : 91|2@0+ (1,0) [0|3] "Enum" Vector__XXX
 SG_ EEC_OilTemp_Validity : 89|2@0+ (1,0) [0|3] "Enum" Vector__XXX
 SG_ EEC_StatorWindingTemp_Validity : 103|2@0+ (1,0) [0|3] "Enum" Vector__XXX
 SG_ EEC_ConsolidatedTemp_Validity : 101|2@0+ (1,0) [0|3] "Enum" Vector__XXX
 SG_ EEC_TakeoffTimeLimit_Validity : 99|2@0+ (1,0) [0|3] "Enum" Vector__XXX
 SG_ EEC_MaxPowerTimeLimit_Validity : 97|2@0+ (1,0) [0|3] "Enum" Vector__XXX
 SG_ EEC_EngineFault_Alert : 111|1@0+ (1,0) [0|1] "Bool" Vector__XXX
 SG_ EEC_EngineDegraded_Alert : 110|1@0+ (1,0) [0|1] "Bool" Vector__XXX
 SG_ EEC_HighTemp_Alert : 109|1@0+ (1,0) [0|1] "Bool" Vector__XXX
 SG_ EEC_StowingAvailable : 108|1@0+ (1,0) [0|1] "Enum" Vector__XXX
 SG_ EEC_LACmdValidity : 119|2@0+ (1,0) [0|3] "Enum" Vector__XXX
 SG_ EEC_LBCmdValidity : 117|2@0+ (1,0) [0|3] "Enum" Vector__XXX
 SG_ EEC_RACmdValidity : 115|2@0+ (1,0) [0|3] "Enum" Vector__XXX
 SG_ EEC_RBCmdValidity : 113|2@0+ (1,0) [0|3] "Enum" Vector__XXX
 SG_ EEC_ContinuousRatedTorque : 135|10@0+ (1,0) [0|1023] "Nm" Vector__XXX
 SG_ EEC_EmergencyRatedTorque : 151|10@0+ (1,0) [0|1023] "Nm" Vector__XXX
 SG_ EEC_TakeoffRatedTorque : 167|10@0+ (1,0) [0|1023] "Nm" Vector__XXX
 SG_ EEC_HiTempTorqueLimit : 183|10@0+ (1,0) [0|1023] "Nm" Vector__XXX
 SG_ COM_RollingCounter : 239|8@0+ (1,0) [0|255] "NA" Vector__XXX
 SG_ COM_E2E_CRC16 : 247|16@0+ (1,0) [0|65535] "NA" Vector__XXX

BO_ 726 EEC_8_Status_Slow_MSG11: 32 EEC_8
 SG_ EEC_HVCurrent : 7|10@0+ (1,-500) [-500|523] "Amps" Vector__XXX
 SG_ EEC_HVInputVoltage : 23|10@0+ (1,0) [0|1023] "Volts" Vector__XXX
 SG_ EEC_ControllerTemp : 39|8@0+ (1,-50) [-50|205] "Celsius" Vector__XXX
 SG_ EEC_OilTemp : 47|8@0+ (1,-50) [-50|205] "Celsius" Vector__XXX
 SG_ EEC_StatorWindingTemp : 55|8@0+ (1,-50) [-50|205] "Celsius" Vector__XXX
 SG_ EEC_ConsolidatedTemp : 63|8@0+ (0.39215686275,0) [0|100.00000000125] "Percentage" Vector__XXX
 SG_ EEC_TakeoffTimeLimit : 71|10@0+ (1,-10) [-10|1013] "Seconds" Vector__XXX
 SG_ EEC_MaxPowerTimeLimit : 87|8@0+ (1,-10) [-10|245] "Seconds" Vector__XXX
 SG_ EEC_HVCurrent_Validity : 95|2@0+ (1,0) [0|3] "Enum" Vector__XXX
 SG_ EEC_HVInputVoltage_Validity : 93|2@0+ (1,0) [0|3] "Enum" Vector__XXX
 SG_ EEC_ControllerTemp_Validity : 91|2@0+ (1,0) [0|3] "Enum" Vector__XXX
 SG_ EEC_OilTemp_Validity : 89|2@0+ (1,0) [0|3] "Enum" Vector__XXX
 SG_ EEC_StatorWindingTemp_Validity : 103|2@0+ (1,0) [0|3] "Enum" Vector__XXX
 SG_ EEC_ConsolidatedTemp_Validity : 101|2@0+ (1,0) [0|3] "Enum" Vector__XXX
 SG_ EEC_TakeoffTimeLimit_Validity : 99|2@0+ (1,0) [0|3] "Enum" Vector__XXX
 SG_ EEC_MaxPowerTimeLimit_Validity : 97|2@0+ (1,0) [0|3] "Enum" Vector__XXX
 SG_ EEC_EngineFault_Alert : 111|1@0+ (1,0) [0|1] "Bool" Vector__XXX
 SG_ EEC_EngineDegraded_Alert : 110|1@0+ (1,0) [0|1] "Bool" Vector__XXX
 SG_ EEC_HighTemp_Alert : 109|1@0+ (1,0) [0|1] "Bool" Vector__XXX
 SG_ EEC_StowingAvailable : 108|1@0+ (1,0) [0|1] "Enum" Vector__XXX
 SG_ EEC_LACmdValidity : 119|2@0+ (1,0) [0|3] "Enum" Vector__XXX
 SG_ EEC_LBCmdValidity : 117|2@0+ (1,0) [0|3] "Enum" Vector__XXX
 SG_ EEC_RACmdValidity : 115|2@0+ (1,0) [0|3] "Enum" Vector__XXX
 SG_ EEC_RBCmdValidity : 113|2@0+ (1,0) [0|3] "Enum" Vector__XXX
 SG_ EEC_ContinuousRatedTorque : 135|10@0+ (1,0) [0|1023] "Nm" Vector__XXX
 SG_ EEC_EmergencyRatedTorque : 151|10@0+ (1,0) [0|1023] "Nm" Vector__XXX
 SG_ EEC_TakeoffRatedTorque : 167|10@0+ (1,0) [0|1023] "Nm" Vector__XXX
 SG_ EEC_HiTempTorqueLimit : 183|10@0+ (1,0) [0|1023] "Nm" Vector__XXX
 SG_ COM_RollingCounter : 239|8@0+ (1,0) [0|255] "NA" Vector__XXX
 SG_ COM_E2E_CRC16 : 247|16@0+ (1,0) [0|65535] "NA" Vector__XXX

BO_ 730 EEC_12_Status_Slow_MSG11: 32 EEC_12
 SG_ EEC_HVCurrent : 7|10@0+ (1,-500) [-500|523] "Amps" Vector__XXX
 SG_ EEC_HVInputVoltage : 23|10@0+ (1,0) [0|1023] "Volts" Vector__XXX
 SG_ EEC_ControllerTemp : 39|8@0+ (1,-50) [-50|205] "Celsius" Vector__XXX
 SG_ EEC_OilTemp : 47|8@0+ (1,-50) [-50|205] "Celsius" Vector__XXX
 SG_ EEC_StatorWindingTemp : 55|8@0+ (1,-50) [-50|205] "Celsius" Vector__XXX
 SG_ EEC_ConsolidatedTemp : 63|8@0+ (0.39215686275,0) [0|100.00000000125] "Percentage" Vector__XXX
 SG_ EEC_TakeoffTimeLimit : 71|10@0+ (1,-10) [-10|1013] "Seconds" Vector__XXX
 SG_ EEC_MaxPowerTimeLimit : 87|8@0+ (1,-10) [-10|245] "Seconds" Vector__XXX
 SG_ EEC_HVCurrent_Validity : 95|2@0+ (1,0) [0|3] "Enum" Vector__XXX
 SG_ EEC_HVInputVoltage_Validity : 93|2@0+ (1,0) [0|3] "Enum" Vector__XXX
 SG_ EEC_ControllerTemp_Validity : 91|2@0+ (1,0) [0|3] "Enum" Vector__XXX
 SG_ EEC_OilTemp_Validity : 89|2@0+ (1,0) [0|3] "Enum" Vector__XXX
 SG_ EEC_StatorWindingTemp_Validity : 103|2@0+ (1,0) [0|3] "Enum" Vector__XXX
 SG_ EEC_ConsolidatedTemp_Validity : 101|2@0+ (1,0) [0|3] "Enum" Vector__XXX
 SG_ EEC_TakeoffTimeLimit_Validity : 99|2@0+ (1,0) [0|3] "Enum" Vector__XXX
 SG_ EEC_MaxPowerTimeLimit_Validity : 97|2@0+ (1,0) [0|3] "Enum" Vector__XXX
 SG_ EEC_EngineFault_Alert : 111|1@0+ (1,0) [0|1] "Bool" Vector__XXX
 SG_ EEC_EngineDegraded_Alert : 110|1@0+ (1,0) [0|1] "Bool" Vector__XXX
 SG_ EEC_HighTemp_Alert : 109|1@0+ (1,0) [0|1] "Bool" Vector__XXX
 SG_ EEC_StowingAvailable : 108|1@0+ (1,0) [0|1] "Enum" Vector__XXX
 SG_ EEC_LACmdValidity : 119|2@0+ (1,0) [0|3] "Enum" Vector__XXX
 SG_ EEC_LBCmdValidity : 117|2@0+ (1,0) [0|3] "Enum" Vector__XXX
 SG_ EEC_RACmdValidity : 115|2@0+ (1,0) [0|3] "Enum" Vector__XXX
 SG_ EEC_RBCmdValidity : 113|2@0+ (1,0) [0|3] "Enum" Vector__XXX
 SG_ EEC_ContinuousRatedTorque : 135|10@0+ (1,0) [0|1023] "Nm" Vector__XXX
 SG_ EEC_EmergencyRatedTorque : 151|10@0+ (1,0) [0|1023] "Nm" Vector__XXX
 SG_ EEC_TakeoffRatedTorque : 167|10@0+ (1,0) [0|1023] "Nm" Vector__XXX
 SG_ EEC_HiTempTorqueLimit : 183|10@0+ (1,0) [0|1023] "Nm" Vector__XXX
 SG_ COM_RollingCounter : 239|8@0+ (1,0) [0|255] "NA" Vector__XXX
 SG_ COM_E2E_CRC16 : 247|16@0+ (1,0) [0|65535] "NA" Vector__XXX

BO_ 655 EEC_1_Status_Fast_MSG10: 12 EEC_1
 SG_ EEC_PropellerRPM : 7|12@0+ (1,-500) [-500|3595] "RPM" Vector__XXX
 SG_ EEC_PropellerRPM_Validity : 9|2@0+ (1,0) [0|3] "Enum" Vector__XXX
 SG_ EEC_OutputShaftTorque : 23|12@0- (0.5,0) [-1024|1023.5] "Nm" Vector__XXX
 SG_ EEC_OutputShaftTorque_Validity : 25|2@0+ (1,0) [0|3] "Enum" Vector__XXX
 SG_ EEC_StateFeedback : 39|8@0+ (1,0) [0|255] "Enum" Vector__XXX
 SG_ EEC_TPAC_HingeAngle : 47|7@0+ (1,-4) [-4|123] "Degrees" Vector__XXX
 SG_ EEC_TPAC_HingeAngle_Valid : 40|1@0+ (1,0) [0|1] "Bool" Vector__XXX
 SG_ EEC_SelectedFCC : 55|2@0+ (1,0) [0|3] "Enum" Vector__XXX
 SG_ EEC_PrimaryMCU : 53|1@0+ (1,0) [0|1] "Enum" Vector__XXX
 SG_ EEC_ProtectionActive : 52|1@0+ (1,0) [0|1] "Bool" Vector__XXX
 SG_ EEC_IBIT_Status : 51|2@0+ (1,0) [0|1] "Enum" Vector__XXX
 SG_ EEC_FCSOverrideLimitsFeedback : 49|2@0+ (1,0) [0|3] "Enum" Vector__XXX
 SG_ EEC_EngineLoss : 63|1@0+ (1,0) [0|1] "Bool" Vector__XXX
 SG_ EEC_HalfEngineLoss : 62|1@0+ (1,0) [0|1] "Bool" Vector__XXX
 SG_ EEC_TPHS_Fault : 61|1@0+ (1,0) [0|1] "Bool" Vector__XXX
 SG_ EEC_MCU_Mismatch_Fault : 60|1@0+ (1,0) [0|1] "Bool" Vector__XXX
 SG_ EEC_PhaseShort_Fault : 59|1@0+ (1,0) [0|1] "Enum" Vector__XXX
 SG_ EEC_TorqueControl_Fault : 58|1@0+ (1,0) [0|1] "Bool" Vector__XXX
 SG_ COM_RollingCounter : 79|8@0+ (1,0) [0|255] "NA" Vector__XXX
 SG_ COM_E2E_CRC16 : 87|16@0+ (1,0) [0|65535] "NA" Vector__XXX

BO_ 659 EEC_5_Status_Fast_MSG10: 12 EEC_5
 SG_ EEC_PropellerRPM : 7|12@0+ (1,-500) [-500|3595] "RPM" Vector__XXX
 SG_ EEC_PropellerRPM_Validity : 9|2@0+ (1,0) [0|3] "Enum" Vector__XXX
 SG_ EEC_OutputShaftTorque : 23|12@0- (0.5,0) [-1024|1023.5] "Nm" Vector__XXX
 SG_ EEC_OutputShaftTorque_Validity : 25|2@0+ (1,0) [0|3] "Enum" Vector__XXX
 SG_ EEC_StateFeedback : 39|8@0+ (1,0) [0|255] "Enum" Vector__XXX
 SG_ EEC_TPAC_HingeAngle : 47|7@0+ (1,-4) [-4|123] "Degrees" Vector__XXX
 SG_ EEC_TPAC_HingeAngle_Valid : 40|1@0+ (1,0) [0|1] "Bool" Vector__XXX
 SG_ EEC_SelectedFCC : 55|2@0+ (1,0) [0|3] "Enum" Vector__XXX
 SG_ EEC_PrimaryMCU : 53|1@0+ (1,0) [0|1] "Enum" Vector__XXX
 SG_ EEC_ProtectionActive : 52|1@0+ (1,0) [0|1] "Bool" Vector__XXX
 SG_ EEC_IBIT_Status : 51|2@0+ (1,0) [0|1] "Enum" Vector__XXX
 SG_ EEC_FCSOverrideLimitsFeedback : 49|2@0+ (1,0) [0|3] "Enum" Vector__XXX
 SG_ EEC_EngineLoss : 63|1@0+ (1,0) [0|1] "Bool" Vector__XXX
 SG_ EEC_HalfEngineLoss : 62|1@0+ (1,0) [0|1] "Bool" Vector__XXX
 SG_ EEC_TPHS_Fault : 61|1@0+ (1,0) [0|1] "Bool" Vector__XXX
 SG_ EEC_MCU_Mismatch_Fault : 60|1@0+ (1,0) [0|1] "Bool" Vector__XXX
 SG_ EEC_PhaseShort_Fault : 59|1@0+ (1,0) [0|1] "Enum" Vector__XXX
 SG_ EEC_TorqueControl_Fault : 58|1@0+ (1,0) [0|1] "Bool" Vector__XXX
 SG_ COM_RollingCounter : 79|8@0+ (1,0) [0|255] "NA" Vector__XXX
 SG_ COM_E2E_CRC16 : 87|16@0+ (1,0) [0|65535] "NA" Vector__XXX

BO_ 662 EEC_8_Status_Fast_MSG10: 12 EEC_8
 SG_ EEC_PropellerRPM : 7|12@0+ (1,-500) [-500|3595] "RPM" Vector__XXX
 SG_ EEC_PropellerRPM_Validity : 9|2@0+ (1,0) [0|3] "Enum" Vector__XXX
 SG_ EEC_OutputShaftTorque : 23|12@0- (0.5,0) [-1024|1023.5] "Nm" Vector__XXX
 SG_ EEC_OutputShaftTorque_Validity : 25|2@0+ (1,0) [0|3] "Enum" Vector__XXX
 SG_ EEC_StateFeedback : 39|8@0+ (1,0) [0|255] "Enum" Vector__XXX
 SG_ EEC_TPAC_HingeAngle : 47|7@0+ (1,-4) [-4|123] "Degrees" Vector__XXX
 SG_ EEC_TPAC_HingeAngle_Valid : 40|1@0+ (1,0) [0|1] "Bool" Vector__XXX
 SG_ EEC_SelectedFCC : 55|2@0+ (1,0) [0|3] "Enum" Vector__XXX
 SG_ EEC_PrimaryMCU : 53|1@0+ (1,0) [0|1] "Enum" Vector__XXX
 SG_ EEC_ProtectionActive : 52|1@0+ (1,0) [0|1] "Bool" Vector__XXX
 SG_ EEC_IBIT_Status : 51|2@0+ (1,0) [0|1] "Enum" Vector__XXX
 SG_ EEC_FCSOverrideLimitsFeedback : 49|2@0+ (1,0) [0|3] "Enum" Vector__XXX
 SG_ EEC_EngineLoss : 63|1@0+ (1,0) [0|1] "Bool" Vector__XXX
 SG_ EEC_HalfEngineLoss : 62|1@0+ (1,0) [0|1] "Bool" Vector__XXX
 SG_ EEC_TPHS_Fault : 61|1@0+ (1,0) [0|1] "Bool" Vector__XXX
 SG_ EEC_MCU_Mismatch_Fault : 60|1@0+ (1,0) [0|1] "Bool" Vector__XXX
 SG_ EEC_PhaseShort_Fault : 59|1@0+ (1,0) [0|1] "Enum" Vector__XXX
 SG_ EEC_TorqueControl_Fault : 58|1@0+ (1,0) [0|1] "Bool" Vector__XXX
 SG_ COM_RollingCounter : 79|8@0+ (1,0) [0|255] "NA" Vector__XXX
 SG_ COM_E2E_CRC16 : 87|16@0+ (1,0) [0|65535] "NA" Vector__XXX

CM_ SG_ 2047 eec_maint_command "Maintenance state command";
CM_ SG_ 2047 commanded_engine_speed "Commanded engine speed";
CM_ SG_ 2047 commanded_engine_torque "Commanded engine torque";
CM_ SG_ 2047 voltage_ctrl_v_dq_cmd_q "Voltage control command (quadrature component value)";
CM_ SG_ 2047 voltage_ctrl_v_dq_cmd_d "Voltage control command (direct component value)";
CM_ SG_ 2047 current_ctrl_i_dq_cmd_q "Current control command (quadrature component value)";
CM_ SG_ 2047 current_ctrl_i_dq_cmd_d "Current control command (direct component value)";
CM_ SG_ 2047 COM_MaintCmd "Set this to 0xEE";
CM_ SG_ 2047 COM_TargetLru_ID "COM Target LRU";
CM_ BO_ 1186 "The BMU Controller Status Message is sent from the  BMU Controller to the FCC every 100 ms to update BMU Controller status";
CM_ BO_ 720 "The EEC Status Slow Message is sent from the EEC to the FCC every 100 ms to update EEC status";
CM_ SG_ 720 EEC_StowingAvailable "0 = Not Faulted, 1 = Faulted";
CM_ BO_ 722 "The EEC Status Slow Message is sent from the EEC to the FCC every 100 ms to update EEC status";
CM_ SG_ 722 EEC_StowingAvailable "0 = Not Faulted, 1 = Faulted";
CM_ BO_ 727 "The EEC Status Slow Message is sent from the EEC to the FCC every 100 ms to update EEC status";
CM_ SG_ 727 EEC_StowingAvailable "0 = Not Faulted, 1 = Faulted";
CM_ BO_ 729 "The EEC Status Slow Message is sent from the EEC to the FCC every 100 ms to update EEC status";
CM_ SG_ 729 EEC_StowingAvailable "0 = Not Faulted, 1 = Faulted";
CM_ BO_ 656 "The EEC Status Fast Message is sent from the EEC to the FCC every 10 ms to update EEC status";
CM_ SG_ 656 EEC_TorqueControl_Fault "0 - Not Faulted, 1 = Faulted
EEC is not able to control torque as commanded.";
CM_ SG_ 656 EEC_PhaseShort_Fault "0 = Not Faulted, 1 = Faulted";
CM_ SG_ 656 EEC_MCU_Mismatch_Fault "0 = Not Faulted, 1 = Faulted";
CM_ SG_ 656 EEC_TPHS_Fault "0 = Not Faulted, 1 = Faulted";
CM_ SG_ 656 EEC_ProtectionActive "0 = Inactive, 1 = Active";
CM_ BO_ 658 "The EEC Status Fast Message is sent from the EEC to the FCC every 10 ms to update EEC status";
CM_ SG_ 658 EEC_TorqueControl_Fault "0 - Not Faulted, 1 = Faulted
EEC is not able to control torque as commanded.";
CM_ SG_ 658 EEC_PhaseShort_Fault "0 = Not Faulted, 1 = Faulted";
CM_ SG_ 658 EEC_MCU_Mismatch_Fault "0 = Not Faulted, 1 = Faulted";
CM_ SG_ 658 EEC_TPHS_Fault "0 = Not Faulted, 1 = Faulted";
CM_ SG_ 658 EEC_ProtectionActive "0 = Inactive, 1 = Active";
CM_ BO_ 663 "The EEC Status Fast Message is sent from the EEC to the FCC every 10 ms to update EEC status";
CM_ SG_ 663 EEC_TorqueControl_Fault "0 - Not Faulted, 1 = Faulted
EEC is not able to control torque as commanded.";
CM_ SG_ 663 EEC_PhaseShort_Fault "0 = Not Faulted, 1 = Faulted";
CM_ SG_ 663 EEC_MCU_Mismatch_Fault "0 = Not Faulted, 1 = Faulted";
CM_ SG_ 663 EEC_TPHS_Fault "0 = Not Faulted, 1 = Faulted";
CM_ SG_ 663 EEC_ProtectionActive "0 = Inactive, 1 = Active";
CM_ BO_ 665 "The EEC Status Fast Message is sent from the EEC to the FCC every 10 ms to update EEC status";
CM_ SG_ 665 EEC_TorqueControl_Fault "0 - Not Faulted, 1 = Faulted
EEC is not able to control torque as commanded.";
CM_ SG_ 665 EEC_PhaseShort_Fault "0 = Not Faulted, 1 = Faulted";
CM_ SG_ 665 EEC_MCU_Mismatch_Fault "0 = Not Faulted, 1 = Faulted";
CM_ SG_ 665 EEC_TPHS_Fault "0 = Not Faulted, 1 = Faulted";
CM_ SG_ 665 EEC_ProtectionActive "0 = Inactive, 1 = Active";
CM_ BO_ 65 "The EEC Command Message is sent from the  FCC to the EEC every 10 ms to update cmd status";
CM_ SG_ 65 EEC_PropSpinLruId "PropSpinLruId=0 = no eec , (1-12) = number of propeller spin .";
CM_ SG_ 65 EEC_PropSpinProfileId "Id=0 = no-spin , Id=1-15 = spin profile to perform.";
CM_ SG_ 65 EEC_FCCHealthIndication "Self-assessed integrity of the transmitting FCC, with lower values indicating lower integrity. FCCs that report higher integrity should be preferred by the receiver";
CM_ BO_ 1948 "The Configuration Message is sent from all remote LRUs to the FCC at 1 hz to provide the configuration data";
CM_ BO_ 1950 "The Configuration Message is sent from all remote LRUs to the FCC at 1 hz to provide the configuration data";
CM_ BO_ 1954 "The Configuration Message is sent from all remote LRUs to the FCC at 1 hz to provide the configuration data";
CM_ BO_ 1960 "The Configuration Message is sent from all remote LRUs to the FCC at 1 hz to provide the configuration data";
CM_ BO_ 1925 "The Configuration Message is sent from all remote LRUs to the FCC at 1 hz to provide the configuration data";
CM_ BO_ 1930 "The Configuration Message is sent from all remote LRUs to the FCC at 1 hz to provide the configuration data";
CM_ BO_ 1933 "The Configuration Message is sent from all remote LRUs to the FCC at 1 hz to provide the configuration data";
CM_ BO_ 1936 "The Configuration Message is sent from all remote LRUs to the FCC at 1 hz to provide the configuration data";
CM_ BO_ 1938 "The Configuration Message is sent from all remote LRUs to the FCC at 1 hz to provide the configuration data";
CM_ BO_ 1943 "The Configuration Message is sent from all remote LRUs to the FCC at 1 hz to provide the configuration data";
CM_ BO_ 1945 "The Configuration Message is sent from all remote LRUs to the FCC at 1 hz to provide the configuration data";
CM_ BO_ 965 "The CSA Status Message is sent from the CSA to the FCC every 20 ms to update CSA status";
CM_ SG_ 965 CSA_TorqueOutputLimited "0 = Torque not limited, 1 = Torque limited";
CM_ SG_ 965 CSA_OutputPosition_Monitor "0 = No error detected, 1 = End Rod Position Error; Init to TRUE until configuration done";
CM_ SG_ 965 CSA_Damping_Monitor "0 = No damping fault detected, 1 = Damping fault detected";
CM_ SG_ 965 CSA_SBIT_Monitor "0 = No SBIT Fault; 1= SBIT Fault Detected";
CM_ SG_ 965 CSA_LVInputBelowNorm_Monitor "0 = 28V input voltage is normal, 1 = 28V input voltage is below normal";
CM_ BO_ 970 "The CSA Status Message is sent from the CSA to the FCC every 20 ms to update CSA status";
CM_ SG_ 970 CSA_TorqueOutputLimited "0 = Torque not limited, 1 = Torque limited";
CM_ SG_ 970 CSA_OutputPosition_Monitor "0 = No error detected, 1 = End Rod Position Error; Init to TRUE until configuration done";
CM_ SG_ 970 CSA_Damping_Monitor "0 = No damping fault detected, 1 = Damping fault detected";
CM_ SG_ 970 CSA_SBIT_Monitor "0 = No SBIT Fault; 1= SBIT Fault Detected";
CM_ SG_ 970 CSA_LVInputBelowNorm_Monitor "0 = 28V input voltage is normal, 1 = 28V input voltage is below normal";
CM_ BO_ 973 "The CSA Status Message is sent from the CSA to the FCC every 20 ms to update CSA status";
CM_ SG_ 973 CSA_TorqueOutputLimited "0 = Torque not limited, 1 = Torque limited";
CM_ SG_ 973 CSA_OutputPosition_Monitor "0 = No error detected, 1 = End Rod Position Error; Init to TRUE until configuration done";
CM_ SG_ 973 CSA_Damping_Monitor "0 = No damping fault detected, 1 = Damping fault detected";
CM_ SG_ 973 CSA_SBIT_Monitor "0 = No SBIT Fault; 1= SBIT Fault Detected";
CM_ SG_ 973 CSA_LVInputBelowNorm_Monitor "0 = 28V input voltage is normal, 1 = 28V input voltage is below normal";
CM_ BO_ 129 "The CSA Command Message is sent from the  FCC to the CSAs every 10 ms to update cmd status";
CM_ SG_ 129 CSA_FCCHealthIndication "Self-assessed integrity of the transmitting FCC, with lower values indicating lower integrity. FCCs that report higher integrity should be preferred by the receiver";
CM_ SG_ 129 CSAROR_DisableActiveControlFPGA "0 = Retain Prior State, 1 = Disable Operation";
CM_ SG_ 129 CSAROR_DisableActiveControlLaneB "0 = Retain Prior State, 1 = Disable Operation";
CM_ SG_ 129 CSAROR_DisableActiveControlLaneA "0 = Retain Prior State, 1 = Disable Operation";
CM_ SG_ 129 CSAROR_EnableActiveControl "Enable torque at edge transition to 1";
CM_ SG_ 129 CSARMR_DisableActiveControlFPGA "0 = Retain Prior State, 1 = Disable Operation";
CM_ SG_ 129 CSARMR_DisableActiveControlLaneB "0 = Retain Prior State, 1 = Disable Operation";
CM_ SG_ 129 CSARMR_DisableActiveControlLaneA "0 = Retain Prior State, 1 = Disable Operation";
CM_ SG_ 129 CSARMR_EnableActiveControl "Enable torque at edge transition to 1";
CM_ SG_ 129 CSARIR_DisableActiveControlFPGA "0 = Retain Prior State, 1 = Disable Operation";
CM_ SG_ 129 CSARIR_DisableActiveControlLaneB "0 = Retain Prior State, 1 = Disable Operation";
CM_ SG_ 129 CSARIR_DisableActiveControlLaneA "0 = Retain Prior State, 1 = Disable Operation";
CM_ SG_ 129 CSARIR_EnableActiveControl "Enable torque at edge transition to 1";
CM_ SG_ 129 CSALIR_DisableActiveControlFPGA "0 = Retain Prior State, 1 = Disable Operation";
CM_ SG_ 129 CSALIR_DisableActiveControlLaneB "0 = Retain Prior State, 1 = Disable Operation";
CM_ SG_ 129 CSALIR_DisableActiveControlLaneA "0 = Retain Prior State, 1 = Disable Operation";
CM_ SG_ 129 CSALIR_EnableActiveControl "Enable torque at edge transition to 1";
CM_ SG_ 129 CSALMR_DisableActiveControlFPGA "0 = Retain Prior State, 1 = Disable Operation";
CM_ SG_ 129 CSALMR_DisableActiveControlLaneB "0 = Retain Prior State, 1 = Disable Operation";
CM_ SG_ 129 CSALMR_DisableActiveControlLaneA "0 = Retain Prior State, 1 = Disable Operation";
CM_ SG_ 129 CSALMR_EnableActiveControl "Enable torque at edge transition to 1";
CM_ SG_ 129 CSALOR_DisableActiveControlFPGA "0 = Retain Prior State, 1 = Disable Operation";
CM_ SG_ 129 CSALOR_DisableActiveControlLaneB "0 = Retain Prior State, 1 = Disable Operation";
CM_ SG_ 129 CSALOR_DisableActiveControlLaneA "0 = Retain Prior State, 1 = Disable Operation";
CM_ SG_ 129 CSALOR_EnableActiveControl "Enable torque at edge transition to 1";
CM_ SG_ 129 CSAROF_DisableActiveControlFPGA "0 = Retain Prior State, 1 = Disable Operation";
CM_ SG_ 129 CSAROF_DisableActiveControlLaneB "0 = Retain Prior State, 1 = Disable Operation";
CM_ SG_ 129 CSAROF_DisableActiveControlLaneA "0 = Retain Prior State, 1 = Disable Operation";
CM_ SG_ 129 CSAROF_EnableActiveControl "Enable torque at edge transition to 1";
CM_ SG_ 129 CSARIF_DisableActiveControlFPGA "0 = Retain Prior State, 1 = Disable Operation";
CM_ SG_ 129 CSARIF_DisableActiveControlLaneB "0 = Retain Prior State, 1 = Disable Operation";
CM_ SG_ 129 CSARIF_DisableActiveControlLaneA "0 = Retain Prior State, 1 = Disable Operation";
CM_ SG_ 129 CSARIF_EnableActiveControl "Enable torque at edge transition to 1";
CM_ SG_ 129 CSALIF_DisableActiveControlFPGA "0 = Retain Prior State, 1 = Disable Operation";
CM_ SG_ 129 CSALIF_DisableActiveControlLaneB "0 = Retain Prior State, 1 = Disable Operation";
CM_ SG_ 129 CSALIF_DisableActiveControlLaneA "0 = Retain Prior State, 1 = Disable Operation";
CM_ SG_ 129 CSALIF_EnableActiveControl "Enable torque at edge transition to 1";
CM_ SG_ 129 CSALOF_DisableActiveControlFPGA "0 = Retain Prior State, 1 = Disable Operation";
CM_ SG_ 129 CSALOF_DisableActiveControlLaneB "0 = Retain Prior State, 1 = Disable Operation";
CM_ SG_ 129 CSALOF_DisableActiveControlLaneA "0 = Retain Prior State, 1 = Disable Operation";
CM_ SG_ 129 CSALOF_EnableActiveControl "Enable torque at edge transition to 1";
CM_ BO_ 193 "The TPA Command Message is sent from the  FCC to the TPA  every 20 ms to update cmd status";
CM_ SG_ 193 TPAC_FCCHealthIndication "Self-assessed integrity of the transmitting FCC, with lower values indicating lower integrity. FCCs that report higher integrity should be preferred by the receiver";
CM_ SG_ 193 TPAC6_ApplyBrakeCmd "0 = Allow Release Brake, 1 = Engage Brake";
CM_ SG_ 193 TPAC6_DisableActiveControlFPGA "0 = Retain Prior State, 1 = Disable Operation";
CM_ SG_ 193 TPAC6_DisableActiveControlLaneB "0 = Retain Prior State, 1 = Disable Operation";
CM_ SG_ 193 TPAC6_DisableActiveControlLaneA "0 = Retain Prior State, 1 = Disable Operation";
CM_ SG_ 193 TPAC6_EnableActiveControl "Enable operation at edge transition to 1";
CM_ SG_ 193 TPAC5_ApplyBrakeCmd "0 = Allow Release Brake, 1 = Engage Brake";
CM_ SG_ 193 TPAC5_DisableActiveControlFPGA "0 = Retain Prior State, 1 = Disable Operation";
CM_ SG_ 193 TPAC5_DisableActiveControlLaneB "0 = Retain Prior State, 1 = Disable Operation";
CM_ SG_ 193 TPAC5_DisableActiveControlLaneA "0 = Retain Prior State, 1 = Disable Operation";
CM_ SG_ 193 TPAC5_EnableActiveControl "Enable operation at edge transition to 1";
CM_ SG_ 193 TPAC4_ApplyBrakeCmd "0 = Allow Release Brake, 1 = Engage Brake";
CM_ SG_ 193 TPAC4_DisableActiveControlFPGA "0 = Retain Prior State, 1 = Disable Operation";
CM_ SG_ 193 TPAC4_DisableActiveControlLaneB "0 = Retain Prior State, 1 = Disable Operation";
CM_ SG_ 193 TPAC4_DisableActiveControlLaneA "0 = Retain Prior State, 1 = Disable Operation";
CM_ SG_ 193 TPAC4_EnableActiveControl "Enable operation at edge transition to 1";
CM_ SG_ 193 TPAC3_ApplyBrakeCmd "0 = Allow Release Brake, 1 = Engage Brake";
CM_ SG_ 193 TPAC3_DisableActiveControlFPGA "0 = Retain Prior State, 1 = Disable Operation";
CM_ SG_ 193 TPAC3_DisableActiveControlLaneB "0 = Retain Prior State, 1 = Disable Operation";
CM_ SG_ 193 TPAC3_DisableActiveControlLaneA "0 = Retain Prior State, 1 = Disable Operation";
CM_ SG_ 193 TPAC3_EnableActiveControl "Enable operation at edge transition to 1";
CM_ SG_ 193 TPAC2_ApplyBrakeCmd "0 = Allow Release Brake, 1 = Engage Brake";
CM_ SG_ 193 TPAC2_DisableActiveControlFPGA "0 = Retain Prior State, 1 = Disable Operation";
CM_ SG_ 193 TPAC2_DisableActiveControlLaneB "0 = Retain Prior State, 1 = Disable Operation";
CM_ SG_ 193 TPAC2_DisableActiveControlLaneA "0 = Retain Prior State, 1 = Disable Operation";
CM_ SG_ 193 TPAC2_EnableActiveControl "Enable operation at edge transition to 1";
CM_ SG_ 193 TPAC1_ApplyBrakeCmd "0 = Allow Release Brake, 1 = Engage Brake";
CM_ SG_ 193 TPAC1_DisableActiveControlFPGA "0 = Retain Prior State, 1 = Disable Operation";
CM_ SG_ 193 TPAC1_DisableActiveControlLaneB "0 = Retain Prior State, 1 = Disable Operation";
CM_ SG_ 193 TPAC1_DisableActiveControlLaneA "0 = Retain Prior State, 1 = Disable Operation";
CM_ SG_ 193 TPAC1_EnableActiveControl "Enable operation at edge transition to 1";
CM_ BO_ 1052 "The TPAC Status Message is sent from the TPA to the FCC every 100 ms to update TPA status";
CM_ SG_ 1052 TPAC_LVInputBelow18V_Monitor "0 = LV input voltage is above 18V, 1 = LV input voltage is below 18V";
CM_ SG_ 1052 TPAC_PBIT_Monitor "0 = No PBIT fault warnings, 1 = PBIT fault warning";
CM_ SG_ 1052 TPAC_BrakeError_Monitor "0 = No brake hold error detected, 1 = Brake fail to hold detected";
CM_ SG_ 1052 TPAC_HVAppliedToTPAC "0 = HV not applied to TPAC, 1 = HV applied to TPAC (threshold is 100V)";
CM_ SG_ 1052 TPAC_HVConnectorsInstalled "0 = No continuity on HV interlock, 1 = Continuity for both HV connectors";
CM_ SG_ 1052 TPAC_HVInputBelow520V_Monitor "0 = HV Input Voltage is greater than or equal to 520V, 1 = HV Input Voltage is below 520V";
CM_ SG_ 1052 TPAC_LVInputBelowNorm_Monitor "0 = LV input voltage is normal, 1 = LV input voltage is below normal";
CM_ BO_ 1054 "The TPAC Status Message is sent from the TPA to the FCC every 100 ms to update TPA status";
CM_ SG_ 1054 TPAC_LVInputBelow18V_Monitor "0 = LV input voltage is above 18V, 1 = LV input voltage is below 18V";
CM_ SG_ 1054 TPAC_PBIT_Monitor "0 = No PBIT fault warnings, 1 = PBIT fault warning";
CM_ SG_ 1054 TPAC_BrakeError_Monitor "0 = No brake hold error detected, 1 = Brake fail to hold detected";
CM_ SG_ 1054 TPAC_HVAppliedToTPAC "0 = HV not applied to TPAC, 1 = HV applied to TPAC (threshold is 100V)";
CM_ SG_ 1054 TPAC_HVConnectorsInstalled "0 = No continuity on HV interlock, 1 = Continuity for both HV connectors";
CM_ SG_ 1054 TPAC_HVInputBelow520V_Monitor "0 = HV Input Voltage is greater than or equal to 520V, 1 = HV Input Voltage is below 520V";
CM_ SG_ 1054 TPAC_LVInputBelowNorm_Monitor "0 = LV input voltage is normal, 1 = LV input voltage is below normal";
CM_ BO_ 1345 "The FCC AC Status Message is sent from the FCC every 1 sec to the remote LRUs to provide a common time reference and information for the Aircraft.
The message is optional for LRUs to subscribe to.";
CM_ BO_ 257 "The BMU Command Message is sent from the  FCC to the BMU Controller and Estimator every 100 ms to update cmd status";
CM_ SG_ 257 BMU_FCCHealthIndication "Self-assessed integrity of the transmitting FCC, with lower values indicating lower integrity. FCCs that report higher integrity should be preferred by the receiver";
CM_ BO_ 1128 "The BMU Estimator Status Message is sent from the  BMU Estimator to the FCC every 100 ms to update BMU Estimator status";
CM_ BO_ 1189 "The BMU Controller Status Message is sent from the  BMU Controller to the FCC every 100 ms to update BMU Controller status";
CM_ BO_ 719 "The EEC Status Slow Message is sent from the EEC to the FCC every 100 ms to update EEC status";
CM_ SG_ 719 EEC_StowingAvailable "0 = Not Faulted, 1 = Faulted";
CM_ BO_ 723 "The EEC Status Slow Message is sent from the EEC to the FCC every 100 ms to update EEC status";
CM_ SG_ 723 EEC_StowingAvailable "0 = Not Faulted, 1 = Faulted";
CM_ BO_ 726 "The EEC Status Slow Message is sent from the EEC to the FCC every 100 ms to update EEC status";
CM_ SG_ 726 EEC_StowingAvailable "0 = Not Faulted, 1 = Faulted";
CM_ BO_ 730 "The EEC Status Slow Message is sent from the EEC to the FCC every 100 ms to update EEC status";
CM_ SG_ 730 EEC_StowingAvailable "0 = Not Faulted, 1 = Faulted";
CM_ BO_ 655 "The EEC Status Fast Message is sent from the EEC to the FCC every 10 ms to update EEC status";
CM_ SG_ 655 EEC_TorqueControl_Fault "0 - Not Faulted, 1 = Faulted
EEC is not able to control torque as commanded.";
CM_ SG_ 655 EEC_PhaseShort_Fault "0 = Not Faulted, 1 = Faulted";
CM_ SG_ 655 EEC_MCU_Mismatch_Fault "0 = Not Faulted, 1 = Faulted";
CM_ SG_ 655 EEC_TPHS_Fault "0 = Not Faulted, 1 = Faulted";
CM_ SG_ 655 EEC_ProtectionActive "0 = Inactive, 1 = Active";
CM_ BO_ 659 "The EEC Status Fast Message is sent from the EEC to the FCC every 10 ms to update EEC status";
CM_ SG_ 659 EEC_TorqueControl_Fault "0 - Not Faulted, 1 = Faulted
EEC is not able to control torque as commanded.";
CM_ SG_ 659 EEC_PhaseShort_Fault "0 = Not Faulted, 1 = Faulted";
CM_ SG_ 659 EEC_MCU_Mismatch_Fault "0 = Not Faulted, 1 = Faulted";
CM_ SG_ 659 EEC_TPHS_Fault "0 = Not Faulted, 1 = Faulted";
CM_ SG_ 659 EEC_ProtectionActive "0 = Inactive, 1 = Active";
CM_ BO_ 662 "The EEC Status Fast Message is sent from the EEC to the FCC every 10 ms to update EEC status";
CM_ SG_ 662 EEC_TorqueControl_Fault "0 - Not Faulted, 1 = Faulted
EEC is not able to control torque as commanded.";
CM_ SG_ 662 EEC_PhaseShort_Fault "0 = Not Faulted, 1 = Faulted";
CM_ SG_ 662 EEC_MCU_Mismatch_Fault "0 = Not Faulted, 1 = Faulted";
CM_ SG_ 662 EEC_TPHS_Fault "0 = Not Faulted, 1 = Faulted";
CM_ SG_ 662 EEC_ProtectionActive "0 = Inactive, 1 = Active";
BA_DEF_ BO_  "VFrameFormat" ENUM  "StandardCAN","ExtendedCAN","reserved","reserved","reserved","reserved","reserved","reserved","reserved","reserved","reserved","reserved","reserved","reserved","StandardCAN_FD","ExtendedCAN_FD";
BA_DEF_  "BusType" STRING ;
BA_DEF_ BO_  "GenMsgCycleTime" INT 0 65535;
BA_DEF_ SG_  "GenSigStartValue" FLOAT 0 100000000000;
BA_DEF_DEF_  "VFrameFormat" "0";
BA_DEF_DEF_  "BusType" "";
BA_DEF_DEF_  "GenMsgCycleTime" 0;
BA_DEF_DEF_  "GenSigStartValue" 0;
BA_ "BusType" "CAN FD";
BA_ "VFrameFormat" BO_ 2047 14;
BA_ "GenSigStartValue" SG_ 2047 COM_MaintCmd 238;
BA_ "VFrameFormat" BO_ 1186 14;
BA_ "GenSigStartValue" SG_ 1186 BMU_Mate_DchgPwr10sHiFi 1023.0;
BA_ "GenSigStartValue" SG_ 1186 BMU_Mate_DchgPwr2sHiFi 1023.0;
BA_ "GenSigStartValue" SG_ 1186 BMU_DchgPwr10sLoFi 1023.0;
BA_ "GenSigStartValue" SG_ 1186 BMU_DchgPwr2sLoFi 1023.0;
BA_ "VFrameFormat" BO_ 720 14;
BA_ "GenSigStartValue" SG_ 720 EEC_MaxPowerTimeLimit 10.0;
BA_ "GenSigStartValue" SG_ 720 EEC_TakeoffTimeLimit 10.0;
BA_ "GenSigStartValue" SG_ 720 EEC_StatorWindingTemp 50.0;
BA_ "GenSigStartValue" SG_ 720 EEC_OilTemp 50.0;
BA_ "GenSigStartValue" SG_ 720 EEC_ControllerTemp 50.0;
BA_ "GenSigStartValue" SG_ 720 EEC_HVCurrent 500.0;
BA_ "VFrameFormat" BO_ 722 14;
BA_ "GenSigStartValue" SG_ 722 EEC_MaxPowerTimeLimit 10.0;
BA_ "GenSigStartValue" SG_ 722 EEC_TakeoffTimeLimit 10.0;
BA_ "GenSigStartValue" SG_ 722 EEC_StatorWindingTemp 50.0;
BA_ "GenSigStartValue" SG_ 722 EEC_OilTemp 50.0;
BA_ "GenSigStartValue" SG_ 722 EEC_ControllerTemp 50.0;
BA_ "GenSigStartValue" SG_ 722 EEC_HVCurrent 500.0;
BA_ "VFrameFormat" BO_ 727 14;
BA_ "GenSigStartValue" SG_ 727 EEC_MaxPowerTimeLimit 10.0;
BA_ "GenSigStartValue" SG_ 727 EEC_TakeoffTimeLimit 10.0;
BA_ "GenSigStartValue" SG_ 727 EEC_StatorWindingTemp 50.0;
BA_ "GenSigStartValue" SG_ 727 EEC_OilTemp 50.0;
BA_ "GenSigStartValue" SG_ 727 EEC_ControllerTemp 50.0;
BA_ "GenSigStartValue" SG_ 727 EEC_HVCurrent 500.0;
BA_ "VFrameFormat" BO_ 729 14;
BA_ "GenSigStartValue" SG_ 729 EEC_MaxPowerTimeLimit 10.0;
BA_ "GenSigStartValue" SG_ 729 EEC_TakeoffTimeLimit 10.0;
BA_ "GenSigStartValue" SG_ 729 EEC_StatorWindingTemp 50.0;
BA_ "GenSigStartValue" SG_ 729 EEC_OilTemp 50.0;
BA_ "GenSigStartValue" SG_ 729 EEC_ControllerTemp 50.0;
BA_ "GenSigStartValue" SG_ 729 EEC_HVCurrent 500.0;
BA_ "VFrameFormat" BO_ 656 14;
BA_ "VFrameFormat" BO_ 658 14;
BA_ "VFrameFormat" BO_ 663 14;
BA_ "VFrameFormat" BO_ 665 14;
BA_ "VFrameFormat" BO_ 65 14;
BA_ "VFrameFormat" BO_ 1948 14;
BA_ "VFrameFormat" BO_ 1950 14;
BA_ "VFrameFormat" BO_ 1954 14;
BA_ "VFrameFormat" BO_ 1960 14;
BA_ "VFrameFormat" BO_ 1925 14;
BA_ "VFrameFormat" BO_ 1930 14;
BA_ "VFrameFormat" BO_ 1933 14;
BA_ "VFrameFormat" BO_ 1936 14;
BA_ "VFrameFormat" BO_ 1938 14;
BA_ "VFrameFormat" BO_ 1943 14;
BA_ "VFrameFormat" BO_ 1945 14;
BA_ "VFrameFormat" BO_ 965 14;
BA_ "GenSigStartValue" SG_ 965 CSA_OutputPosition_Monitor 1.0;
BA_ "VFrameFormat" BO_ 970 14;
BA_ "GenSigStartValue" SG_ 970 CSA_OutputPosition_Monitor 1.0;
BA_ "VFrameFormat" BO_ 973 14;
BA_ "GenSigStartValue" SG_ 973 CSA_OutputPosition_Monitor 1.0;
BA_ "VFrameFormat" BO_ 129 14;
BA_ "VFrameFormat" BO_ 193 14;
BA_ "VFrameFormat" BO_ 1052 14;
BA_ "GenSigStartValue" SG_ 1052 TPAC_ForceEstimate 100.0;
BA_ "VFrameFormat" BO_ 1054 14;
BA_ "GenSigStartValue" SG_ 1054 TPAC_ForceEstimate 100.0;
BA_ "VFrameFormat" BO_ 1345 14;
BA_ "GenSigStartValue" SG_ 1345 FCC_OutsideAirTemp 40.0;
BA_ "VFrameFormat" BO_ 257 14;
BA_ "VFrameFormat" BO_ 1128 14;
BA_ "GenSigStartValue" SG_ 1128 BMU_DchgPwr10sHiFi 1023.0;
BA_ "GenSigStartValue" SG_ 1128 BMU_DchgPwr2sHiFi 1023.0;
BA_ "GenSigStartValue" SG_ 1128 BMU_CellBlockMaxTemp 50.0;
BA_ "GenSigStartValue" SG_ 1128 BMU_CellBlockMinTemp 50.0;
BA_ "VFrameFormat" BO_ 1189 14;
BA_ "GenSigStartValue" SG_ 1189 BMU_Mate_DchgPwr10sHiFi 1023.0;
BA_ "GenSigStartValue" SG_ 1189 BMU_Mate_DchgPwr2sHiFi 1023.0;
BA_ "GenSigStartValue" SG_ 1189 BMU_DchgPwr10sLoFi 1023.0;
BA_ "GenSigStartValue" SG_ 1189 BMU_DchgPwr2sLoFi 1023.0;
BA_ "VFrameFormat" BO_ 719 14;
BA_ "GenSigStartValue" SG_ 719 EEC_MaxPowerTimeLimit 10.0;
BA_ "GenSigStartValue" SG_ 719 EEC_TakeoffTimeLimit 10.0;
BA_ "GenSigStartValue" SG_ 719 EEC_StatorWindingTemp 50.0;
BA_ "GenSigStartValue" SG_ 719 EEC_OilTemp 50.0;
BA_ "GenSigStartValue" SG_ 719 EEC_ControllerTemp 50.0;
BA_ "GenSigStartValue" SG_ 719 EEC_HVCurrent 500.0;
BA_ "VFrameFormat" BO_ 723 14;
BA_ "GenSigStartValue" SG_ 723 EEC_MaxPowerTimeLimit 10.0;
BA_ "GenSigStartValue" SG_ 723 EEC_TakeoffTimeLimit 10.0;
BA_ "GenSigStartValue" SG_ 723 EEC_StatorWindingTemp 50.0;
BA_ "GenSigStartValue" SG_ 723 EEC_OilTemp 50.0;
BA_ "GenSigStartValue" SG_ 723 EEC_ControllerTemp 50.0;
BA_ "GenSigStartValue" SG_ 723 EEC_HVCurrent 500.0;
BA_ "VFrameFormat" BO_ 726 14;
BA_ "GenSigStartValue" SG_ 726 EEC_MaxPowerTimeLimit 10.0;
BA_ "GenSigStartValue" SG_ 726 EEC_TakeoffTimeLimit 10.0;
BA_ "GenSigStartValue" SG_ 726 EEC_StatorWindingTemp 50.0;
BA_ "GenSigStartValue" SG_ 726 EEC_OilTemp 50.0;
BA_ "GenSigStartValue" SG_ 726 EEC_ControllerTemp 50.0;
BA_ "GenSigStartValue" SG_ 726 EEC_HVCurrent 500.0;
BA_ "VFrameFormat" BO_ 730 14;
BA_ "GenSigStartValue" SG_ 730 EEC_MaxPowerTimeLimit 10.0;
BA_ "GenSigStartValue" SG_ 730 EEC_TakeoffTimeLimit 10.0;
BA_ "GenSigStartValue" SG_ 730 EEC_StatorWindingTemp 50.0;
BA_ "GenSigStartValue" SG_ 730 EEC_OilTemp 50.0;
BA_ "GenSigStartValue" SG_ 730 EEC_ControllerTemp 50.0;
BA_ "GenSigStartValue" SG_ 730 EEC_HVCurrent 500.0;
BA_ "VFrameFormat" BO_ 655 14;
BA_ "VFrameFormat" BO_ 659 14;
BA_ "VFrameFormat" BO_ 662 14;
BA_ "GenMsgCycleTime" BO_ 65 10;
VAL_ 2047 eec_maint_command 0 "EEC_STATE_MAINT_CMD_STANDBY" 1 "EEC_STATE_MAINT_CMD_TORQUE_CTRL" 2 "EEC_STATE_MAINT_CMD_MAX_STOW" 3 "EEC_STATE_MAINT_CMD_MIN_STOW" 4 "EEC_STATE_MAINT_CMD_RESIST_WINDMILL" 5 "EEC_STATE_MAINT_CMD_ACTIVE_DISCHARGE" 6 "EEC_STATE_MAINT_CMD_SPEED_CTRL" 7 "EEC_STATE_MAINT_CMD_CURRENT_CTRL" 8 "EEC_STATE_MAINT_CMD_VOLTAGE_CTRL" ;
VAL_ 2047 COM_MaintCmd 0 "NO_MAINT_REQUEST" 1 "REQUEST_QUIET_MODE" 2 "REQUEST_SW_UPLOAD_A" 3 "REQUEST_SW_UPLOAD_B" 4 "REQUEST_SW_DOWNLOAD_A" 5 "REQUEST_SW_DOWNLOAD_B" 238 "EEC_CMD_FUNCTION" ;
VAL_ 1186 BMU_Mate_PackTempAlert 1 "ERROR" 0 "NO_ERROR" ;
VAL_ 1186 BMU_Mate_PackHiTempAlert 1 "ERROR" 0 "NO_ERROR" ;
VAL_ 1186 BMU_Mate_PackOverheatAlert 1 "ERROR" 0 "NO_ERROR" ;
VAL_ 1186 BMU_Mate_EstHVPSDegradedAlert 1 "ERROR" 0 "NO_ERROR" ;
VAL_ 1186 BMU_Mate_CtrlHVPSDegradedAlert 1 "ERROR" 0 "NO_ERROR" ;
VAL_ 1186 BMU_Mate_PackHVExposedAlert 1 "ERROR" 0 "NO_ERROR" ;
VAL_ 1186 BMU_Mate_HVPSFaultAlert 1 "ERROR" 0 "NO_ERROR" ;
VAL_ 1186 BMU_Mate_HVPSImbalanceAlert 1 "ERROR" 0 "NO_ERROR" ;
VAL_ 1186 BMU_PackPyroStatus 3 "RESERVED" 2 "CLOSED" 1 "OPEN" 0 "INVALID" ;
VAL_ 1186 BMU_PackHVExposedAlert 1 "ERROR" 0 "NO_ERROR" ;
VAL_ 1186 BMU_CtrlHVPSDegradedAlert 1 "ERROR" 0 "NO_ERROR" ;
VAL_ 1186 BMU_HVPSFaultAlert 1 "ERROR" 0 "NO_ERROR" ;
VAL_ 1186 BMU_HVPSImbalanceAlert 1 "ERROR" 0 "NO_ERROR" ;
VAL_ 1186 BMU_PropMinBusVoltageFault 1 "ERROR" 0 "NO_ERROR" ;
VAL_ 1186 BMU_ECSMinBusVoltageFault 1 "ERROR" 0 "NO_ERROR" ;
VAL_ 1186 BMU_ThermalPlugStatus 3 "RESERVED" 2 "CONNECTED" 1 "DISCONNECTED" 0 "INVALID" ;
VAL_ 1186 BMU_ChargePlugStatus 3 "RESERVED" 2 "CONNECTED" 1 "DISCONNECTED" 0 "INVALID" ;
VAL_ 1186 BMU_ChargeStatus 2 "NOT CHARGING" 1 "CHARGING" 0 "INVALID" ;
VAL_ 1186 BMU_CCUModeSwitchPosition 2 "GND" 1 "SVCE" 0 "INVALID" ;
VAL_ 1186 BMU_XlinkLSPyroStatus 3 "RESERVED" 2 "CLOSED" 1 "OPEN" 0 "INVALID" ;
VAL_ 1186 BMU_XlinkHSPyroStatus 3 "RESERVED" 2 "CLOSED" 1 "OPEN" 0 "INVALID" ;
VAL_ 1186 BMU_EE2PyroStatus 3 "RESERVED" 2 "CLOSED" 1 "OPEN" 0 "INVALID" ;
VAL_ 1186 BMU_EE1PyroStatus 3 "RESERVED" 2 "CLOSED" 1 "OPEN" 0 "INVALID" ;
VAL_ 1186 BMU_AuxCurrent_Validity 3 "RESERVED" 2 "VALID" 1 "DEGRADED" 0 "INVALID" ;
VAL_ 1186 BMU_PropBusConnectionState 5 "HV_FAULT" 4 "HV_READY_CLOSED" 3 "HV_CLOSING" 2 "HV_OPENING" 1 "HV_OPEN" 0 "HV_UNKNOWN" ;
VAL_ 1186 BMU_MainBusConnectionState 5 "HV_FAULT" 4 "HV_READY_CLOSED" 3 "HV_CLOSING" 2 "HV_OPENING" 1 "HV_OPEN" 0 "HV_UNKNOWN" ;
VAL_ 1186 BMU_Mate_ChgPwr2sHiFi_Validity 3 "RESERVED" 2 "VALID" 1 "DEGRADED" 0 "INVALID" ;
VAL_ 1186 BMU_Mate_ChgPwr10sHiFi_Validity 3 "RESERVED" 2 "VALID" 1 "DEGRADED" 0 "INVALID" ;
VAL_ 1186 BMU_ChgPwr2sLoFi_Validity 3 "RESERVED" 2 "VALID" 1 "DEGRADED" 0 "INVALID" ;
VAL_ 1186 BMU_ChgPwr10sLoFi_Validity 3 "RESERVED" 2 "VALID" 1 "DEGRADED" 0 "INVALID" ;
VAL_ 1186 BMU_CLEnergyLoFi_Validity 3 "RESERVED" 2 "VALID" 1 "DEGRADED" 0 "INVALID" ;
VAL_ 1186 BMU_VLEnergyLoFi_Validity 3 "RESERVED" 2 "VALID" 1 "DEGRADED" 0 "INVALID" ;
VAL_ 1186 BMU_MaxAvailEnergyLoFi_Validity 3 "RESERVED" 2 "VALID" 1 "DEGRADED" 0 "INVALID" ;
VAL_ 1186 BMU_RemainingEnergyLoFi_Validity 3 "RESERVED" 2 "VALID" 1 "DEGRADED" 0 "INVALID" ;
VAL_ 1186 BMU_ChargeTimeRemaining_Validity 3 "RESERVED" 2 "VALID" 1 "DEGRADED" 0 "INVALID" ;
VAL_ 1186 BMU_ChargeCurrent_Validity 3 "RESERVED" 2 "VALID" 1 "DEGRADED" 0 "INVALID" ;
VAL_ 1186 BMU_ChargerVoltage_Validity 3 "RESERVED" 2 "VALID" 1 "DEGRADED" 0 "INVALID" ;
VAL_ 1186 BMU_Mate_DchgPwr10sHiFi_Validity 3 "RESERVED" 2 "VALID" 1 "DEGRADED" 0 "INVALID" ;
VAL_ 1186 BMU_Mate_DchgPwr2sHiFi_Validity 3 "RESERVED" 2 "VALID" 1 "DEGRADED" 0 "INVALID" ;
VAL_ 1186 BMU_DchgPwr10sLoFi_Validity 3 "RESERVED" 2 "VALID" 1 "DEGRADED" 0 "INVALID" ;
VAL_ 1186 BMU_DchgPwr2sLoFi_Validity 3 "RESERVED" 2 "VALID" 1 "DEGRADED" 0 "INVALID" ;
VAL_ 1186 BMU_EE2Current_Validity 3 "RESERVED" 2 "VALID" 1 "DEGRADED" 0 "INVALID" ;
VAL_ 1186 BMU_EE1Current_Validity 3 "RESERVED" 2 "VALID" 1 "DEGRADED" 0 "INVALID" ;
VAL_ 1186 BMU_XlinkCurrent_Validity 3 "RESERVED" 2 "VALID" 1 "DEGRADED" 0 "INVALID" ;
VAL_ 1186 BMU_PropBusVoltage_Validity 3 "RESERVED" 2 "VALID" 1 "DEGRADED" 0 "INVALID" ;
VAL_ 1186 BMU_CellStackVoltage_Validity 3 "RESERVED" 2 "VALID" 1 "DEGRADED" 0 "INVALID" ;
VAL_ 720 EEC_RBCmdValidity 3 "ROLLING_COUNTER_FAIL" 2 "E2E_CRC16_FAIL" 1 "CMD_TIMEOUT" 0 "MESSAGE_AND_DATA_VALID" ;
VAL_ 720 EEC_RACmdValidity 3 "ROLLING_COUNTER_FAIL" 2 "E2E_CRC16_FAIL" 1 "CMD_TIMEOUT" 0 "MESSAGE_AND_DATA_VALID" ;
VAL_ 720 EEC_LBCmdValidity 3 "ROLLING_COUNTER_FAIL" 2 "E2E_CRC16_FAIL" 1 "CMD_TIMEOUT" 0 "MESSAGE_AND_DATA_VALID" ;
VAL_ 720 EEC_LACmdValidity 3 "ROLLING_COUNTER_FAIL" 2 "E2E_CRC16_FAIL" 1 "CMD_TIMEOUT" 0 "MESSAGE_AND_DATA_VALID" ;
VAL_ 720 EEC_StowingAvailable 1 "TRUE" 0 "FALSE" ;
VAL_ 720 EEC_MaxPowerTimeLimit_Validity 3 "RESERVED" 2 "VALID" 1 "DEGRADED" 0 "INVALID" ;
VAL_ 720 EEC_TakeoffTimeLimit_Validity 3 "RESERVED" 2 "VALID" 1 "DEGRADED" 0 "INVALID" ;
VAL_ 720 EEC_ConsolidatedTemp_Validity 3 "RESERVED" 2 "VALID" 1 "DEGRADED" 0 "INVALID" ;
VAL_ 720 EEC_StatorWindingTemp_Validity 3 "RESERVED" 2 "VALID" 1 "DEGRADED" 0 "INVALID" ;
VAL_ 720 EEC_OilTemp_Validity 3 "RESERVED" 2 "VALID" 1 "DEGRADED" 0 "INVALID" ;
VAL_ 720 EEC_ControllerTemp_Validity 3 "RESERVED" 2 "VALID" 1 "DEGRADED" 0 "INVALID" ;
VAL_ 720 EEC_HVInputVoltage_Validity 3 "RESERVED" 2 "VALID" 1 "DEGRADED" 0 "INVALID" ;
VAL_ 720 EEC_HVCurrent_Validity 3 "RESERVED" 2 "VALID" 1 "DEGRADED" 0 "INVALID" ;
VAL_ 722 EEC_RBCmdValidity 3 "ROLLING_COUNTER_FAIL" 2 "E2E_CRC16_FAIL" 1 "CMD_TIMEOUT" 0 "MESSAGE_AND_DATA_VALID" ;
VAL_ 722 EEC_RACmdValidity 3 "ROLLING_COUNTER_FAIL" 2 "E2E_CRC16_FAIL" 1 "CMD_TIMEOUT" 0 "MESSAGE_AND_DATA_VALID" ;
VAL_ 722 EEC_LBCmdValidity 3 "ROLLING_COUNTER_FAIL" 2 "E2E_CRC16_FAIL" 1 "CMD_TIMEOUT" 0 "MESSAGE_AND_DATA_VALID" ;
VAL_ 722 EEC_LACmdValidity 3 "ROLLING_COUNTER_FAIL" 2 "E2E_CRC16_FAIL" 1 "CMD_TIMEOUT" 0 "MESSAGE_AND_DATA_VALID" ;
VAL_ 722 EEC_StowingAvailable 1 "TRUE" 0 "FALSE" ;
VAL_ 722 EEC_MaxPowerTimeLimit_Validity 3 "RESERVED" 2 "VALID" 1 "DEGRADED" 0 "INVALID" ;
VAL_ 722 EEC_TakeoffTimeLimit_Validity 3 "RESERVED" 2 "VALID" 1 "DEGRADED" 0 "INVALID" ;
VAL_ 722 EEC_ConsolidatedTemp_Validity 3 "RESERVED" 2 "VALID" 1 "DEGRADED" 0 "INVALID" ;
VAL_ 722 EEC_StatorWindingTemp_Validity 3 "RESERVED" 2 "VALID" 1 "DEGRADED" 0 "INVALID" ;
VAL_ 722 EEC_OilTemp_Validity 3 "RESERVED" 2 "VALID" 1 "DEGRADED" 0 "INVALID" ;
VAL_ 722 EEC_ControllerTemp_Validity 3 "RESERVED" 2 "VALID" 1 "DEGRADED" 0 "INVALID" ;
VAL_ 722 EEC_HVInputVoltage_Validity 3 "RESERVED" 2 "VALID" 1 "DEGRADED" 0 "INVALID" ;
VAL_ 722 EEC_HVCurrent_Validity 3 "RESERVED" 2 "VALID" 1 "DEGRADED" 0 "INVALID" ;
VAL_ 727 EEC_RBCmdValidity 3 "ROLLING_COUNTER_FAIL" 2 "E2E_CRC16_FAIL" 1 "CMD_TIMEOUT" 0 "MESSAGE_AND_DATA_VALID" ;
VAL_ 727 EEC_RACmdValidity 3 "ROLLING_COUNTER_FAIL" 2 "E2E_CRC16_FAIL" 1 "CMD_TIMEOUT" 0 "MESSAGE_AND_DATA_VALID" ;
VAL_ 727 EEC_LBCmdValidity 3 "ROLLING_COUNTER_FAIL" 2 "E2E_CRC16_FAIL" 1 "CMD_TIMEOUT" 0 "MESSAGE_AND_DATA_VALID" ;
VAL_ 727 EEC_LACmdValidity 3 "ROLLING_COUNTER_FAIL" 2 "E2E_CRC16_FAIL" 1 "CMD_TIMEOUT" 0 "MESSAGE_AND_DATA_VALID" ;
VAL_ 727 EEC_StowingAvailable 1 "TRUE" 0 "FALSE" ;
VAL_ 727 EEC_MaxPowerTimeLimit_Validity 3 "RESERVED" 2 "VALID" 1 "DEGRADED" 0 "INVALID" ;
VAL_ 727 EEC_TakeoffTimeLimit_Validity 3 "RESERVED" 2 "VALID" 1 "DEGRADED" 0 "INVALID" ;
VAL_ 727 EEC_ConsolidatedTemp_Validity 3 "RESERVED" 2 "VALID" 1 "DEGRADED" 0 "INVALID" ;
VAL_ 727 EEC_StatorWindingTemp_Validity 3 "RESERVED" 2 "VALID" 1 "DEGRADED" 0 "INVALID" ;
VAL_ 727 EEC_OilTemp_Validity 3 "RESERVED" 2 "VALID" 1 "DEGRADED" 0 "INVALID" ;
VAL_ 727 EEC_ControllerTemp_Validity 3 "RESERVED" 2 "VALID" 1 "DEGRADED" 0 "INVALID" ;
VAL_ 727 EEC_HVInputVoltage_Validity 3 "RESERVED" 2 "VALID" 1 "DEGRADED" 0 "INVALID" ;
VAL_ 727 EEC_HVCurrent_Validity 3 "RESERVED" 2 "VALID" 1 "DEGRADED" 0 "INVALID" ;
VAL_ 729 EEC_RBCmdValidity 3 "ROLLING_COUNTER_FAIL" 2 "E2E_CRC16_FAIL" 1 "CMD_TIMEOUT" 0 "MESSAGE_AND_DATA_VALID" ;
VAL_ 729 EEC_RACmdValidity 3 "ROLLING_COUNTER_FAIL" 2 "E2E_CRC16_FAIL" 1 "CMD_TIMEOUT" 0 "MESSAGE_AND_DATA_VALID" ;
VAL_ 729 EEC_LBCmdValidity 3 "ROLLING_COUNTER_FAIL" 2 "E2E_CRC16_FAIL" 1 "CMD_TIMEOUT" 0 "MESSAGE_AND_DATA_VALID" ;
VAL_ 729 EEC_LACmdValidity 3 "ROLLING_COUNTER_FAIL" 2 "E2E_CRC16_FAIL" 1 "CMD_TIMEOUT" 0 "MESSAGE_AND_DATA_VALID" ;
VAL_ 729 EEC_StowingAvailable 1 "TRUE" 0 "FALSE" ;
VAL_ 729 EEC_MaxPowerTimeLimit_Validity 3 "RESERVED" 2 "VALID" 1 "DEGRADED" 0 "INVALID" ;
VAL_ 729 EEC_TakeoffTimeLimit_Validity 3 "RESERVED" 2 "VALID" 1 "DEGRADED" 0 "INVALID" ;
VAL_ 729 EEC_ConsolidatedTemp_Validity 3 "RESERVED" 2 "VALID" 1 "DEGRADED" 0 "INVALID" ;
VAL_ 729 EEC_StatorWindingTemp_Validity 3 "RESERVED" 2 "VALID" 1 "DEGRADED" 0 "INVALID" ;
VAL_ 729 EEC_OilTemp_Validity 3 "RESERVED" 2 "VALID" 1 "DEGRADED" 0 "INVALID" ;
VAL_ 729 EEC_ControllerTemp_Validity 3 "RESERVED" 2 "VALID" 1 "DEGRADED" 0 "INVALID" ;
VAL_ 729 EEC_HVInputVoltage_Validity 3 "RESERVED" 2 "VALID" 1 "DEGRADED" 0 "INVALID" ;
VAL_ 729 EEC_HVCurrent_Validity 3 "RESERVED" 2 "VALID" 1 "DEGRADED" 0 "INVALID" ;
VAL_ 656 EEC_PhaseShort_Fault 1 "FAULTED" 0 "NOT FAULTED" ;
VAL_ 656 EEC_FCSOverrideLimitsFeedback 3 "RESERVED" 2 "EEC_PROTECTIONS_INACTIVE" 1 "EEC_PROTECTIONS_ACTIVE" 0 "INVALID" ;
VAL_ 656 EEC_IBIT_Status 3 "IBIT_PASS" 2 "IBIT_FAIL" 1 "IBIT_INPROGRESS" 0 "IBIT_IDLE" ;
VAL_ 656 EEC_PrimaryMCU 1 "MCU_B" 0 "MCU_A" ;
VAL_ 656 EEC_SelectedFCC 3 "RB" 2 "RA" 1 "LB" 0 "LA" ;
VAL_ 656 EEC_StateFeedback 13 "EEC_STATE_ENGINE_SPINDOWN" 12 "EEC_STATE_ENGINE_WARMING" 11 "EEC_STATE_ENGINE_COOLING" 10 "EEC_STATE_RESIST_WINDMILL" 9 "EEC_STATE_MAINT" 8 "EEC_STATE_FAULT" 7 "EEC_STATE_ACTIVE_DISCHARGE" 6 "EEC_STATE_MIN_DRAG_STOW" 5 "EEC_STATE_MAX_DRAG_STOW" 4 "EEC_STATE_STOWING" 3 "EEC_STATE_ENABLE" 2 "EEC_STATE_SPINUP" 1 "EEC_STATE_STANDBY" 0 "EEC_STATE_INIT" ;
VAL_ 656 EEC_OutputShaftTorque_Validity 3 "RESERVED" 2 "VALID" 1 "DEGRADED" 0 "INVALID" ;
VAL_ 656 EEC_PropellerRPM_Validity 3 "RESERVED" 2 "VALID" 1 "DEGRADED" 0 "INVALID" ;
VAL_ 658 EEC_PhaseShort_Fault 1 "FAULTED" 0 "NOT FAULTED" ;
VAL_ 658 EEC_FCSOverrideLimitsFeedback 3 "RESERVED" 2 "EEC_PROTECTIONS_INACTIVE" 1 "EEC_PROTECTIONS_ACTIVE" 0 "INVALID" ;
VAL_ 658 EEC_IBIT_Status 3 "IBIT_PASS" 2 "IBIT_FAIL" 1 "IBIT_INPROGRESS" 0 "IBIT_IDLE" ;
VAL_ 658 EEC_PrimaryMCU 1 "MCU_B" 0 "MCU_A" ;
VAL_ 658 EEC_SelectedFCC 3 "RB" 2 "RA" 1 "LB" 0 "LA" ;
VAL_ 658 EEC_StateFeedback 13 "EEC_STATE_ENGINE_SPINDOWN" 12 "EEC_STATE_ENGINE_WARMING" 11 "EEC_STATE_ENGINE_COOLING" 10 "EEC_STATE_RESIST_WINDMILL" 9 "EEC_STATE_MAINT" 8 "EEC_STATE_FAULT" 7 "EEC_STATE_ACTIVE_DISCHARGE" 6 "EEC_STATE_MIN_DRAG_STOW" 5 "EEC_STATE_MAX_DRAG_STOW" 4 "EEC_STATE_STOWING" 3 "EEC_STATE_ENABLE" 2 "EEC_STATE_SPINUP" 1 "EEC_STATE_STANDBY" 0 "EEC_STATE_INIT" ;
VAL_ 658 EEC_OutputShaftTorque_Validity 3 "RESERVED" 2 "VALID" 1 "DEGRADED" 0 "INVALID" ;
VAL_ 658 EEC_PropellerRPM_Validity 3 "RESERVED" 2 "VALID" 1 "DEGRADED" 0 "INVALID" ;
VAL_ 663 EEC_PhaseShort_Fault 1 "FAULTED" 0 "NOT FAULTED" ;
VAL_ 663 EEC_FCSOverrideLimitsFeedback 3 "RESERVED" 2 "EEC_PROTECTIONS_INACTIVE" 1 "EEC_PROTECTIONS_ACTIVE" 0 "INVALID" ;
VAL_ 663 EEC_IBIT_Status 3 "IBIT_PASS" 2 "IBIT_FAIL" 1 "IBIT_INPROGRESS" 0 "IBIT_IDLE" ;
VAL_ 663 EEC_PrimaryMCU 1 "MCU_B" 0 "MCU_A" ;
VAL_ 663 EEC_SelectedFCC 3 "RB" 2 "RA" 1 "LB" 0 "LA" ;
VAL_ 663 EEC_StateFeedback 13 "EEC_STATE_ENGINE_SPINDOWN" 12 "EEC_STATE_ENGINE_WARMING" 11 "EEC_STATE_ENGINE_COOLING" 10 "EEC_STATE_RESIST_WINDMILL" 9 "EEC_STATE_MAINT" 8 "EEC_STATE_FAULT" 7 "EEC_STATE_ACTIVE_DISCHARGE" 6 "EEC_STATE_MIN_DRAG_STOW" 5 "EEC_STATE_MAX_DRAG_STOW" 4 "EEC_STATE_STOWING" 3 "EEC_STATE_ENABLE" 2 "EEC_STATE_SPINUP" 1 "EEC_STATE_STANDBY" 0 "EEC_STATE_INIT" ;
VAL_ 663 EEC_OutputShaftTorque_Validity 3 "RESERVED" 2 "VALID" 1 "DEGRADED" 0 "INVALID" ;
VAL_ 663 EEC_PropellerRPM_Validity 3 "RESERVED" 2 "VALID" 1 "DEGRADED" 0 "INVALID" ;
VAL_ 665 EEC_PhaseShort_Fault 1 "FAULTED" 0 "NOT FAULTED" ;
VAL_ 665 EEC_FCSOverrideLimitsFeedback 3 "RESERVED" 2 "EEC_PROTECTIONS_INACTIVE" 1 "EEC_PROTECTIONS_ACTIVE" 0 "INVALID" ;
VAL_ 665 EEC_IBIT_Status 3 "IBIT_PASS" 2 "IBIT_FAIL" 1 "IBIT_INPROGRESS" 0 "IBIT_IDLE" ;
VAL_ 665 EEC_PrimaryMCU 1 "MCU_B" 0 "MCU_A" ;
VAL_ 665 EEC_SelectedFCC 3 "RB" 2 "RA" 1 "LB" 0 "LA" ;
VAL_ 665 EEC_StateFeedback 13 "EEC_STATE_ENGINE_SPINDOWN" 12 "EEC_STATE_ENGINE_WARMING" 11 "EEC_STATE_ENGINE_COOLING" 10 "EEC_STATE_RESIST_WINDMILL" 9 "EEC_STATE_MAINT" 8 "EEC_STATE_FAULT" 7 "EEC_STATE_ACTIVE_DISCHARGE" 6 "EEC_STATE_MIN_DRAG_STOW" 5 "EEC_STATE_MAX_DRAG_STOW" 4 "EEC_STATE_STOWING" 3 "EEC_STATE_ENABLE" 2 "EEC_STATE_SPINUP" 1 "EEC_STATE_STANDBY" 0 "EEC_STATE_INIT" ;
VAL_ 665 EEC_OutputShaftTorque_Validity 3 "RESERVED" 2 "VALID" 1 "DEGRADED" 0 "INVALID" ;
VAL_ 665 EEC_PropellerRPM_Validity 3 "RESERVED" 2 "VALID" 1 "DEGRADED" 0 "INVALID" ;
VAL_ 65 EEC_NotFly 1 "TRUE" 0 "FALSE" ;
VAL_ 65 EEC12_StateCmd 8 "EEC_CMD_ENGINE_WARMING" 7 "EEC_CMD_ENGINE_COOLING" 6 "EEC_CMD_RESIST_WINDMILL" 5 "EEC_CMD_MAINTENANCE" 4 "EEC_CMD_ACTIVE_DISCHARGE" 3 "EEC_CMD_MIN_DRAG_STOW" 2 "EEC_CMD_MAX_DRAG_STOW" 1 "EEC_CMD_ENABLE" 0 "EEC_CMD_STANDBY" ;
VAL_ 65 EEC11_StateCmd 8 "EEC_CMD_ENGINE_WARMING" 7 "EEC_CMD_ENGINE_COOLING" 6 "EEC_CMD_RESIST_WINDMILL" 5 "EEC_CMD_MAINTENANCE" 4 "EEC_CMD_ACTIVE_DISCHARGE" 3 "EEC_CMD_MIN_DRAG_STOW" 2 "EEC_CMD_MAX_DRAG_STOW" 1 "EEC_CMD_ENABLE" 0 "EEC_CMD_STANDBY" ;
VAL_ 65 EEC10_StateCmd 8 "EEC_CMD_ENGINE_WARMING" 7 "EEC_CMD_ENGINE_COOLING" 6 "EEC_CMD_RESIST_WINDMILL" 5 "EEC_CMD_MAINTENANCE" 4 "EEC_CMD_ACTIVE_DISCHARGE" 3 "EEC_CMD_MIN_DRAG_STOW" 2 "EEC_CMD_MAX_DRAG_STOW" 1 "EEC_CMD_ENABLE" 0 "EEC_CMD_STANDBY" ;
VAL_ 65 EEC09_StateCmd 8 "EEC_CMD_ENGINE_WARMING" 7 "EEC_CMD_ENGINE_COOLING" 6 "EEC_CMD_RESIST_WINDMILL" 5 "EEC_CMD_MAINTENANCE" 4 "EEC_CMD_ACTIVE_DISCHARGE" 3 "EEC_CMD_MIN_DRAG_STOW" 2 "EEC_CMD_MAX_DRAG_STOW" 1 "EEC_CMD_ENABLE" 0 "EEC_CMD_STANDBY" ;
VAL_ 65 EEC08_StateCmd 8 "EEC_CMD_ENGINE_WARMING" 7 "EEC_CMD_ENGINE_COOLING" 6 "EEC_CMD_RESIST_WINDMILL" 5 "EEC_CMD_MAINTENANCE" 4 "EEC_CMD_ACTIVE_DISCHARGE" 3 "EEC_CMD_MIN_DRAG_STOW" 2 "EEC_CMD_MAX_DRAG_STOW" 1 "EEC_CMD_ENABLE" 0 "EEC_CMD_STANDBY" ;
VAL_ 65 EEC07_StateCmd 8 "EEC_CMD_ENGINE_WARMING" 7 "EEC_CMD_ENGINE_COOLING" 6 "EEC_CMD_RESIST_WINDMILL" 5 "EEC_CMD_MAINTENANCE" 4 "EEC_CMD_ACTIVE_DISCHARGE" 3 "EEC_CMD_MIN_DRAG_STOW" 2 "EEC_CMD_MAX_DRAG_STOW" 1 "EEC_CMD_ENABLE" 0 "EEC_CMD_STANDBY" ;
VAL_ 65 EEC06_StateCmd 8 "EEC_CMD_ENGINE_WARMING" 7 "EEC_CMD_ENGINE_COOLING" 6 "EEC_CMD_RESIST_WINDMILL" 5 "EEC_CMD_MAINTENANCE" 4 "EEC_CMD_ACTIVE_DISCHARGE" 3 "EEC_CMD_MIN_DRAG_STOW" 2 "EEC_CMD_MAX_DRAG_STOW" 1 "EEC_CMD_ENABLE" 0 "EEC_CMD_STANDBY" ;
VAL_ 65 EEC05_StateCmd 8 "EEC_CMD_ENGINE_WARMING" 7 "EEC_CMD_ENGINE_COOLING" 6 "EEC_CMD_RESIST_WINDMILL" 5 "EEC_CMD_MAINTENANCE" 4 "EEC_CMD_ACTIVE_DISCHARGE" 3 "EEC_CMD_MIN_DRAG_STOW" 2 "EEC_CMD_MAX_DRAG_STOW" 1 "EEC_CMD_ENABLE" 0 "EEC_CMD_STANDBY" ;
VAL_ 65 EEC04_StateCmd 8 "EEC_CMD_ENGINE_WARMING" 7 "EEC_CMD_ENGINE_COOLING" 6 "EEC_CMD_RESIST_WINDMILL" 5 "EEC_CMD_MAINTENANCE" 4 "EEC_CMD_ACTIVE_DISCHARGE" 3 "EEC_CMD_MIN_DRAG_STOW" 2 "EEC_CMD_MAX_DRAG_STOW" 1 "EEC_CMD_ENABLE" 0 "EEC_CMD_STANDBY" ;
VAL_ 65 EEC03_StateCmd 8 "EEC_CMD_ENGINE_WARMING" 7 "EEC_CMD_ENGINE_COOLING" 6 "EEC_CMD_RESIST_WINDMILL" 5 "EEC_CMD_MAINTENANCE" 4 "EEC_CMD_ACTIVE_DISCHARGE" 3 "EEC_CMD_MIN_DRAG_STOW" 2 "EEC_CMD_MAX_DRAG_STOW" 1 "EEC_CMD_ENABLE" 0 "EEC_CMD_STANDBY" ;
VAL_ 65 EEC02_StateCmd 8 "EEC_CMD_ENGINE_WARMING" 7 "EEC_CMD_ENGINE_COOLING" 6 "EEC_CMD_RESIST_WINDMILL" 5 "EEC_CMD_MAINTENANCE" 4 "EEC_CMD_ACTIVE_DISCHARGE" 3 "EEC_CMD_MIN_DRAG_STOW" 2 "EEC_CMD_MAX_DRAG_STOW" 1 "EEC_CMD_ENABLE" 0 "EEC_CMD_STANDBY" ;
VAL_ 65 EEC01_StateCmd 8 "EEC_CMD_ENGINE_WARMING" 7 "EEC_CMD_ENGINE_COOLING" 6 "EEC_CMD_RESIST_WINDMILL" 5 "EEC_CMD_MAINTENANCE" 4 "EEC_CMD_ACTIVE_DISCHARGE" 3 "EEC_CMD_MIN_DRAG_STOW" 2 "EEC_CMD_MAX_DRAG_STOW" 1 "EEC_CMD_ENABLE" 0 "EEC_CMD_STANDBY" ;
VAL_ 65 EEC12_HVAvailabilityStatus 1 "HV_AVAILABLE" 0 "HV_NOT_AVAILABLE" ;
VAL_ 65 EEC12_FCSOverrideLimitsCmd 3 "RESERVED" 2 "EEC_PROTECTIONS_INACTIVE" 1 "EEC_PROTECTIONS_ACTIVE" 0 "INVALID" ;
VAL_ 65 EEC11_HVAvailabilityStatus 1 "HV_AVAILABLE" 0 "HV_NOT_AVAILABLE" ;
VAL_ 65 EEC11_FCSOverrideLimitsCmd 3 "RESERVED" 2 "EEC_PROTECTIONS_INACTIVE" 1 "EEC_PROTECTIONS_ACTIVE" 0 "INVALID" ;
VAL_ 65 EEC10_HVAvailabilityStatus 1 "HV_AVAILABLE" 0 "HV_NOT_AVAILABLE" ;
VAL_ 65 EEC10_FCSOverrideLimitsCmd 3 "RESERVED" 2 "EEC_PROTECTIONS_INACTIVE" 1 "EEC_PROTECTIONS_ACTIVE" 0 "INVALID" ;
VAL_ 65 EEC09_HVAvailabilityStatus 1 "HV_AVAILABLE" 0 "HV_NOT_AVAILABLE" ;
VAL_ 65 EEC09_FCSOverrideLimitsCmd 3 "RESERVED" 2 "EEC_PROTECTIONS_INACTIVE" 1 "EEC_PROTECTIONS_ACTIVE" 0 "INVALID" ;
VAL_ 65 EEC08_HVAvailabilityStatus 1 "HV_AVAILABLE" 0 "HV_NOT_AVAILABLE" ;
VAL_ 65 EEC08_FCSOverrideLimitsCmd 3 "RESERVED" 2 "EEC_PROTECTIONS_INACTIVE" 1 "EEC_PROTECTIONS_ACTIVE" 0 "INVALID" ;
VAL_ 65 EEC07_HVAvailabilityStatus 1 "HV_AVAILABLE" 0 "HV_NOT_AVAILABLE" ;
VAL_ 65 EEC07_FCSOverrideLimitsCmd 3 "RESERVED" 2 "EEC_PROTECTIONS_INACTIVE" 1 "EEC_PROTECTIONS_ACTIVE" 0 "INVALID" ;
VAL_ 65 EEC06_HVAvailabilityStatus 1 "HV_AVAILABLE" 0 "HV_NOT_AVAILABLE" ;
VAL_ 65 EEC06_FCSOverrideLimitsCmd 3 "RESERVED" 2 "EEC_PROTECTIONS_INACTIVE" 1 "EEC_PROTECTIONS_ACTIVE" 0 "INVALID" ;
VAL_ 65 EEC05_HVAvailabilityStatus 1 "HV_AVAILABLE" 0 "HV_NOT_AVAILABLE" ;
VAL_ 65 EEC05_FCSOverrideLimitsCmd 3 "RESERVED" 2 "EEC_PROTECTIONS_INACTIVE" 1 "EEC_PROTECTIONS_ACTIVE" 0 "INVALID" ;
VAL_ 65 EEC04_HVAvailabilityStatus 1 "HV_AVAILABLE" 0 "HV_NOT_AVAILABLE" ;
VAL_ 65 EEC04_FCSOverrideLimitsCmd 3 "RESERVED" 2 "EEC_PROTECTIONS_INACTIVE" 1 "EEC_PROTECTIONS_ACTIVE" 0 "INVALID" ;
VAL_ 65 EEC03_HVAvailabilityStatus 1 "HV_AVAILABLE" 0 "HV_NOT_AVAILABLE" ;
VAL_ 65 EEC03_FCSOverrideLimitsCmd 3 "RESERVED" 2 "EEC_PROTECTIONS_INACTIVE" 1 "EEC_PROTECTIONS_ACTIVE" 0 "INVALID" ;
VAL_ 65 EEC02_HVAvailabilityStatus 1 "HV_AVAILABLE" 0 "HV_NOT_AVAILABLE" ;
VAL_ 65 EEC02_FCSOverrideLimitsCmd 3 "RESERVED" 2 "EEC_PROTECTIONS_INACTIVE" 1 "EEC_PROTECTIONS_ACTIVE" 0 "INVALID" ;
VAL_ 65 EEC01_HVAvailabilityStatus 1 "HV_AVAILABLE" 0 "HV_NOT_AVAILABLE" ;
VAL_ 65 EEC01_FCSOverrideLimitsCmd 3 "RESERVED" 2 "EEC_PROTECTIONS_INACTIVE" 1 "EEC_PROTECTIONS_ACTIVE" 0 "INVALID" ;
VAL_ 1948 COM_ConfigErrorDetected 1 "ERROR" 0 "NO_ERROR" ;
VAL_ 1950 COM_ConfigErrorDetected 1 "ERROR" 0 "NO_ERROR" ;
VAL_ 1954 COM_ConfigErrorDetected 1 "ERROR" 0 "NO_ERROR" ;
VAL_ 1960 COM_ConfigErrorDetected 1 "ERROR" 0 "NO_ERROR" ;
VAL_ 1925 COM_ConfigErrorDetected 1 "ERROR" 0 "NO_ERROR" ;
VAL_ 1930 COM_ConfigErrorDetected 1 "ERROR" 0 "NO_ERROR" ;
VAL_ 1933 COM_ConfigErrorDetected 1 "ERROR" 0 "NO_ERROR" ;
VAL_ 1936 COM_ConfigErrorDetected 1 "ERROR" 0 "NO_ERROR" ;
VAL_ 1938 COM_ConfigErrorDetected 1 "ERROR" 0 "NO_ERROR" ;
VAL_ 1943 COM_ConfigErrorDetected 1 "ERROR" 0 "NO_ERROR" ;
VAL_ 1945 COM_ConfigErrorDetected 1 "ERROR" 0 "NO_ERROR" ;
VAL_ 965 CSA_SBIT_Monitor_Exec 1 "TRUE" 0 "FALSE" ;
VAL_ 965 CSA_TorqueOutputLimited 1 "TRUE" 0 "FALSE" ;
VAL_ 965 CSA_OutputPosition_Monitor 1 "ERROR" 0 "NO_ERROR" ;
VAL_ 965 CSA_CmdResponse_Monitor 1 "ERROR" 0 "NO_ERROR" ;
VAL_ 965 CSA_EMAControlError_Monitor 1 "ERROR" 0 "NO_ERROR" ;
VAL_ 965 CSA_EMACInternalError_Monitor 1 "ERROR" 0 "NO_ERROR" ;
VAL_ 965 CSA_LVInputBelow18V_Monitor 1 "ERROR" 0 "NO_ERROR" ;
VAL_ 965 CSA_PBIT_Monitor 1 "FAULT_DETECTED" 0 "NO_FAULT_DETECTED" ;
VAL_ 965 CSA_SBIT_Monitor 1 "FAULT_DETECTED" 0 "NO_FAULT_DETECTED" ;
VAL_ 965 CSA_LVInputBelowNorm_Monitor 1 "ERROR" 0 "NO_ERROR" ;
VAL_ 965 CSA_ActiveMode 5 "MAINTENANCE_MODE" 4 "SBIT_MODE" 3 "FAIL_SAFE" 2 "MOTOR_CONTROL_ACTIVE" 1 "STANDBY" 0 "POWER_UP_CONFIGURATION" ;
VAL_ 965 CSA_RBCmdValidity 3 "ROLLING_COUNTER_FAIL" 2 "E2E_CRC16_FAIL" 1 "CMD_TIMEOUT" 0 "MESSAGE_AND_DATA_VALID" ;
VAL_ 965 CSA_RACmdValidity 3 "ROLLING_COUNTER_FAIL" 2 "E2E_CRC16_FAIL" 1 "CMD_TIMEOUT" 0 "MESSAGE_AND_DATA_VALID" ;
VAL_ 965 CSA_SelectedFCC 3 "RB" 2 "RA" 1 "LB" 0 "LA" ;
VAL_ 965 CSA_LBCmdValidity 3 "ROLLING_COUNTER_FAIL" 2 "E2E_CRC16_FAIL" 1 "CMD_TIMEOUT" 0 "MESSAGE_AND_DATA_VALID" ;
VAL_ 965 CSA_LACmdValidity 3 "ROLLING_COUNTER_FAIL" 2 "E2E_CRC16_FAIL" 1 "CMD_TIMEOUT" 0 "MESSAGE_AND_DATA_VALID" ;
VAL_ 970 CSA_SBIT_Monitor_Exec 1 "TRUE" 0 "FALSE" ;
VAL_ 970 CSA_TorqueOutputLimited 1 "TRUE" 0 "FALSE" ;
VAL_ 970 CSA_OutputPosition_Monitor 1 "ERROR" 0 "NO_ERROR" ;
VAL_ 970 CSA_CmdResponse_Monitor 1 "ERROR" 0 "NO_ERROR" ;
VAL_ 970 CSA_EMAControlError_Monitor 1 "ERROR" 0 "NO_ERROR" ;
VAL_ 970 CSA_EMACInternalError_Monitor 1 "ERROR" 0 "NO_ERROR" ;
VAL_ 970 CSA_LVInputBelow18V_Monitor 1 "ERROR" 0 "NO_ERROR" ;
VAL_ 970 CSA_PBIT_Monitor 1 "FAULT_DETECTED" 0 "NO_FAULT_DETECTED" ;
VAL_ 970 CSA_SBIT_Monitor 1 "FAULT_DETECTED" 0 "NO_FAULT_DETECTED" ;
VAL_ 970 CSA_LVInputBelowNorm_Monitor 1 "ERROR" 0 "NO_ERROR" ;
VAL_ 970 CSA_ActiveMode 5 "MAINTENANCE_MODE" 4 "SBIT_MODE" 3 "FAIL_SAFE" 2 "MOTOR_CONTROL_ACTIVE" 1 "STANDBY" 0 "POWER_UP_CONFIGURATION" ;
VAL_ 970 CSA_RBCmdValidity 3 "ROLLING_COUNTER_FAIL" 2 "E2E_CRC16_FAIL" 1 "CMD_TIMEOUT" 0 "MESSAGE_AND_DATA_VALID" ;
VAL_ 970 CSA_RACmdValidity 3 "ROLLING_COUNTER_FAIL" 2 "E2E_CRC16_FAIL" 1 "CMD_TIMEOUT" 0 "MESSAGE_AND_DATA_VALID" ;
VAL_ 970 CSA_SelectedFCC 3 "RB" 2 "RA" 1 "LB" 0 "LA" ;
VAL_ 970 CSA_LBCmdValidity 3 "ROLLING_COUNTER_FAIL" 2 "E2E_CRC16_FAIL" 1 "CMD_TIMEOUT" 0 "MESSAGE_AND_DATA_VALID" ;
VAL_ 970 CSA_LACmdValidity 3 "ROLLING_COUNTER_FAIL" 2 "E2E_CRC16_FAIL" 1 "CMD_TIMEOUT" 0 "MESSAGE_AND_DATA_VALID" ;
VAL_ 973 CSA_SBIT_Monitor_Exec 1 "TRUE" 0 "FALSE" ;
VAL_ 973 CSA_TorqueOutputLimited 1 "TRUE" 0 "FALSE" ;
VAL_ 973 CSA_OutputPosition_Monitor 1 "ERROR" 0 "NO_ERROR" ;
VAL_ 973 CSA_CmdResponse_Monitor 1 "ERROR" 0 "NO_ERROR" ;
VAL_ 973 CSA_EMAControlError_Monitor 1 "ERROR" 0 "NO_ERROR" ;
VAL_ 973 CSA_EMACInternalError_Monitor 1 "ERROR" 0 "NO_ERROR" ;
VAL_ 973 CSA_LVInputBelow18V_Monitor 1 "ERROR" 0 "NO_ERROR" ;
VAL_ 973 CSA_PBIT_Monitor 1 "FAULT_DETECTED" 0 "NO_FAULT_DETECTED" ;
VAL_ 973 CSA_SBIT_Monitor 1 "FAULT_DETECTED" 0 "NO_FAULT_DETECTED" ;
VAL_ 973 CSA_LVInputBelowNorm_Monitor 1 "ERROR" 0 "NO_ERROR" ;
VAL_ 973 CSA_ActiveMode 5 "MAINTENANCE_MODE" 4 "SBIT_MODE" 3 "FAIL_SAFE" 2 "MOTOR_CONTROL_ACTIVE" 1 "STANDBY" 0 "POWER_UP_CONFIGURATION" ;
VAL_ 973 CSA_RBCmdValidity 3 "ROLLING_COUNTER_FAIL" 2 "E2E_CRC16_FAIL" 1 "CMD_TIMEOUT" 0 "MESSAGE_AND_DATA_VALID" ;
VAL_ 973 CSA_RACmdValidity 3 "ROLLING_COUNTER_FAIL" 2 "E2E_CRC16_FAIL" 1 "CMD_TIMEOUT" 0 "MESSAGE_AND_DATA_VALID" ;
VAL_ 973 CSA_SelectedFCC 3 "RB" 2 "RA" 1 "LB" 0 "LA" ;
VAL_ 973 CSA_LBCmdValidity 3 "ROLLING_COUNTER_FAIL" 2 "E2E_CRC16_FAIL" 1 "CMD_TIMEOUT" 0 "MESSAGE_AND_DATA_VALID" ;
VAL_ 973 CSA_LACmdValidity 3 "ROLLING_COUNTER_FAIL" 2 "E2E_CRC16_FAIL" 1 "CMD_TIMEOUT" 0 "MESSAGE_AND_DATA_VALID" ;
VAL_ 129 CSA_NotFly 1 "TRUE" 0 "FALSE" ;
VAL_ 129 CSAROR_DisableActiveControlFPGA 1 "TRUE" 0 "FALSE" ;
VAL_ 129 CSAROR_DisableActiveControlLaneB 1 "TRUE" 0 "FALSE" ;
VAL_ 129 CSAROR_DisableActiveControlLaneA 1 "TRUE" 0 "FALSE" ;
VAL_ 129 CSAROR_EnableActiveControl 1 "TRUE" 0 "FALSE" ;
VAL_ 129 CSARMR_DisableActiveControlFPGA 1 "TRUE" 0 "FALSE" ;
VAL_ 129 CSARMR_DisableActiveControlLaneB 1 "TRUE" 0 "FALSE" ;
VAL_ 129 CSARMR_DisableActiveControlLaneA 1 "TRUE" 0 "FALSE" ;
VAL_ 129 CSARMR_EnableActiveControl 1 "TRUE" 0 "FALSE" ;
VAL_ 129 CSARIR_DisableActiveControlFPGA 1 "TRUE" 0 "FALSE" ;
VAL_ 129 CSARIR_DisableActiveControlLaneB 1 "TRUE" 0 "FALSE" ;
VAL_ 129 CSARIR_DisableActiveControlLaneA 1 "TRUE" 0 "FALSE" ;
VAL_ 129 CSARIR_EnableActiveControl 1 "TRUE" 0 "FALSE" ;
VAL_ 129 CSALIR_DisableActiveControlFPGA 1 "TRUE" 0 "FALSE" ;
VAL_ 129 CSALIR_DisableActiveControlLaneB 1 "TRUE" 0 "FALSE" ;
VAL_ 129 CSALIR_DisableActiveControlLaneA 1 "TRUE" 0 "FALSE" ;
VAL_ 129 CSALIR_EnableActiveControl 1 "TRUE" 0 "FALSE" ;
VAL_ 129 CSALMR_DisableActiveControlFPGA 1 "TRUE" 0 "FALSE" ;
VAL_ 129 CSALMR_DisableActiveControlLaneB 1 "TRUE" 0 "FALSE" ;
VAL_ 129 CSALMR_DisableActiveControlLaneA 1 "TRUE" 0 "FALSE" ;
VAL_ 129 CSALMR_EnableActiveControl 1 "TRUE" 0 "FALSE" ;
VAL_ 129 CSALOR_DisableActiveControlFPGA 1 "TRUE" 0 "FALSE" ;
VAL_ 129 CSALOR_DisableActiveControlLaneB 1 "TRUE" 0 "FALSE" ;
VAL_ 129 CSALOR_DisableActiveControlLaneA 1 "TRUE" 0 "FALSE" ;
VAL_ 129 CSALOR_EnableActiveControl 1 "TRUE" 0 "FALSE" ;
VAL_ 129 CSAROF_DisableActiveControlFPGA 1 "TRUE" 0 "FALSE" ;
VAL_ 129 CSAROF_DisableActiveControlLaneB 1 "TRUE" 0 "FALSE" ;
VAL_ 129 CSAROF_DisableActiveControlLaneA 1 "TRUE" 0 "FALSE" ;
VAL_ 129 CSAROF_EnableActiveControl 1 "TRUE" 0 "FALSE" ;
VAL_ 129 CSARIF_DisableActiveControlFPGA 1 "TRUE" 0 "FALSE" ;
VAL_ 129 CSARIF_DisableActiveControlLaneB 1 "TRUE" 0 "FALSE" ;
VAL_ 129 CSARIF_DisableActiveControlLaneA 1 "TRUE" 0 "FALSE" ;
VAL_ 129 CSARIF_EnableActiveControl 1 "TRUE" 0 "FALSE" ;
VAL_ 129 CSALIF_DisableActiveControlFPGA 1 "TRUE" 0 "FALSE" ;
VAL_ 129 CSALIF_DisableActiveControlLaneB 1 "TRUE" 0 "FALSE" ;
VAL_ 129 CSALIF_DisableActiveControlLaneA 1 "TRUE" 0 "FALSE" ;
VAL_ 129 CSALIF_EnableActiveControl 1 "TRUE" 0 "FALSE" ;
VAL_ 129 CSALOF_DisableActiveControlFPGA 1 "TRUE" 0 "FALSE" ;
VAL_ 129 CSALOF_DisableActiveControlLaneB 1 "TRUE" 0 "FALSE" ;
VAL_ 129 CSALOF_DisableActiveControlLaneA 1 "TRUE" 0 "FALSE" ;
VAL_ 129 CSALOF_EnableActiveControl 1 "TRUE" 0 "FALSE" ;
VAL_ 193 TPAC_NotFly 1 "TRUE" 0 "FALSE" ;
VAL_ 193 TPAC6_ApplyBrakeCmd 1 "TRUE" 0 "FALSE" ;
VAL_ 193 TPAC6_DisableActiveControlFPGA 1 "TRUE" 0 "FALSE" ;
VAL_ 193 TPAC6_DisableActiveControlLaneB 1 "TRUE" 0 "FALSE" ;
VAL_ 193 TPAC6_DisableActiveControlLaneA 1 "TRUE" 0 "FALSE" ;
VAL_ 193 TPAC6_EnableActiveControl 1 "TRUE" 0 "FALSE" ;
VAL_ 193 TPAC5_ApplyBrakeCmd 1 "TRUE" 0 "FALSE" ;
VAL_ 193 TPAC5_DisableActiveControlFPGA 1 "TRUE" 0 "FALSE" ;
VAL_ 193 TPAC5_DisableActiveControlLaneB 1 "TRUE" 0 "FALSE" ;
VAL_ 193 TPAC5_DisableActiveControlLaneA 1 "TRUE" 0 "FALSE" ;
VAL_ 193 TPAC5_EnableActiveControl 1 "TRUE" 0 "FALSE" ;
VAL_ 193 TPAC4_ApplyBrakeCmd 1 "TRUE" 0 "FALSE" ;
VAL_ 193 TPAC4_DisableActiveControlFPGA 1 "TRUE" 0 "FALSE" ;
VAL_ 193 TPAC4_DisableActiveControlLaneB 1 "TRUE" 0 "FALSE" ;
VAL_ 193 TPAC4_DisableActiveControlLaneA 1 "TRUE" 0 "FALSE" ;
VAL_ 193 TPAC4_EnableActiveControl 1 "TRUE" 0 "FALSE" ;
VAL_ 193 TPAC3_ApplyBrakeCmd 1 "TRUE" 0 "FALSE" ;
VAL_ 193 TPAC3_DisableActiveControlFPGA 1 "TRUE" 0 "FALSE" ;
VAL_ 193 TPAC3_DisableActiveControlLaneB 1 "TRUE" 0 "FALSE" ;
VAL_ 193 TPAC3_DisableActiveControlLaneA 1 "TRUE" 0 "FALSE" ;
VAL_ 193 TPAC3_EnableActiveControl 1 "TRUE" 0 "FALSE" ;
VAL_ 193 TPAC2_ApplyBrakeCmd 1 "TRUE" 0 "FALSE" ;
VAL_ 193 TPAC2_DisableActiveControlFPGA 1 "TRUE" 0 "FALSE" ;
VAL_ 193 TPAC2_DisableActiveControlLaneB 1 "TRUE" 0 "FALSE" ;
VAL_ 193 TPAC2_DisableActiveControlLaneA 1 "TRUE" 0 "FALSE" ;
VAL_ 193 TPAC2_EnableActiveControl 1 "TRUE" 0 "FALSE" ;
VAL_ 193 TPAC1_ApplyBrakeCmd 1 "TRUE" 0 "FALSE" ;
VAL_ 193 TPAC1_DisableActiveControlFPGA 1 "TRUE" 0 "FALSE" ;
VAL_ 193 TPAC1_DisableActiveControlLaneB 1 "TRUE" 0 "FALSE" ;
VAL_ 193 TPAC1_DisableActiveControlLaneA 1 "TRUE" 0 "FALSE" ;
VAL_ 193 TPAC1_EnableActiveControl 1 "TRUE" 0 "FALSE" ;
VAL_ 1052 TPAC_SBIT_Monitor_Exec 1 "TRUE" 0 "FALSE" ;
VAL_ 1052 TPAC_ForceOutputLimited 1 "TRUE" 0 "FALSE" ;
VAL_ 1052 TPAC_OutputPosition_Monitor 1 "ERROR" 0 "NO_ERROR" ;
VAL_ 1052 TPAC_CmdResponse_Monitor 1 "ERROR" 0 "NO_ERROR" ;
VAL_ 1052 TPAC_EMAControlError_Monitor 1 "ERROR" 0 "NO_ERROR" ;
VAL_ 1052 TPAC_EMACInternalError_Monitor 1 "ERROR" 0 "NO_ERROR" ;
VAL_ 1052 TPAC_LVInputBelow18V_Monitor 1 "ERROR" 0 "NO_ERROR" ;
VAL_ 1052 TPAC_PBIT_Monitor 1 "ERROR" 0 "NO_ERROR" ;
VAL_ 1052 TPAC_BrakeError_Monitor 1 "ERROR" 0 "NO_ERROR" ;
VAL_ 1052 TPAC_SBIT_Monitor 1 "FAULT_DETECTED" 0 "NO_FAULT_DETECTED" ;
VAL_ 1052 TPAC_HVAppliedToTPAC 1 "TRUE" 0 "FALSE" ;
VAL_ 1052 TPAC_HVConnectorsInstalled 1 "HVIL_CLOSED" 0 "HVIL_OPEN" ;
VAL_ 1052 TPAC_HVInputBelow520V_Monitor 1 "ERROR" 0 "NO_ERROR" ;
VAL_ 1052 TPAC_LVInputBelowNorm_Monitor 1 "TRUE" 0 "FALSE" ;
VAL_ 1052 TPAC_BrakeApplied 1 "TRUE" 0 "FALSE" ;
VAL_ 1052 TPAC_ActiveMode 7 "SPARE" 6 "HV DISCHARGE" 5 "MAINTENANCE_MODE" 4 "SBIT_MODE" 3 "FAIL_SAFE" 2 "MOTOR_CONTROL_ACTIVE" 1 "STANDBY" 0 "POWER_UP_CONFIGURATION" ;
VAL_ 1052 TPAC_RBCmdValidity 3 "ROLLING_COUNTER_FAIL" 2 "E2E_CRC16_FAIL" 1 "CMD_TIMEOUT" 0 "MESSAGE_AND_DATA_VALID" ;
VAL_ 1052 TPAC_RACmdValidity 3 "ROLLING_COUNTER_FAIL" 2 "E2E_CRC16_FAIL" 1 "CMD_TIMEOUT" 0 "MESSAGE_AND_DATA_VALID" ;
VAL_ 1052 TPAC_SelectedFCC 3 "RB" 2 "RA" 1 "LB" 0 "LA" ;
VAL_ 1052 TPAC_LBCmdValidity 3 "ROLLING_COUNTER_FAIL" 2 "E2E_CRC16_FAIL" 1 "CMD_TIMEOUT" 0 "MESSAGE_AND_DATA_VALID" ;
VAL_ 1052 TPAC_LACmdValidity 3 "ROLLING_COUNTER_FAIL" 2 "E2E_CRC16_FAIL" 1 "CMD_TIMEOUT" 0 "MESSAGE_AND_DATA_VALID" ;
VAL_ 1054 TPAC_SBIT_Monitor_Exec 1 "TRUE" 0 "FALSE" ;
VAL_ 1054 TPAC_ForceOutputLimited 1 "TRUE" 0 "FALSE" ;
VAL_ 1054 TPAC_OutputPosition_Monitor 1 "ERROR" 0 "NO_ERROR" ;
VAL_ 1054 TPAC_CmdResponse_Monitor 1 "ERROR" 0 "NO_ERROR" ;
VAL_ 1054 TPAC_EMAControlError_Monitor 1 "ERROR" 0 "NO_ERROR" ;
VAL_ 1054 TPAC_EMACInternalError_Monitor 1 "ERROR" 0 "NO_ERROR" ;
VAL_ 1054 TPAC_LVInputBelow18V_Monitor 1 "ERROR" 0 "NO_ERROR" ;
VAL_ 1054 TPAC_PBIT_Monitor 1 "ERROR" 0 "NO_ERROR" ;
VAL_ 1054 TPAC_BrakeError_Monitor 1 "ERROR" 0 "NO_ERROR" ;
VAL_ 1054 TPAC_SBIT_Monitor 1 "FAULT_DETECTED" 0 "NO_FAULT_DETECTED" ;
VAL_ 1054 TPAC_HVAppliedToTPAC 1 "TRUE" 0 "FALSE" ;
VAL_ 1054 TPAC_HVConnectorsInstalled 1 "HVIL_CLOSED" 0 "HVIL_OPEN" ;
VAL_ 1054 TPAC_HVInputBelow520V_Monitor 1 "ERROR" 0 "NO_ERROR" ;
VAL_ 1054 TPAC_LVInputBelowNorm_Monitor 1 "TRUE" 0 "FALSE" ;
VAL_ 1054 TPAC_BrakeApplied 1 "TRUE" 0 "FALSE" ;
VAL_ 1054 TPAC_ActiveMode 7 "SPARE" 6 "HV DISCHARGE" 5 "MAINTENANCE_MODE" 4 "SBIT_MODE" 3 "FAIL_SAFE" 2 "MOTOR_CONTROL_ACTIVE" 1 "STANDBY" 0 "POWER_UP_CONFIGURATION" ;
VAL_ 1054 TPAC_RBCmdValidity 3 "ROLLING_COUNTER_FAIL" 2 "E2E_CRC16_FAIL" 1 "CMD_TIMEOUT" 0 "MESSAGE_AND_DATA_VALID" ;
VAL_ 1054 TPAC_RACmdValidity 3 "ROLLING_COUNTER_FAIL" 2 "E2E_CRC16_FAIL" 1 "CMD_TIMEOUT" 0 "MESSAGE_AND_DATA_VALID" ;
VAL_ 1054 TPAC_SelectedFCC 3 "RB" 2 "RA" 1 "LB" 0 "LA" ;
VAL_ 1054 TPAC_LBCmdValidity 3 "ROLLING_COUNTER_FAIL" 2 "E2E_CRC16_FAIL" 1 "CMD_TIMEOUT" 0 "MESSAGE_AND_DATA_VALID" ;
VAL_ 1054 TPAC_LACmdValidity 3 "ROLLING_COUNTER_FAIL" 2 "E2E_CRC16_FAIL" 1 "CMD_TIMEOUT" 0 "MESSAGE_AND_DATA_VALID" ;
VAL_ 1345 FCC_MaintenanceMode 1 "ENABLED" 0 "DISABLED" ;
VAL_ 1345 FCC_AircraftMode 3 "FLY" 2 "GND" 1 "SVCE" 0 "RESERVED" ;
VAL_ 1345 FCC_FlightPhase 13 "CLD" 12 "SLD" 11 "VLD" 10 "ITR" 9 "DSC" 8 "CRS" 7 "CLB" 6 "OTR" 5 "STO" 4 "VTO" 3 "CTO" 2 "TAX" 1 "PARK" 0 "PWR" ;
VAL_ 257 BMU_NotFly 1 "TRUE" 0 "FALSE" ;
VAL_ 257 BMU6_MainBusDeEnergizeCmd 1 "TRUE" 0 "FALSE" ;
VAL_ 257 BMU6_TilterPyroCmd 1 "DISCONNECT" 0 "NO_CMD" ;
VAL_ 257 BMU6_LifterPyroCmd 1 "DISCONNECT" 0 "NO_CMD" ;
VAL_ 257 BMU6_XlinkPyroCmd 1 "DISCONNECT" 0 "NO_CMD" ;
VAL_ 257 BMU6_PropBusCmd 2 "ENERGIZE" 1 "EE HVIL CHECK" 0 "DE_ENERGIZE" ;
VAL_ 257 BMU5_MainBusDeEnergizeCmd 1 "TRUE" 0 "FALSE" ;
VAL_ 257 BMU5_TilterPyroCmd 1 "DISCONNECT" 0 "NO_CMD" ;
VAL_ 257 BMU5_LifterPyroCmd 1 "DISCONNECT" 0 "NO_CMD" ;
VAL_ 257 BMU5_XlinkPyroCmd 1 "DISCONNECT" 0 "NO_CMD" ;
VAL_ 257 BMU5_PropBusCmd 2 "ENERGIZE" 1 "EE HVIL CHECK" 0 "DE_ENERGIZE" ;
VAL_ 257 BMU4_MainBusDeEnergizeCmd 1 "TRUE" 0 "FALSE" ;
VAL_ 257 BMU4_TilterPyroCmd 1 "DISCONNECT" 0 "NO_CMD" ;
VAL_ 257 BMU4_LifterPyroCmd 1 "DISCONNECT" 0 "NO_CMD" ;
VAL_ 257 BMU4_XlinkPyroCmd 1 "DISCONNECT" 0 "NO_CMD" ;
VAL_ 257 BMU4_PropBusCmd 2 "ENERGIZE" 1 "EE HVIL CHECK" 0 "DE_ENERGIZE" ;
VAL_ 257 BMU3_MainBusDeEnergizeCmd 1 "TRUE" 0 "FALSE" ;
VAL_ 257 BMU3_TilterPyroCmd 1 "DISCONNECT" 0 "NO_CMD" ;
VAL_ 257 BMU3_LifterPyroCmd 1 "DISCONNECT" 0 "NO_CMD" ;
VAL_ 257 BMU3_XlinkPyroCmd 1 "DISCONNECT" 0 "NO_CMD" ;
VAL_ 257 BMU3_PropBusCmd 2 "ENERGIZE" 1 "EE HVIL CHECK" 0 "DE_ENERGIZE" ;
VAL_ 257 BMU2_MainBusDeEnergizeCmd 1 "TRUE" 0 "FALSE" ;
VAL_ 257 BMU2_TilterPyroCmd 1 "DISCONNECT" 0 "NO_CMD" ;
VAL_ 257 BMU2_LifterPyroCmd 1 "DISCONNECT" 0 "NO_CMD" ;
VAL_ 257 BMU2_XlinkPyroCmd 1 "DISCONNECT" 0 "NO_CMD" ;
VAL_ 257 BMU2_PropBusCmd 2 "ENERGIZE" 1 "EE HVIL CHECK" 0 "DE_ENERGIZE" ;
VAL_ 257 BMU1_MainBusDeEnergizeCmd 1 "TRUE" 0 "FALSE" ;
VAL_ 257 BMU1_TilterPyroCmd 1 "DISCONNECT" 0 "NO_CMD" ;
VAL_ 257 BMU1_LifterPyroCmd 1 "DISCONNECT" 0 "NO_CMD" ;
VAL_ 257 BMU1_XlinkPyroCmd 1 "DISCONNECT" 0 "NO_CMD" ;
VAL_ 257 BMU1_PropBusCmd 2 "ENERGIZE" 1 "EE HVIL CHECK" 0 "DE_ENERGIZE" ;
VAL_ 1128 BMU_ConsolidatedEISTemp_Validity 3 "RESERVED" 2 "VALID" 1 "DEGRADED" 0 "INVALID" ;
VAL_ 1128 BMU_PackOverheatAlert 1 "ERROR" 0 "NO_ERROR" ;
VAL_ 1128 BMU_PackHiTempAlert 1 "ERROR" 0 "NO_ERROR" ;
VAL_ 1128 BMU_PackTempAlert 1 "ERROR" 0 "NO_ERROR" ;
VAL_ 1128 BMU_EstHVPSDegradedAlert 1 "ERROR" 0 "NO_ERROR" ;
VAL_ 1128 BMU_ChgPwr2sHiFi_Validity 3 "RESERVED" 2 "VALID" 1 "DEGRADED" 0 "INVALID" ;
VAL_ 1128 BMU_ChgPwr10sHiFi_Validity 3 "RESERVED" 2 "VALID" 1 "DEGRADED" 0 "INVALID" ;
VAL_ 1128 BMU_MaxAvailEnergyHiFi_Validity 3 "RESERVED" 2 "VALID" 1 "DEGRADED" 0 "INVALID" ;
VAL_ 1128 BMU_RemainingEnergyHiFi_Validity 3 "RESERVED" 2 "VALID" 1 "DEGRADED" 0 "INVALID" ;
VAL_ 1128 BMU_PackSOC_Validity 3 "RESERVED" 2 "VALID" 1 "DEGRADED" 0 "INVALID" ;
VAL_ 1128 BMU_VLEnergyHiFi_Validity 3 "RESERVED" 2 "VALID" 1 "DEGRADED" 0 "INVALID" ;
VAL_ 1128 BMU_CLEnergyHiFi_Validity 3 "RESERVED" 2 "VALID" 1 "DEGRADED" 0 "INVALID" ;
VAL_ 1128 BMU_ModuleMinVoltage_Validity 3 "RESERVED" 2 "VALID" 1 "DEGRADED" 0 "INVALID" ;
VAL_ 1128 BMU_ModuleMaxVoltage_Validity 3 "RESERVED" 2 "VALID" 1 "DEGRADED" 0 "INVALID" ;
VAL_ 1128 BMU_CellBlockMinTemp_Validity 3 "RESERVED" 2 "VALID" 1 "DEGRADED" 0 "INVALID" ;
VAL_ 1128 BMU_CellBlockMaxTemp_Validity 3 "RESERVED" 2 "VALID" 1 "DEGRADED" 0 "INVALID" ;
VAL_ 1128 BMU_CellStackCurrent_Validity 3 "RESERVED" 2 "VALID" 1 "DEGRADED" 0 "INVALID" ;
VAL_ 1128 BMU_PackSOH_Validity 3 "RESERVED" 2 "VALID" 1 "DEGRADED" 0 "INVALID" ;
VAL_ 1128 BMU_DchgPwr10sHiFi_Validity 3 "RESERVED" 2 "VALID" 1 "DEGRADED" 0 "INVALID" ;
VAL_ 1128 BMU_DchgPwr2sHiFi_Validity 3 "RESERVED" 2 "VALID" 1 "DEGRADED" 0 "INVALID" ;
VAL_ 1189 BMU_Mate_PackTempAlert 1 "ERROR" 0 "NO_ERROR" ;
VAL_ 1189 BMU_Mate_PackHiTempAlert 1 "ERROR" 0 "NO_ERROR" ;
VAL_ 1189 BMU_Mate_PackOverheatAlert 1 "ERROR" 0 "NO_ERROR" ;
VAL_ 1189 BMU_Mate_EstHVPSDegradedAlert 1 "ERROR" 0 "NO_ERROR" ;
VAL_ 1189 BMU_Mate_CtrlHVPSDegradedAlert 1 "ERROR" 0 "NO_ERROR" ;
VAL_ 1189 BMU_Mate_PackHVExposedAlert 1 "ERROR" 0 "NO_ERROR" ;
VAL_ 1189 BMU_Mate_HVPSFaultAlert 1 "ERROR" 0 "NO_ERROR" ;
VAL_ 1189 BMU_Mate_HVPSImbalanceAlert 1 "ERROR" 0 "NO_ERROR" ;
VAL_ 1189 BMU_PackPyroStatus 3 "RESERVED" 2 "CLOSED" 1 "OPEN" 0 "INVALID" ;
VAL_ 1189 BMU_PackHVExposedAlert 1 "ERROR" 0 "NO_ERROR" ;
VAL_ 1189 BMU_CtrlHVPSDegradedAlert 1 "ERROR" 0 "NO_ERROR" ;
VAL_ 1189 BMU_HVPSFaultAlert 1 "ERROR" 0 "NO_ERROR" ;
VAL_ 1189 BMU_HVPSImbalanceAlert 1 "ERROR" 0 "NO_ERROR" ;
VAL_ 1189 BMU_PropMinBusVoltageFault 1 "ERROR" 0 "NO_ERROR" ;
VAL_ 1189 BMU_ECSMinBusVoltageFault 1 "ERROR" 0 "NO_ERROR" ;
VAL_ 1189 BMU_ThermalPlugStatus 3 "RESERVED" 2 "CONNECTED" 1 "DISCONNECTED" 0 "INVALID" ;
VAL_ 1189 BMU_ChargePlugStatus 3 "RESERVED" 2 "CONNECTED" 1 "DISCONNECTED" 0 "INVALID" ;
VAL_ 1189 BMU_ChargeStatus 2 "NOT CHARGING" 1 "CHARGING" 0 "INVALID" ;
VAL_ 1189 BMU_CCUModeSwitchPosition 2 "GND" 1 "SVCE" 0 "INVALID" ;
VAL_ 1189 BMU_XlinkLSPyroStatus 3 "RESERVED" 2 "CLOSED" 1 "OPEN" 0 "INVALID" ;
VAL_ 1189 BMU_XlinkHSPyroStatus 3 "RESERVED" 2 "CLOSED" 1 "OPEN" 0 "INVALID" ;
VAL_ 1189 BMU_EE2PyroStatus 3 "RESERVED" 2 "CLOSED" 1 "OPEN" 0 "INVALID" ;
VAL_ 1189 BMU_EE1PyroStatus 3 "RESERVED" 2 "CLOSED" 1 "OPEN" 0 "INVALID" ;
VAL_ 1189 BMU_AuxCurrent_Validity 3 "RESERVED" 2 "VALID" 1 "DEGRADED" 0 "INVALID" ;
VAL_ 1189 BMU_PropBusConnectionState 5 "HV_FAULT" 4 "HV_READY_CLOSED" 3 "HV_CLOSING" 2 "HV_OPENING" 1 "HV_OPEN" 0 "HV_UNKNOWN" ;
VAL_ 1189 BMU_MainBusConnectionState 5 "HV_FAULT" 4 "HV_READY_CLOSED" 3 "HV_CLOSING" 2 "HV_OPENING" 1 "HV_OPEN" 0 "HV_UNKNOWN" ;
VAL_ 1189 BMU_Mate_ChgPwr2sHiFi_Validity 3 "RESERVED" 2 "VALID" 1 "DEGRADED" 0 "INVALID" ;
VAL_ 1189 BMU_Mate_ChgPwr10sHiFi_Validity 3 "RESERVED" 2 "VALID" 1 "DEGRADED" 0 "INVALID" ;
VAL_ 1189 BMU_ChgPwr2sLoFi_Validity 3 "RESERVED" 2 "VALID" 1 "DEGRADED" 0 "INVALID" ;
VAL_ 1189 BMU_ChgPwr10sLoFi_Validity 3 "RESERVED" 2 "VALID" 1 "DEGRADED" 0 "INVALID" ;
VAL_ 1189 BMU_CLEnergyLoFi_Validity 3 "RESERVED" 2 "VALID" 1 "DEGRADED" 0 "INVALID" ;
VAL_ 1189 BMU_VLEnergyLoFi_Validity 3 "RESERVED" 2 "VALID" 1 "DEGRADED" 0 "INVALID" ;
VAL_ 1189 BMU_MaxAvailEnergyLoFi_Validity 3 "RESERVED" 2 "VALID" 1 "DEGRADED" 0 "INVALID" ;
VAL_ 1189 BMU_RemainingEnergyLoFi_Validity 3 "RESERVED" 2 "VALID" 1 "DEGRADED" 0 "INVALID" ;
VAL_ 1189 BMU_ChargeTimeRemaining_Validity 3 "RESERVED" 2 "VALID" 1 "DEGRADED" 0 "INVALID" ;
VAL_ 1189 BMU_ChargeCurrent_Validity 3 "RESERVED" 2 "VALID" 1 "DEGRADED" 0 "INVALID" ;
VAL_ 1189 BMU_ChargerVoltage_Validity 3 "RESERVED" 2 "VALID" 1 "DEGRADED" 0 "INVALID" ;
VAL_ 1189 BMU_Mate_DchgPwr10sHiFi_Validity 3 "RESERVED" 2 "VALID" 1 "DEGRADED" 0 "INVALID" ;
VAL_ 1189 BMU_Mate_DchgPwr2sHiFi_Validity 3 "RESERVED" 2 "VALID" 1 "DEGRADED" 0 "INVALID" ;
VAL_ 1189 BMU_DchgPwr10sLoFi_Validity 3 "RESERVED" 2 "VALID" 1 "DEGRADED" 0 "INVALID" ;
VAL_ 1189 BMU_DchgPwr2sLoFi_Validity 3 "RESERVED" 2 "VALID" 1 "DEGRADED" 0 "INVALID" ;
VAL_ 1189 BMU_EE2Current_Validity 3 "RESERVED" 2 "VALID" 1 "DEGRADED" 0 "INVALID" ;
VAL_ 1189 BMU_EE1Current_Validity 3 "RESERVED" 2 "VALID" 1 "DEGRADED" 0 "INVALID" ;
VAL_ 1189 BMU_XlinkCurrent_Validity 3 "RESERVED" 2 "VALID" 1 "DEGRADED" 0 "INVALID" ;
VAL_ 1189 BMU_PropBusVoltage_Validity 3 "RESERVED" 2 "VALID" 1 "DEGRADED" 0 "INVALID" ;
VAL_ 1189 BMU_CellStackVoltage_Validity 3 "RESERVED" 2 "VALID" 1 "DEGRADED" 0 "INVALID" ;
VAL_ 719 EEC_RBCmdValidity 3 "ROLLING_COUNTER_FAIL" 2 "E2E_CRC16_FAIL" 1 "CMD_TIMEOUT" 0 "MESSAGE_AND_DATA_VALID" ;
VAL_ 719 EEC_RACmdValidity 3 "ROLLING_COUNTER_FAIL" 2 "E2E_CRC16_FAIL" 1 "CMD_TIMEOUT" 0 "MESSAGE_AND_DATA_VALID" ;
VAL_ 719 EEC_LBCmdValidity 3 "ROLLING_COUNTER_FAIL" 2 "E2E_CRC16_FAIL" 1 "CMD_TIMEOUT" 0 "MESSAGE_AND_DATA_VALID" ;
VAL_ 719 EEC_LACmdValidity 3 "ROLLING_COUNTER_FAIL" 2 "E2E_CRC16_FAIL" 1 "CMD_TIMEOUT" 0 "MESSAGE_AND_DATA_VALID" ;
VAL_ 719 EEC_StowingAvailable 1 "TRUE" 0 "FALSE" ;
VAL_ 719 EEC_MaxPowerTimeLimit_Validity 3 "RESERVED" 2 "VALID" 1 "DEGRADED" 0 "INVALID" ;
VAL_ 719 EEC_TakeoffTimeLimit_Validity 3 "RESERVED" 2 "VALID" 1 "DEGRADED" 0 "INVALID" ;
VAL_ 719 EEC_ConsolidatedTemp_Validity 3 "RESERVED" 2 "VALID" 1 "DEGRADED" 0 "INVALID" ;
VAL_ 719 EEC_StatorWindingTemp_Validity 3 "RESERVED" 2 "VALID" 1 "DEGRADED" 0 "INVALID" ;
VAL_ 719 EEC_OilTemp_Validity 3 "RESERVED" 2 "VALID" 1 "DEGRADED" 0 "INVALID" ;
VAL_ 719 EEC_ControllerTemp_Validity 3 "RESERVED" 2 "VALID" 1 "DEGRADED" 0 "INVALID" ;
VAL_ 719 EEC_HVInputVoltage_Validity 3 "RESERVED" 2 "VALID" 1 "DEGRADED" 0 "INVALID" ;
VAL_ 719 EEC_HVCurrent_Validity 3 "RESERVED" 2 "VALID" 1 "DEGRADED" 0 "INVALID" ;
VAL_ 723 EEC_RBCmdValidity 3 "ROLLING_COUNTER_FAIL" 2 "E2E_CRC16_FAIL" 1 "CMD_TIMEOUT" 0 "MESSAGE_AND_DATA_VALID" ;
VAL_ 723 EEC_RACmdValidity 3 "ROLLING_COUNTER_FAIL" 2 "E2E_CRC16_FAIL" 1 "CMD_TIMEOUT" 0 "MESSAGE_AND_DATA_VALID" ;
VAL_ 723 EEC_LBCmdValidity 3 "ROLLING_COUNTER_FAIL" 2 "E2E_CRC16_FAIL" 1 "CMD_TIMEOUT" 0 "MESSAGE_AND_DATA_VALID" ;
VAL_ 723 EEC_LACmdValidity 3 "ROLLING_COUNTER_FAIL" 2 "E2E_CRC16_FAIL" 1 "CMD_TIMEOUT" 0 "MESSAGE_AND_DATA_VALID" ;
VAL_ 723 EEC_StowingAvailable 1 "TRUE" 0 "FALSE" ;
VAL_ 723 EEC_MaxPowerTimeLimit_Validity 3 "RESERVED" 2 "VALID" 1 "DEGRADED" 0 "INVALID" ;
VAL_ 723 EEC_TakeoffTimeLimit_Validity 3 "RESERVED" 2 "VALID" 1 "DEGRADED" 0 "INVALID" ;
VAL_ 723 EEC_ConsolidatedTemp_Validity 3 "RESERVED" 2 "VALID" 1 "DEGRADED" 0 "INVALID" ;
VAL_ 723 EEC_StatorWindingTemp_Validity 3 "RESERVED" 2 "VALID" 1 "DEGRADED" 0 "INVALID" ;
VAL_ 723 EEC_OilTemp_Validity 3 "RESERVED" 2 "VALID" 1 "DEGRADED" 0 "INVALID" ;
VAL_ 723 EEC_ControllerTemp_Validity 3 "RESERVED" 2 "VALID" 1 "DEGRADED" 0 "INVALID" ;
VAL_ 723 EEC_HVInputVoltage_Validity 3 "RESERVED" 2 "VALID" 1 "DEGRADED" 0 "INVALID" ;
VAL_ 723 EEC_HVCurrent_Validity 3 "RESERVED" 2 "VALID" 1 "DEGRADED" 0 "INVALID" ;
VAL_ 726 EEC_RBCmdValidity 3 "ROLLING_COUNTER_FAIL" 2 "E2E_CRC16_FAIL" 1 "CMD_TIMEOUT" 0 "MESSAGE_AND_DATA_VALID" ;
VAL_ 726 EEC_RACmdValidity 3 "ROLLING_COUNTER_FAIL" 2 "E2E_CRC16_FAIL" 1 "CMD_TIMEOUT" 0 "MESSAGE_AND_DATA_VALID" ;
VAL_ 726 EEC_LBCmdValidity 3 "ROLLING_COUNTER_FAIL" 2 "E2E_CRC16_FAIL" 1 "CMD_TIMEOUT" 0 "MESSAGE_AND_DATA_VALID" ;
VAL_ 726 EEC_LACmdValidity 3 "ROLLING_COUNTER_FAIL" 2 "E2E_CRC16_FAIL" 1 "CMD_TIMEOUT" 0 "MESSAGE_AND_DATA_VALID" ;
VAL_ 726 EEC_StowingAvailable 1 "TRUE" 0 "FALSE" ;
VAL_ 726 EEC_MaxPowerTimeLimit_Validity 3 "RESERVED" 2 "VALID" 1 "DEGRADED" 0 "INVALID" ;
VAL_ 726 EEC_TakeoffTimeLimit_Validity 3 "RESERVED" 2 "VALID" 1 "DEGRADED" 0 "INVALID" ;
VAL_ 726 EEC_ConsolidatedTemp_Validity 3 "RESERVED" 2 "VALID" 1 "DEGRADED" 0 "INVALID" ;
VAL_ 726 EEC_StatorWindingTemp_Validity 3 "RESERVED" 2 "VALID" 1 "DEGRADED" 0 "INVALID" ;
VAL_ 726 EEC_OilTemp_Validity 3 "RESERVED" 2 "VALID" 1 "DEGRADED" 0 "INVALID" ;
VAL_ 726 EEC_ControllerTemp_Validity 3 "RESERVED" 2 "VALID" 1 "DEGRADED" 0 "INVALID" ;
VAL_ 726 EEC_HVInputVoltage_Validity 3 "RESERVED" 2 "VALID" 1 "DEGRADED" 0 "INVALID" ;
VAL_ 726 EEC_HVCurrent_Validity 3 "RESERVED" 2 "VALID" 1 "DEGRADED" 0 "INVALID" ;
VAL_ 730 EEC_RBCmdValidity 3 "ROLLING_COUNTER_FAIL" 2 "E2E_CRC16_FAIL" 1 "CMD_TIMEOUT" 0 "MESSAGE_AND_DATA_VALID" ;
VAL_ 730 EEC_RACmdValidity 3 "ROLLING_COUNTER_FAIL" 2 "E2E_CRC16_FAIL" 1 "CMD_TIMEOUT" 0 "MESSAGE_AND_DATA_VALID" ;
VAL_ 730 EEC_LBCmdValidity 3 "ROLLING_COUNTER_FAIL" 2 "E2E_CRC16_FAIL" 1 "CMD_TIMEOUT" 0 "MESSAGE_AND_DATA_VALID" ;
VAL_ 730 EEC_LACmdValidity 3 "ROLLING_COUNTER_FAIL" 2 "E2E_CRC16_FAIL" 1 "CMD_TIMEOUT" 0 "MESSAGE_AND_DATA_VALID" ;
VAL_ 730 EEC_StowingAvailable 1 "TRUE" 0 "FALSE" ;
VAL_ 730 EEC_MaxPowerTimeLimit_Validity 3 "RESERVED" 2 "VALID" 1 "DEGRADED" 0 "INVALID" ;
VAL_ 730 EEC_TakeoffTimeLimit_Validity 3 "RESERVED" 2 "VALID" 1 "DEGRADED" 0 "INVALID" ;
VAL_ 730 EEC_ConsolidatedTemp_Validity 3 "RESERVED" 2 "VALID" 1 "DEGRADED" 0 "INVALID" ;
VAL_ 730 EEC_StatorWindingTemp_Validity 3 "RESERVED" 2 "VALID" 1 "DEGRADED" 0 "INVALID" ;
VAL_ 730 EEC_OilTemp_Validity 3 "RESERVED" 2 "VALID" 1 "DEGRADED" 0 "INVALID" ;
VAL_ 730 EEC_ControllerTemp_Validity 3 "RESERVED" 2 "VALID" 1 "DEGRADED" 0 "INVALID" ;
VAL_ 730 EEC_HVInputVoltage_Validity 3 "RESERVED" 2 "VALID" 1 "DEGRADED" 0 "INVALID" ;
VAL_ 730 EEC_HVCurrent_Validity 3 "RESERVED" 2 "VALID" 1 "DEGRADED" 0 "INVALID" ;
VAL_ 655 EEC_PhaseShort_Fault 1 "FAULTED" 0 "NOT FAULTED" ;
VAL_ 655 EEC_FCSOverrideLimitsFeedback 3 "RESERVED" 2 "EEC_PROTECTIONS_INACTIVE" 1 "EEC_PROTECTIONS_ACTIVE" 0 "INVALID" ;
VAL_ 655 EEC_IBIT_Status 3 "IBIT_PASS" 2 "IBIT_FAIL" 1 "IBIT_INPROGRESS" 0 "IBIT_IDLE" ;
VAL_ 655 EEC_PrimaryMCU 1 "MCU_B" 0 "MCU_A" ;
VAL_ 655 EEC_SelectedFCC 3 "RB" 2 "RA" 1 "LB" 0 "LA" ;
VAL_ 655 EEC_StateFeedback 13 "EEC_STATE_ENGINE_SPINDOWN" 12 "EEC_STATE_ENGINE_WARMING" 11 "EEC_STATE_ENGINE_COOLING" 10 "EEC_STATE_RESIST_WINDMILL" 9 "EEC_STATE_MAINT" 8 "EEC_STATE_FAULT" 7 "EEC_STATE_ACTIVE_DISCHARGE" 6 "EEC_STATE_MIN_DRAG_STOW" 5 "EEC_STATE_MAX_DRAG_STOW" 4 "EEC_STATE_STOWING" 3 "EEC_STATE_ENABLE" 2 "EEC_STATE_SPINUP" 1 "EEC_STATE_STANDBY" 0 "EEC_STATE_INIT" ;
VAL_ 655 EEC_OutputShaftTorque_Validity 3 "RESERVED" 2 "VALID" 1 "DEGRADED" 0 "INVALID" ;
VAL_ 655 EEC_PropellerRPM_Validity 3 "RESERVED" 2 "VALID" 1 "DEGRADED" 0 "INVALID" ;
VAL_ 659 EEC_PhaseShort_Fault 1 "FAULTED" 0 "NOT FAULTED" ;
VAL_ 659 EEC_FCSOverrideLimitsFeedback 3 "RESERVED" 2 "EEC_PROTECTIONS_INACTIVE" 1 "EEC_PROTECTIONS_ACTIVE" 0 "INVALID" ;
VAL_ 659 EEC_IBIT_Status 3 "IBIT_PASS" 2 "IBIT_FAIL" 1 "IBIT_INPROGRESS" 0 "IBIT_IDLE" ;
VAL_ 659 EEC_PrimaryMCU 1 "MCU_B" 0 "MCU_A" ;
VAL_ 659 EEC_SelectedFCC 3 "RB" 2 "RA" 1 "LB" 0 "LA" ;
VAL_ 659 EEC_StateFeedback 13 "EEC_STATE_ENGINE_SPINDOWN" 12 "EEC_STATE_ENGINE_WARMING" 11 "EEC_STATE_ENGINE_COOLING" 10 "EEC_STATE_RESIST_WINDMILL" 9 "EEC_STATE_MAINT" 8 "EEC_STATE_FAULT" 7 "EEC_STATE_ACTIVE_DISCHARGE" 6 "EEC_STATE_MIN_DRAG_STOW" 5 "EEC_STATE_MAX_DRAG_STOW" 4 "EEC_STATE_STOWING" 3 "EEC_STATE_ENABLE" 2 "EEC_STATE_SPINUP" 1 "EEC_STATE_STANDBY" 0 "EEC_STATE_INIT" ;
VAL_ 659 EEC_OutputShaftTorque_Validity 3 "RESERVED" 2 "VALID" 1 "DEGRADED" 0 "INVALID" ;
VAL_ 659 EEC_PropellerRPM_Validity 3 "RESERVED" 2 "VALID" 1 "DEGRADED" 0 "INVALID" ;
VAL_ 662 EEC_PhaseShort_Fault 1 "FAULTED" 0 "NOT FAULTED" ;
VAL_ 662 EEC_FCSOverrideLimitsFeedback 3 "RESERVED" 2 "EEC_PROTECTIONS_INACTIVE" 1 "EEC_PROTECTIONS_ACTIVE" 0 "INVALID" ;
VAL_ 662 EEC_IBIT_Status 3 "IBIT_PASS" 2 "IBIT_FAIL" 1 "IBIT_INPROGRESS" 0 "IBIT_IDLE" ;
VAL_ 662 EEC_PrimaryMCU 1 "MCU_B" 0 "MCU_A" ;
VAL_ 662 EEC_SelectedFCC 3 "RB" 2 "RA" 1 "LB" 0 "LA" ;
VAL_ 662 EEC_StateFeedback 13 "EEC_STATE_ENGINE_SPINDOWN" 12 "EEC_STATE_ENGINE_WARMING" 11 "EEC_STATE_ENGINE_COOLING" 10 "EEC_STATE_RESIST_WINDMILL" 9 "EEC_STATE_MAINT" 8 "EEC_STATE_FAULT" 7 "EEC_STATE_ACTIVE_DISCHARGE" 6 "EEC_STATE_MIN_DRAG_STOW" 5 "EEC_STATE_MAX_DRAG_STOW" 4 "EEC_STATE_STOWING" 3 "EEC_STATE_ENABLE" 2 "EEC_STATE_SPINUP" 1 "EEC_STATE_STANDBY" 0 "EEC_STATE_INIT" ;
VAL_ 662 EEC_OutputShaftTorque_Validity 3 "RESERVED" 2 "VALID" 1 "DEGRADED" 0 "INVALID" ;
VAL_ 662 EEC_PropellerRPM_Validity 3 "RESERVED" 2 "VALID" 1 "DEGRADED" 0 "INVALID" ;
SIG_VALTYPE_ 2047 current_ctrl_i_dq_cmd_d : 1;
SIG_VALTYPE_ 2047 current_ctrl_i_dq_cmd_q : 1;
SIG_VALTYPE_ 2047 voltage_ctrl_v_dq_cmd_d : 1;
SIG_VALTYPE_ 2047 voltage_ctrl_v_dq_cmd_q : 1;
SIG_VALTYPE_ 2047 commanded_engine_torque : 1;
SIG_VALTYPE_ 2047 commanded_engine_speed : 1;
